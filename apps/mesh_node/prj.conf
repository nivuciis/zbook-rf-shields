## CMakeLists.txt
```
# Copyright (c) 2026 Centro de Inovacao EDGE
# SPDX-License-Identifier: Apache-2.0

cmake_minimum_required(VERSION 3.20.0)

find_package(Zephyr REQUIRED HINTS $ENV{ZEPHYR_BASE})
project(mesh_node)

target_sources(app PRIVATE
  src/main.c
  src/mesh.c
  src/radio.c
  src/meshtastic.c
  src/nodedb.c
  src/pb.c
  src/aes128.c
  src/hw_models.c
  src/events.c
  src/input.c
  src/gfx.c
  src/font5x8.c
  src/ui_draw.c
  src/ui.c
  src/buzzer.c
)
```

## Kconfig
```
# Copyright (c) 2026 Centro de Inovacao EDGE
# SPDX-License-Identifier: Apache-2.0

mainmenu "ZBook Meshtastic node"

config APP_UI_ENCODER_REVERSE
	bool "Reverse the rotary encoder direction"
	help
	  Enable if turning the encoder clockwise moves the selection up.

source "Kconfig.zephyr"
```

## prj.conf
```kconfig
# Copyright (c) 2026 Centro de Inovacao EDGE
# SPDX-License-Identifier: Apache-2.0

# The RFM95W is driven directly over SPI by src/radio.c, so the Zephyr LoRa
# driver (enabled by default by the zbook_lora shield) is left out.
CONFIG_LORA=n
CONFIG_SPI=y
CONFIG_GPIO=y

# Chip unique ID -> Meshtastic node number
CONFIG_HWINFO=y

# Interactive console on the PROG USB serial port
CONFIG_SHELL=y
CONFIG_SHELL_STACK_SIZE=4096
CONFIG_SHELL_BACKEND_SERIAL=y
CONFIG_SHELL_CMD_BUFF_SIZE=320
CONFIG_SHELL_ARGC_MAX=40

# Logs go through the shell
CONFIG_LOG=y
CONFIG_LOG_BUFFER_SIZE=4096

CONFIG_MAIN_STACK_SIZE=2048

# Periodic NODEINFO/position sends build and encrypt packets on the system workqueue
CONFIG_SYSTEM_WORKQUEUE_STACK_SIZE=2048

# OLED user interface: SSD1306 on i2c0, BTN0..BTN3 and the rotary encoder
CONFIG_I2C=y
CONFIG_DISPLAY=y
CONFIG_INPUT=y

# Piezo buzzer (pwm-buzzer alias, GPIO32)
CONFIG_PWM=y

# zbus: input and mesh events to the UI (message subscriber, static buffers)
CONFIG_ZBUS=y
CONFIG_ZBUS_MSG_SUBSCRIBER=y
CONFIG_ZBUS_MSG_SUBSCRIBER_BUF_ALLOC_STATIC=y
CONFIG_ZBUS_MSG_SUBSCRIBER_NET_BUF_STATIC_DATA_SIZE=256
CONFIG_ZBUS_MSG_SUBSCRIBER_NET_BUF_POOL_SIZE=16
```

## app.overlay
```dts
/*
 * Copyright (c) 2026 Centro de Inovacao EDGE
 * SPDX-License-Identifier: Apache-2.0
 *
 * mesh_node only: run i2c0 at 400 kHz so a full OLED frame (1 KB) takes
 * about 25 ms instead of 100 ms. The SSD1306 and the TMP1075 support it.
 */
#include <zephyr/dt-bindings/i2c/i2c.h>

&i2c0 {
	clock-frequency = <I2C_BITRATE_FAST>;
};
```

## src/main.c
```c
/**
 * @file main.c
 *
 * @brief Meshtastic node for the ZBook + RFM95W.
 *
 * Joins the Meshtastic primary channel (LongFast, default key) as a CLIENT
 * node: announces itself (NODEINFO), relays packets for its neighbours
 * (managed flooding), answers ACKs and NODEINFO requests, and sends and
 * receives text messages. Everything is driven from the Zephyr shell
 * ("mesh" commands) on the PROG USB serial port.
 *
 * @author Vinicius RM Carvalho
 * @date 2026-11-12
 * @copyright Copyright (c) 2026 Centro de Inovacao EDGE
 * SPDX-License-Identifier: Apache-2.0
 */
#include <stdlib.h>
#include <string.h>

#include <zephyr/kernel.h>
#include <zephyr/logging/log.h>
#include <zephyr/shell/shell.h>

#include "mesh.h"
#include "meshtastic.h"
#include "nodedb.h"
#include "radio.h"
#include "ui.h"

LOG_MODULE_REGISTER(app, LOG_LEVEL_INF);

#define DEFAULT_REGION       "US"
#define DEFAULT_PRESET       "LongFast"
#define NODEINFO_PERIOD      K_HOURS(3)    /* Meshtastic default */
#define POSITION_PERIOD      K_MINUTES(30)

/* ------------------------------------------------------- periodic sends */

static void nodeinfo_work_fn(struct k_work *work);
static void position_work_fn(struct k_work *work);
static K_WORK_DELAYABLE_DEFINE(nodeinfo_work, nodeinfo_work_fn);
static K_WORK_DELAYABLE_DEFINE(position_work, position_work_fn);

static void nodeinfo_work_fn(struct k_work *work)
{
	mesh_send_nodeinfo(MESH_BROADCAST, false);
	k_work_reschedule(k_work_delayable_from_work(work), NODEINFO_PERIOD);
}

static void position_work_fn(struct k_work *work)
{
	if (mesh_has_position()) {
		mesh_send_position(MESH_BROADCAST);
	}
	k_work_reschedule(k_work_delayable_from_work(work), POSITION_PERIOD);
}

/* ---------------------------------------------------------------- helpers */

/* Degrees * 1e7 -> "-9.64980" without floating point. */
static void fmt_coord(char *buf, size_t size, int32_t v)
{
	uint32_t a = v < 0 ? (uint32_t)(-(int64_t)v) : (uint32_t)v;

	snprintk(buf, size, "%s%u.%05u", v < 0 ? "-" : "", a / 10000000U, (a % 10000000U) / 100U);
}

/* "-9.6498" -> -96498000 (degrees * 1e7) without floating point. */
static bool parse_coord(const char *s, int32_t *out)
{
	bool neg = false;
	int64_t ip = 0, frac = 0, scale = 10000000;

	if (*s == '-' || *s == '+') {
		neg = (*s == '-');
		s++;
	}
	if (*s < '0' || *s > '9') {
		return false;
	}
	while (*s >= '0' && *s <= '9') {
		ip = ip * 10 + (*s++ - '0');
	}
	if (*s == '.') {
		s++;
		while (*s >= '0' && *s <= '9') {
			if (scale > 1) {
				scale /= 10;
				frac += (*s - '0') * scale;
			}
			s++;
		}
	}
	if (*s != '\0' || ip > 180) {
		return false;
	}
	*out = (int32_t)((ip * 10000000 + frac) * (neg ? -1 : 1));
	return true;
}

static void fmt_ago(char *buf, size_t size, int64_t since_ms)
{
	int s = (int)((k_uptime_get() - since_ms) / 1000);

	if (s < 60) {
		snprintk(buf, size, "%ds", s);
	} else if (s < 3600) {
		snprintk(buf, size, "%dm", s / 60);
	} else {
		snprintk(buf, size, "%dh", s / 3600);
	}
}

static bool parse_node_id(const char *s, uint32_t *num)
{
	char *end;

	if (*s == '!') {
		s++;
	}
	*num = strtoul(s, &end, 16);
	return *s != '\0' && *end == '\0';
}

/* Join argv[first..] with spaces (shell splits the message into words). */
static bool join_args(char *buf, size_t size, size_t argc, char **argv, size_t first)
{
	size_t len = 0;

	buf[0] = '\0';
	for (size_t i = first; i < argc; i++) {
		size_t n = strlen(argv[i]);

		if (len + n + 2 > size) {
			return false;
		}
		if (len) {
			buf[len++] = ' ';
		}
		memcpy(&buf[len], argv[i], n);
		len += n;
		buf[len] = '\0';
	}
	return len > 0;
}

/* ----------------------------------------------------------------- shell */

static int cmd_id(const struct shell *sh, size_t argc, char **argv)
{
	const struct mesh_identity *me = mesh_identity();

	ARG_UNUSED(argc);
	ARG_UNUSED(argv);
	shell_print(sh, "Node      : !%08x", me->num);
	shell_print(sh, "Name      : %s (%s)", me->long_name, me->short_name);
	shell_print(sh, "Hardware  : PRIVATE_HW, role CLIENT");
	shell_print(sh, "Relay     : %s", mesh_relay_enabled() ? "on" : "off");
	return 0;
}

static int cmd_name(const struct shell *sh, size_t argc, char **argv)
{
	if (strlen(argv[1]) > 39 || (argc > 2 && strlen(argv[2]) > 4)) {
		shell_error(sh, "Long name up to 39 characters, short name up to 4");
		return -EINVAL;
	}
	mesh_set_name(argv[1], argc > 2 ? argv[2] : NULL);
	shell_print(sh, "Name set (not saved across resets). Announcing...");
	return mesh_send_nodeinfo(MESH_BROADCAST, false);
}

static int cmd_announce(const struct shell *sh, size_t argc, char **argv)
{
	ARG_UNUSED(argc);
	ARG_UNUSED(argv);
	shell_print(sh, "Sending NODEINFO and asking neighbours for theirs...");
	return mesh_send_nodeinfo(MESH_BROADCAST, true);
}

static int cmd_send(const struct shell *sh, size_t argc, char **argv)
{
	char text[201];
	uint32_t id;
	int ret;

	if (!join_args(text, sizeof(text), argc, argv, 1)) {
		shell_error(sh, "Message too long (200 characters max)");
		return -EINVAL;
	}
	ret = mesh_send_text(MESH_BROADCAST, text, false, &id);
	if (ret == 0) {
		shell_print(sh, "Queued to everyone on %s (id %08x)", radio_get()->preset->name, id);
	}
	return ret;
}

static int cmd_dm(const struct shell *sh, size_t argc, char **argv)
{
	char text[201];
	uint32_t to, id;
	int ret;

	if (!parse_node_id(argv[1], &to)) {
		shell_error(sh, "Invalid node id: %s (use !a1b2c3d4)", argv[1]);
		return -EINVAL;
	}
	if (!join_args(text, sizeof(text), argc, argv, 2)) {
		shell_error(sh, "Message too long (200 characters max)");
		return -EINVAL;
	}
	ret = mesh_send_text(to, text, true, &id);
	if (ret == 0) {
		shell_print(sh, "Queued to !%08x (id %08x), waiting for ACK...", to, id);
	}
	return ret;
}

static int cmd_pos(const struct shell *sh, size_t argc, char **argv)
{
	int32_t lat, lon, alt = 0;
	char a[16], b[16];

	if (argc == 2 && strcmp(argv[1], "off") == 0) {
		mesh_clear_position();
		shell_print(sh, "Position cleared.");
		return 0;
	}
	if (argc < 3 || !parse_coord(argv[1], &lat) || !parse_coord(argv[2], &lon)) {
		shell_error(sh, "Use: mesh pos <lat> <lon> [alt_m]   e.g. mesh pos -9.6498 -35.7089 10");
		return -EINVAL;
	}
	if (argc > 3) {
		alt = atoi(argv[3]);
	}
	mesh_set_position(lat, lon, alt);
	fmt_coord(a, sizeof(a), lat);
	fmt_coord(b, sizeof(b), lon);
	shell_print(sh, "Position %s, %s, %d m. Sending...", a, b, alt);
	return mesh_send_position(MESH_BROADCAST);
}

static int cmd_nodes(const struct shell *sh, size_t argc, char **argv)
{
	static struct node_entry list[NODEDB_MAX_NODES];
	int n = nodedb_snapshot(list, ARRAY_SIZE(list));
	char ago[8], rssi[8], snr[8], hops[4];

	ARG_UNUSED(argc);
	ARG_UNUSED(argv);

	if (n == 0) {
		shell_print(sh, "No nodes heard yet. Try 'mesh announce'.");
		return 0;
	}

	shell_print(sh, "%-10s %-5s %-24s %4s %5s %4s %5s %5s  %s", "ID", "Short", "Long name",
		    "Hops", "RSSI", "SNR", "Seen", "Pkts", "Hardware");
	for (int i = 0; i < n; i++) {
		const struct node_entry *e = &list[i];

		fmt_ago(ago, sizeof(ago), e->last_heard_ms);
		if (e->hops_away < 0) {
			strcpy(hops, "?");
		} else {
			snprintk(hops, sizeof(hops), "%d", e->hops_away);
		}
		if (e->has_signal) {
			snprintk(rssi, sizeof(rssi), "%d", e->rssi);
			snprintk(snr, sizeof(snr), "%d", e->snr);
		} else {
			strcpy(rssi, "-");
			strcpy(snr, "-");
		}
		shell_print(sh, "!%08x  %-5s %-24.24s %4s %5s %4s %5s %5u  %s", e->num,
			    e->has_user ? e->short_name : "?", e->has_user ? e->long_name : "",
			    hops, rssi, snr, ago, e->packets,
			    e->has_user ? mesh_hw_model_name(e->hw_model) : "");
	}
	shell_print(sh, "%d node(s). RSSI/SNR only for nodes heard directly (0 hops).", n);
	return 0;
}

static int cmd_node(const struct shell *sh, size_t argc, char **argv)
{
	struct node_entry e;
	uint32_t num;
	char ago[8], lat[16], lon[16];

	ARG_UNUSED(argc);
	if (!parse_node_id(argv[1], &num)) {
		shell_error(sh, "Invalid node id: %s (use !a1b2c3d4)", argv[1]);
		return -EINVAL;
	}
	if (!nodedb_get(num, &e)) {
		shell_error(sh, "Node !%08x not heard yet", num);
		return -ENOENT;
	}

	fmt_ago(ago, sizeof(ago), e.last_heard_ms);
	shell_print(sh, "Node      : !%08x", e.num);
	if (e.has_user) {
		shell_print(sh, "Name      : %s (%s)", e.long_name, e.short_name);
		shell_print(sh, "Hardware  : %s", mesh_hw_model_name(e.hw_model));
		shell_print(sh, "Role      : %s", mesh_role_name(e.role));
	} else {
		shell_print(sh, "Name      : unknown (no NODEINFO heard yet)");
	}
	shell_print(sh, "Last heard: %s ago, %u packet(s), last port %s%s", ago, e.packets,
		    mesh_port_name(e.last_port), e.last_decrypted ? "" : " (not decrypted)");
	if (e.hops_away >= 0) {
		shell_print(sh, "Hops away : %d", e.hops_away);
	}
	if (e.has_signal) {
		shell_print(sh, "Signal    : %d dBm, SNR %d dB (direct)", e.rssi, e.snr);
	} else {
		shell_print(sh, "Signal    : only heard through relays (last relay ..%02x)",
			    e.last_relay);
	}
	if (e.has_pos) {
		fmt_coord(lat, sizeof(lat), e.lat_i);
		fmt_coord(lon, sizeof(lon), e.lon_i);
		shell_print(sh, "Position  : %s, %s, %d m", lat, lon, e.alt_m);
	}
	if (e.has_battery) {
		shell_print(sh, "Battery   : %u%%", e.battery_level);
	}
	return 0;
}

static int cmd_radio(const struct shell *sh, size_t argc, char **argv)
{
	const struct radio_state *s = radio_get();
	struct radio_stats rs;
	struct mesh_stats ms;

	ARG_UNUSED(argc);
	ARG_UNUSED(argv);
	radio_get_stats(&rs);
	mesh_get_stats(&ms);

	shell_print(sh, "Region   : %s", s->region->name);
	shell_print(sh, "Preset   : %s (SF%u, BW %u kHz, CR 4/%u)", s->preset->name,
		    s->preset->sf, s->preset->bw_khz, s->preset->cr);
	shell_print(sh, "Frequency: %u.%03u MHz (slot %u of %u)", s->freq_hz / 1000000U,
		    (s->freq_hz / 1000U) % 1000U, s->slot + 1, s->num_slots);
	shell_print(sh, "Channel  : hash 0x%02x, default key", s->channel_hash);
	shell_print(sh, "TX power : %u dBm", s->tx_power_dbm);
	shell_print(sh, "DIO0     : %s (%u by interrupt, %u found by polling)",
		    !rs.dio0_configured ? "not configured"
		    : rs.dio0_hits ? "working" : "no edge seen yet",
		    rs.dio0_hits, rs.dio0_misses);
	shell_print(sh, "Radio    : %u RX, %u CRC errors, %u TX (%u ms on air)", rs.rx_frames,
		    rs.crc_errors, rs.tx_frames, rs.tx_airtime_ms);
	shell_print(sh, "Mesh     : %u new, %u decrypted, %u other channel, %u duplicates",
		    ms.received, ms.decrypted, ms.other_channel, ms.duplicates);
	shell_print(sh, "Routing  : %u sent, %u relayed, %u relays cancelled", ms.sent,
		    ms.relayed, ms.relays_cancelled);
	return 0;
}

static int cmd_region(const struct shell *sh, size_t argc, char **argv)
{
	const struct mesh_region *r = radio_find_region(argv[1]);

	ARG_UNUSED(argc);
	if (r == NULL) {
		shell_error(sh, "Unknown region. Options:");
		for (size_t i = 0; i < mesh_region_count; i++) {
			shell_print(sh, "  %s", mesh_regions[i].name);
		}
		return -EINVAL;
	}
	return radio_set(r, radio_get()->preset);
}

static int cmd_preset(const struct shell *sh, size_t argc, char **argv)
{
	const struct mesh_preset *p = radio_find_preset(argv[1]);

	ARG_UNUSED(argc);
	if (p == NULL) {
		shell_error(sh, "Unknown preset. Options:");
		for (size_t i = 0; i < mesh_preset_count; i++) {
			shell_print(sh, "  %s", mesh_presets[i].name);
		}
		return -EINVAL;
	}
	return radio_set(radio_get()->region, p);
}

static int cmd_txpower(const struct shell *sh, size_t argc, char **argv)
{
	int dbm = atoi(argv[1]);

	ARG_UNUSED(argc);
	if (radio_set_tx_power((uint8_t)CLAMP(dbm, 0, 255)) < 0) {
		shell_error(sh, "Use 2..17 dBm");
		return -EINVAL;
	}
	shell_print(sh, "TX power %d dBm", dbm);
	return 0;
}

static int on_off(const struct shell *sh, const char *arg, bool *out)
{
	if (strcmp(arg, "on") == 0) {
		*out = true;
	} else if (strcmp(arg, "off") == 0) {
		*out = false;
	} else {
		shell_error(sh, "Use on or off");
		return -EINVAL;
	}
	return 0;
}

static int cmd_relay(const struct shell *sh, size_t argc, char **argv)
{
	bool on;

	ARG_UNUSED(argc);
	if (on_off(sh, argv[1], &on) == 0) {
		mesh_set_relay(on);
		return 0;
	}
	return -EINVAL;
}

static int cmd_live(const struct shell *sh, size_t argc, char **argv)
{
	bool on;

	ARG_UNUSED(argc);
	if (on_off(sh, argv[1], &on) == 0) {
		mesh_set_live(on);
		return 0;
	}
	return -EINVAL;
}

static void diag_line(const struct shell *sh, const char *name, uint32_t got, uint32_t want,
		      int width)
{
	shell_print(sh, "  %-14s 0x%0*x  (expected 0x%0*x)  %s", name, width, got, width, want,
		    got == want ? "OK" : "<-- MISMATCH");
}

static int cmd_diag(const struct shell *sh, size_t argc, char **argv)
{
	struct radio_diag d, want;
	int seconds = argc > 1 ? atoi(argv[1]) : 10;

	if (radio_read_diag(&d) < 0) {
		shell_error(sh, "SPI error while reading the radio");
		return -EIO;
	}
	radio_expected_diag(&want);

	shell_print(sh, "SX1276 registers (version 0x%02x):", d.version);
	diag_line(sh, "OpMode", d.op_mode, want.op_mode, 2);
	diag_line(sh, "Frequency", d.frf, want.frf, 6);
	diag_line(sh, "ModemConfig1", d.modem_config_1, want.modem_config_1, 2);
	diag_line(sh, "ModemConfig2", d.modem_config_2, want.modem_config_2, 2);
	diag_line(sh, "ModemConfig3", d.modem_config_3, want.modem_config_3, 2);
	diag_line(sh, "SyncWord", d.sync_word, want.sync_word, 2);
	diag_line(sh, "Preamble", d.preamble, want.preamble, 4);
	diag_line(sh, "PaConfig", d.pa_config, want.pa_config, 2);

	shell_print(sh, "Channel RSSI for %d s:", seconds);
	for (int i = 0; i < seconds; i++) {
		if (radio_read_diag(&d) == 0) {
			shell_print(sh, "  %2d s: %4d dBm%s", i + 1, d.rssi_now,
				    (d.modem_stat & 0x01) ? "  (LoRa signal detected)" : "");
		}
		k_sleep(K_SECONDS(1));
	}
	return 0;
}

static int cmd_clear(const struct shell *sh, size_t argc, char **argv)
{
	ARG_UNUSED(argc);
	ARG_UNUSED(argv);
	nodedb_clear();
	shell_print(sh, "Node table cleared.");
	return 0;
}

SHELL_STATIC_SUBCMD_SET_CREATE(mesh_cmds,
	SHELL_CMD(id, NULL, "This node's ID and name", cmd_id),
	SHELL_CMD_ARG(name, NULL, "Set name: mesh name <long> [short]", cmd_name, 2, 1),
	SHELL_CMD(announce, NULL, "Send NODEINFO and ask neighbours for theirs", cmd_announce),
	SHELL_CMD_ARG(send, NULL, "Message to everyone: mesh send <text>", cmd_send, 2, 30),
	SHELL_CMD_ARG(dm, NULL, "Direct message with ACK: mesh dm !id <text>", cmd_dm, 3, 30),
	SHELL_CMD_ARG(pos, NULL, "Fixed position: mesh pos <lat> <lon> [alt] | off", cmd_pos, 2, 2),
	SHELL_CMD(nodes, NULL, "List the nodes heard", cmd_nodes),
	SHELL_CMD_ARG(node, NULL, "Details of one node: mesh node !a1b2c3d4", cmd_node, 2, 0),
	SHELL_CMD(radio, NULL, "Radio settings and counters", cmd_radio),
	SHELL_CMD_ARG(region, NULL, "Set region: US | ANZ | BR_902", cmd_region, 2, 0),
	SHELL_CMD_ARG(preset, NULL, "Set modem preset: LongFast, MediumFast, ...", cmd_preset, 2, 0),
	SHELL_CMD_ARG(txpower, NULL, "TX power in dBm: mesh txpower 2..17", cmd_txpower, 2, 0),
	SHELL_CMD_ARG(relay, NULL, "Relay other nodes' packets: mesh relay on|off", cmd_relay, 2, 0),
	SHELL_CMD_ARG(live, NULL, "Print each packet: mesh live on|off", cmd_live, 2, 0),
	SHELL_CMD_ARG(diag, NULL, "Check radio registers and RSSI: mesh diag [s]", cmd_diag, 1, 1),
	SHELL_CMD(clear, NULL, "Clear the node table", cmd_clear),
	SHELL_SUBCMD_SET_END);

SHELL_CMD_REGISTER(mesh, &mesh_cmds, "Meshtastic node", NULL);

/* ------------------------------------------------------------------ main */

int main(void)
{
	int ret = radio_init(radio_find_region(DEFAULT_REGION), radio_find_preset(DEFAULT_PRESET));

	if (ret < 0) {
		LOG_ERR("Radio init failed (%d). Check the SPI wiring.", ret);
		return 0;
	}

	mesh_start();
	ui_start();
	k_work_schedule(&nodeinfo_work, K_SECONDS(15));
	k_work_schedule(&position_work, K_SECONDS(20));

	LOG_INF("Meshtastic node ready. Type 'mesh help'. Antenna must be connected!");
	return 0;
}
```

## src/aes128.c
```c
/**
 * @file aes128.c
 * @brief Minimal AES-128 (FIPS-197), encrypt direction only, plus CTR mode.
 * @copyright Copyright (c) 2026 Centro de Inovacao EDGE
 * SPDX-License-Identifier: Apache-2.0
 */
#include <string.h>

#include "aes128.h"

static const uint8_t sbox[256] = {
	0x63, 0x7c, 0x77, 0x7b, 0xf2, 0x6b, 0x6f, 0xc5, 0x30, 0x01, 0x67, 0x2b, 0xfe, 0xd7, 0xab, 0x76,
	0xca, 0x82, 0xc9, 0x7d, 0xfa, 0x59, 0x47, 0xf0, 0xad, 0xd4, 0xa2, 0xaf, 0x9c, 0xa4, 0x72, 0xc0,
	0xb7, 0xfd, 0x93, 0x26, 0x36, 0x3f, 0xf7, 0xcc, 0x34, 0xa5, 0xe5, 0xf1, 0x71, 0xd8, 0x31, 0x15,
	0x04, 0xc7, 0x23, 0xc3, 0x18, 0x96, 0x05, 0x9a, 0x07, 0x12, 0x80, 0xe2, 0xeb, 0x27, 0xb2, 0x75,
	0x09, 0x83, 0x2c, 0x1a, 0x1b, 0x6e, 0x5a, 0xa0, 0x52, 0x3b, 0xd6, 0xb3, 0x29, 0xe3, 0x2f, 0x84,
	0x53, 0xd1, 0x00, 0xed, 0x20, 0xfc, 0xb1, 0x5b, 0x6a, 0xcb, 0xbe, 0x39, 0x4a, 0x4c, 0x58, 0xcf,
	0xd0, 0xef, 0xaa, 0xfb, 0x43, 0x4d, 0x33, 0x85, 0x45, 0xf9, 0x02, 0x7f, 0x50, 0x3c, 0x9f, 0xa8,
	0x51, 0xa3, 0x40, 0x8f, 0x92, 0x9d, 0x38, 0xf5, 0xbc, 0xb6, 0xda, 0x21, 0x10, 0xff, 0xf3, 0xd2,
	0xcd, 0x0c, 0x13, 0xec, 0x5f, 0x97, 0x44, 0x17, 0xc4, 0xa7, 0x7e, 0x3d, 0x64, 0x5d, 0x19, 0x73,
	0x60, 0x81, 0x4f, 0xdc, 0x22, 0x2a, 0x90, 0x88, 0x46, 0xee, 0xb8, 0x14, 0xde, 0x5e, 0x0b, 0xdb,
	0xe0, 0x32, 0x3a, 0x0a, 0x49, 0x06, 0x24, 0x5c, 0xc2, 0xd3, 0xac, 0x62, 0x91, 0x95, 0xe4, 0x79,
	0xe7, 0xc8, 0x37, 0x6d, 0x8d, 0xd5, 0x4e, 0xa9, 0x6c, 0x56, 0xf4, 0xea, 0x65, 0x7a, 0xae, 0x08,
	0xba, 0x78, 0x25, 0x2e, 0x1c, 0xa6, 0xb4, 0xc6, 0xe8, 0xdd, 0x74, 0x1f, 0x4b, 0xbd, 0x8b, 0x8a,
	0x70, 0x3e, 0xb5, 0x66, 0x48, 0x03, 0xf6, 0x0e, 0x61, 0x35, 0x57, 0xb9, 0x86, 0xc1, 0x1d, 0x9e,
	0xe1, 0xf8, 0x98, 0x11, 0x69, 0xd9, 0x8e, 0x94, 0x9b, 0x1e, 0x87, 0xe9, 0xce, 0x55, 0x28, 0xdf,
	0x8c, 0xa1, 0x89, 0x0d, 0xbf, 0xe6, 0x42, 0x68, 0x41, 0x99, 0x2d, 0x0f, 0xb0, 0x54, 0xbb, 0x16,
};

static const uint8_t rcon[10] = {0x01, 0x02, 0x04, 0x08, 0x10, 0x20, 0x40, 0x80, 0x1b, 0x36};

static uint8_t xtime(uint8_t x)
{
	return (uint8_t)((x << 1) ^ ((x & 0x80) ? 0x1b : 0x00));
}

void aes128_init(struct aes128_ctx *ctx, const uint8_t key[16])
{
	uint8_t *rk = ctx->round_key;

	memcpy(rk, key, 16);
	for (int i = 4; i < 44; i++) {
		uint8_t t[4];

		memcpy(t, &rk[(i - 1) * 4], 4);
		if (i % 4 == 0) {
			uint8_t first = t[0];

			t[0] = sbox[t[1]] ^ rcon[i / 4 - 1];
			t[1] = sbox[t[2]];
			t[2] = sbox[t[3]];
			t[3] = sbox[first];
		}
		for (int j = 0; j < 4; j++) {
			rk[i * 4 + j] = rk[(i - 4) * 4 + j] ^ t[j];
		}
	}
}

static void add_round_key(uint8_t s[16], const uint8_t *rk)
{
	for (int i = 0; i < 16; i++) {
		s[i] ^= rk[i];
	}
}

static void sub_bytes_shift_rows(uint8_t s[16])
{
	uint8_t t[16];

	/* State is column-major: s[col * 4 + row]. Row r shifts left by r. */
	for (int c = 0; c < 4; c++) {
		for (int r = 0; r < 4; r++) {
			t[c * 4 + r] = sbox[s[((c + r) % 4) * 4 + r]];
		}
	}
	memcpy(s, t, 16);
}

static void mix_columns(uint8_t s[16])
{
	for (int c = 0; c < 4; c++) {
		uint8_t *col = &s[c * 4];
		uint8_t a0 = col[0], a1 = col[1], a2 = col[2], a3 = col[3];
		uint8_t all = a0 ^ a1 ^ a2 ^ a3;

		col[0] ^= all ^ xtime(a0 ^ a1);
		col[1] ^= all ^ xtime(a1 ^ a2);
		col[2] ^= all ^ xtime(a2 ^ a3);
		col[3] ^= all ^ xtime(a3 ^ a0);
	}
}

void aes128_encrypt_block(const struct aes128_ctx *ctx, const uint8_t in[16], uint8_t out[16])
{
	uint8_t s[16];

	memcpy(s, in, 16);
	add_round_key(s, &ctx->round_key[0]);
	for (int round = 1; round < 10; round++) {
		sub_bytes_shift_rows(s);
		mix_columns(s);
		add_round_key(s, &ctx->round_key[round * 16]);
	}
	sub_bytes_shift_rows(s);
	add_round_key(s, &ctx->round_key[160]);
	memcpy(out, s, 16);
}

void aes128_ctr_xcrypt(const struct aes128_ctx *ctx, const uint8_t iv[16], uint8_t *buf, size_t len)
{
	uint8_t counter[16];
	uint8_t keystream[16];

	memcpy(counter, iv, 16);
	for (size_t off = 0; off < len; off += 16) {
		aes128_encrypt_block(ctx, counter, keystream);
		for (size_t i = 0; i < 16 && off + i < len; i++) {
			buf[off + i] ^= keystream[i];
		}
		/* Increment the last 4 bytes as a big-endian counter. */
		for (int i = 15; i >= 12; i--) {
			if (++counter[i] != 0) {
				break;
			}
		}
	}
}
```

## src/buzzer.c
```c
/**
 * @file buzzer.c
 * @brief Notification sounds on the ZBook piezo buzzer.
 * @copyright Copyright (c) 2026 Centro de Inovacao EDGE
 * SPDX-License-Identifier: Apache-2.0
 *
 * A second observer of mesh_event_chan, independent of the UI: it plays a
 * short tune whenever a text message arrives (a different one for direct
 * messages). The buzzer is the board's "pwm-buzzer" (GPIO32, PWM slice 8),
 * driven with a 50 % duty cycle at the note frequency.
 */
#include <zephyr/drivers/pwm.h>
#include <zephyr/kernel.h>
#include <zephyr/logging/log.h>

#include "buzzer.h"
#include "events.h"
#include "meshtastic.h"

LOG_MODULE_REGISTER(buzzer, LOG_LEVEL_INF);

struct note {
	uint16_t hz;  /* 0 = silence */
	uint16_t ms;
};

/* Channel message: two quick notes. */
static const struct note tune_channel[] = {
	{1760, 70}, {0, 50}, {2349, 110},
};

/* Direct message: three rising notes, easier to tell apart. */
static const struct note tune_direct[] = {
	{1568, 70}, {0, 30}, {2093, 70}, {0, 30}, {2637, 140},
};

static const struct pwm_dt_spec buzzer = PWM_DT_SPEC_GET(DT_ALIAS(pwm_buzzer));
static bool enabled = true;

static void play(const struct note *tune, size_t len)
{
	for (size_t i = 0; i < len; i++) {
		if (tune[i].hz == 0) {
			pwm_set_pulse_dt(&buzzer, 0);
		} else {
			uint32_t period = PWM_HZ(tune[i].hz);

			pwm_set_dt(&buzzer, period, period / 2);
		}
		k_msleep(tune[i].ms);
	}
	pwm_set_pulse_dt(&buzzer, 0);
}

void buzzer_set_enabled(bool on)
{
	enabled = on;
}

bool buzzer_enabled(void)
{
	return enabled;
}

ZBUS_MSG_SUBSCRIBER_DEFINE(buzzer_sub);
ZBUS_CHAN_ADD_OBS(mesh_event_chan, buzzer_sub, 4);

static void buzzer_thread(void *a, void *b, void *c)
{
	const struct zbus_channel *chan;
	struct mesh_event ev;

	ARG_UNUSED(a);
	ARG_UNUSED(b);
	ARG_UNUSED(c);

	if (!pwm_is_ready_dt(&buzzer)) {
		LOG_ERR("Buzzer PWM not ready");
		return;
	}
	pwm_set_pulse_dt(&buzzer, 0);

	while (zbus_sub_wait_msg(&buzzer_sub, &chan, &ev, K_FOREVER) == 0) {
		if (!enabled || ev.type != MESH_EV_TEXT) {
			continue;
		}
		if (ev.to == MESH_BROADCAST) {
			play(tune_channel, ARRAY_SIZE(tune_channel));
		} else {
			play(tune_direct, ARRAY_SIZE(tune_direct));
		}
	}
}

K_THREAD_DEFINE(buzzer_tid, 1536, buzzer_thread, NULL, NULL, NULL, 12, 0, 0);
```

## src/buzzer.h
```c
/**
 * @file buzzer.h
 * @brief Notification sounds on the ZBook piezo buzzer.
 * @copyright Copyright (c) 2026 Centro de Inovacao EDGE
 * SPDX-License-Identifier: Apache-2.0
 */
#ifndef BUZZER_H_
#define BUZZER_H_

#include <stdbool.h>

void buzzer_set_enabled(bool on);
bool buzzer_enabled(void);

#endif /* BUZZER_H_ */
```

## src/events.c
```c
/**
 * @file events.c
 * @brief zbus channel definitions (observers are added where they live).
 * @copyright Copyright (c) 2026 Centro de Inovacao EDGE
 * SPDX-License-Identifier: Apache-2.0
 */
#include "events.h"

ZBUS_CHAN_DEFINE(ui_input_chan, struct ui_input, NULL, NULL, ZBUS_OBSERVERS_EMPTY,
		 ZBUS_MSG_INIT(0));

ZBUS_CHAN_DEFINE(mesh_event_chan, struct mesh_event, NULL, NULL, ZBUS_OBSERVERS_EMPTY,
		 ZBUS_MSG_INIT(0));
```

## src/events.h
```c
/**
 * @file events.h
 * @brief zbus channels between the input devices, the mesh and the UI.
 * @copyright Copyright (c) 2026 Centro de Inovacao EDGE
 * SPDX-License-Identifier: Apache-2.0
 *
 *   input.c --ui_input_chan-->  ui.c   (buttons and rotary encoder)
 *   mesh.c  --mesh_event_chan-> ui.c   (messages, nodes, ACKs, sends)
 *
 * Both channels are observed by a message subscriber in ui.c, so the UI
 * receives every event in order, even while it is busy refreshing the OLED.
 */
#ifndef EVENTS_H_
#define EVENTS_H_

#include <stdbool.h>
#include <stdint.h>

#include <zephyr/zbus/zbus.h>

/** The four board buttons (BTN0..BTN3) plus the encoder push button. */
enum ui_key {
	UI_KEY_BACK,    /* BTN0 */
	UI_KEY_OK,      /* BTN1 or encoder press */
	UI_KEY_ACTION,  /* BTN2: context action of the screen */
	UI_KEY_HOME,    /* BTN3 */
};

struct ui_input {
	bool rotate;    /* true: encoder turned by `delta` detents */
	int8_t delta;
	uint8_t key;    /* enum ui_key, when !rotate */
};

enum mesh_event_type {
	MESH_EV_TEXT,   /* text message for us or for everyone */
	MESH_EV_NODE,   /* node added or updated in the node table */
	MESH_EV_ACK,    /* ACK/NAK for one of our direct messages */
	MESH_EV_SENT,   /* one of our packets went out on the air */
};

#define MESH_EV_TEXT_MAX 200

struct mesh_event {
	uint8_t type;   /* enum mesh_event_type */
	bool ok;        /* MESH_EV_ACK: delivered */
	int8_t snr;
	int16_t rssi;
	uint32_t from;
	uint32_t to;
	uint32_t id;
	char text[MESH_EV_TEXT_MAX + 1];
};

ZBUS_CHAN_DECLARE(ui_input_chan, mesh_event_chan);

#endif /* EVENTS_H_ */
```

## src/font5x8.c
```c
/**
 * @file font5x8.c
 * @brief 5x8 bitmap font, ASCII 0x20-0x7E and Latin-1 0xA0-0xFF.
 *
 * Glyphs converted from the X11 misc-fixed 5x8 font ("Public domain font.
 * Share and enjoy."). Each glyph is 5 column bytes, bit 0 = top row, which
 * matches the SSD1306 vertical-tiled framebuffer layout.
 */
#include <stdint.h>

#include "font5x8.h"

const uint8_t font5x8_ascii[95][5] = {
	{0x00, 0x00, 0x00, 0x00, 0x00}, /* U+0020   */
	{0x00, 0x00, 0x5e, 0x00, 0x00}, /* U+0021 ! */
	{0x00, 0x0e, 0x00, 0x0e, 0x00}, /* U+0022 " */
	{0x14, 0x7f, 0x14, 0x7f, 0x14}, /* U+0023 # */
	{0x04, 0x2a, 0x7f, 0x2a, 0x10}, /* U+0024 $ */
	{0x00, 0x16, 0x08, 0x34, 0x00}, /* U+0025 % */
	{0x36, 0x49, 0x36, 0x40, 0x00}, /* U+0026 & */
	{0x00, 0x00, 0x0e, 0x00, 0x00}, /* U+0027 ' */
	{0x00, 0x3c, 0x42, 0x00, 0x00}, /* U+0028 ( */
	{0x00, 0x42, 0x3c, 0x00, 0x00}, /* U+0029 ) */
	{0x54, 0x38, 0x38, 0x54, 0x00}, /* U+002A asterisk */
	{0x10, 0x10, 0x7c, 0x10, 0x10}, /* U+002B + */
	{0x00, 0x80, 0x60, 0x20, 0x00}, /* U+002C , */
	{0x10, 0x10, 0x10, 0x10, 0x00}, /* U+002D - */
	{0x00, 0x40, 0xe0, 0x40, 0x00}, /* U+002E . */
	{0x60, 0x10, 0x08, 0x06, 0x00}, /* U+002F slash */
	{0x00, 0x3c, 0x42, 0x3c, 0x00}, /* U+0030 0 */
	{0x00, 0x44, 0x7e, 0x40, 0x00}, /* U+0031 1 */
	{0x64, 0x52, 0x52, 0x4c, 0x00}, /* U+0032 2 */
	{0x22, 0x4a, 0x4e, 0x32, 0x00}, /* U+0033 3 */
	{0x18, 0x14, 0x7e, 0x10, 0x00}, /* U+0034 4 */
	{0x2e, 0x4a, 0x4a, 0x32, 0x00}, /* U+0035 5 */
	{0x3c, 0x4a, 0x4a, 0x30, 0x00}, /* U+0036 6 */
	{0x02, 0x62, 0x1a, 0x06, 0x00}, /* U+0037 7 */
	{0x34, 0x4a, 0x4a, 0x34, 0x00}, /* U+0038 8 */
	{0x0c, 0x52, 0x52, 0x3c, 0x00}, /* U+0039 9 */
	{0x00, 0x6c, 0x6c, 0x00, 0x00}, /* U+003A : */
	{0x00, 0x80, 0x6c, 0x2c, 0x00}, /* U+003B ; */
	{0x00, 0x18, 0x24, 0x42, 0x00}, /* U+003C < */
	{0x28, 0x28, 0x28, 0x28, 0x00}, /* U+003D = */
	{0x00, 0x42, 0x24, 0x18, 0x00}, /* U+003E > */
	{0x00, 0x04, 0x52, 0x0c, 0x00}, /* U+003F ? */
	{0x3c, 0x42, 0x99, 0xa5, 0x1e}, /* U+0040 @ */
	{0x7c, 0x12, 0x12, 0x7c, 0x00}, /* U+0041 A */
	{0x7e, 0x4a, 0x4a, 0x34, 0x00}, /* U+0042 B */
	{0x3c, 0x42, 0x42, 0x24, 0x00}, /* U+0043 C */
	{0x7e, 0x42, 0x42, 0x3c, 0x00}, /* U+0044 D */
	{0x7e, 0x4a, 0x4a, 0x42, 0x00}, /* U+0045 E */
	{0x7e, 0x0a, 0x0a, 0x02, 0x00}, /* U+0046 F */
	{0x3c, 0x42, 0x52, 0x34, 0x00}, /* U+0047 G */
	{0x7e, 0x08, 0x08, 0x7e, 0x00}, /* U+0048 H */
	{0x00, 0x42, 0x7e, 0x42, 0x00}, /* U+0049 I */
	{0x20, 0x42, 0x3e, 0x02, 0x00}, /* U+004A J */
	{0x7e, 0x08, 0x34, 0x42, 0x00}, /* U+004B K */
	{0x7e, 0x40, 0x40, 0x40, 0x00}, /* U+004C L */
	{0x7e, 0x0c, 0x0c, 0x7e, 0x00}, /* U+004D M */
	{0x7e, 0x0c, 0x38, 0x7e, 0x00}, /* U+004E N */
	{0x3c, 0x42, 0x42, 0x3c, 0x00}, /* U+004F O */
	{0x7e, 0x12, 0x12, 0x0c, 0x00}, /* U+0050 P */
	{0x3c, 0x52, 0x62, 0xbc, 0x00}, /* U+0051 Q */
	{0x7e, 0x12, 0x12, 0x6c, 0x00}, /* U+0052 R */
	{0x24, 0x4a, 0x52, 0x24, 0x00}, /* U+0053 S */
	{0x00, 0x02, 0x7e, 0x02, 0x00}, /* U+0054 T */
	{0x3e, 0x40, 0x40, 0x3e, 0x00}, /* U+0055 U */
	{0x1e, 0x60, 0x60, 0x1e, 0x00}, /* U+0056 V */
	{0x7e, 0x30, 0x30, 0x7e, 0x00}, /* U+0057 W */
	{0x66, 0x18, 0x18, 0x66, 0x00}, /* U+0058 X */
	{0x06, 0x08, 0x70, 0x08, 0x06}, /* U+0059 Y */
	{0x62, 0x52, 0x4a, 0x46, 0x00}, /* U+005A Z */
	{0x00, 0x7e, 0x42, 0x42, 0x00}, /* U+005B [ */
	{0x06, 0x08, 0x10, 0x60, 0x00}, /* U+005C backslash */
	{0x00, 0x42, 0x42, 0x7e, 0x00}, /* U+005D ] */
	{0x00, 0x04, 0x02, 0x04, 0x00}, /* U+005E ^ */
	{0x80, 0x80, 0x80, 0x80, 0x00}, /* U+005F _ */
	{0x00, 0x02, 0x04, 0x00, 0x00}, /* U+0060 ` */
	{0x30, 0x48, 0x48, 0x78, 0x00}, /* U+0061 a */
	{0x7e, 0x48, 0x48, 0x30, 0x00}, /* U+0062 b */
	{0x00, 0x30, 0x48, 0x48, 0x00}, /* U+0063 c */
	{0x30, 0x48, 0x48, 0x7e, 0x00}, /* U+0064 d */
	{0x30, 0x68, 0x58, 0x10, 0x00}, /* U+0065 e */
	{0x10, 0x7c, 0x12, 0x04, 0x00}, /* U+0066 f */
	{0x10, 0xa8, 0xa8, 0x70, 0x00}, /* U+0067 g */
	{0x7e, 0x08, 0x08, 0x70, 0x00}, /* U+0068 h */
	{0x00, 0x48, 0x7a, 0x40, 0x00}, /* U+0069 i */
	{0x00, 0x40, 0x80, 0x7a, 0x00}, /* U+006A j */
	{0x7e, 0x10, 0x10, 0x68, 0x00}, /* U+006B k */
	{0x00, 0x42, 0x7e, 0x40, 0x00}, /* U+006C l */
	{0x78, 0x08, 0x70, 0x08, 0x70}, /* U+006D m */
	{0x78, 0x08, 0x08, 0x70, 0x00}, /* U+006E n */
	{0x30, 0x48, 0x48, 0x30, 0x00}, /* U+006F o */
	{0xf8, 0x28, 0x28, 0x10, 0x00}, /* U+0070 p */
	{0x10, 0x28, 0x28, 0xf8, 0x00}, /* U+0071 q */
	{0x78, 0x10, 0x08, 0x10, 0x00}, /* U+0072 r */
	{0x00, 0x50, 0x58, 0x28, 0x00}, /* U+0073 s */
	{0x08, 0x3e, 0x48, 0x20, 0x00}, /* U+0074 t */
	{0x38, 0x40, 0x40, 0x78, 0x00}, /* U+0075 u */
	{0x00, 0x38, 0x40, 0x38, 0x00}, /* U+0076 v */
	{0x38, 0x40, 0x30, 0x40, 0x38}, /* U+0077 w */
	{0x48, 0x30, 0x30, 0x48, 0x00}, /* U+0078 x */
	{0x58, 0xa0, 0xa0, 0x78, 0x00}, /* U+0079 y */
	{0x48, 0x68, 0x58, 0x48, 0x00}, /* U+007A z */
	{0x08, 0x2a, 0x55, 0x41, 0x00}, /* U+007B { */
	{0x00, 0x00, 0x7e, 0x00, 0x00}, /* U+007C | */
	{0x41, 0x55, 0x2a, 0x08, 0x00}, /* U+007D } */
	{0x04, 0x02, 0x04, 0x02, 0x00}, /* U+007E ~ */
};

const uint8_t font5x8_latin1[96][5] = {
	{0x00, 0x00, 0x00, 0x00, 0x00}, /* U+00A0   */
	{0x00, 0x00, 0x7a, 0x00, 0x00}, /* U+00A1 ¡ */
	{0x30, 0x48, 0xfc, 0x48, 0x00}, /* U+00A2 ¢ */
	{0x48, 0x3c, 0x4a, 0x24, 0x00}, /* U+00A3 £ */
	{0x44, 0x38, 0x28, 0x38, 0x44}, /* U+00A4 ¤ */
	{0x2a, 0x2c, 0x78, 0x2c, 0x2a}, /* U+00A5 ¥ */
	{0x00, 0x00, 0x77, 0x00, 0x00}, /* U+00A6 ¦ */
	{0x4e, 0x55, 0x55, 0x39, 0x00}, /* U+00A7 § */
	{0x00, 0x02, 0x00, 0x02, 0x00}, /* U+00A8 ¨ */
	{0x3c, 0x5a, 0x66, 0x42, 0x3c}, /* U+00A9 © */
	{0x00, 0x12, 0x15, 0x17, 0x00}, /* U+00AA ª */
	{0x10, 0x28, 0x10, 0x28, 0x00}, /* U+00AB « */
	{0x00, 0x10, 0x10, 0x70, 0x00}, /* U+00AC ¬ */
	{0x00, 0x10, 0x10, 0x10, 0x00}, /* U+00AD ­ */
	{0x3c, 0x7e, 0x56, 0x6a, 0x3c}, /* U+00AE ® */
	{0x00, 0x02, 0x02, 0x02, 0x00}, /* U+00AF ¯ */
	{0x00, 0x04, 0x0a, 0x04, 0x00}, /* U+00B0 ° */
	{0x00, 0x48, 0x5c, 0x48, 0x00}, /* U+00B1 ± */
	{0x00, 0x12, 0x19, 0x16, 0x00}, /* U+00B2 ² */
	{0x00, 0x15, 0x15, 0x0a, 0x00}, /* U+00B3 ³ */
	{0x00, 0x04, 0x02, 0x00, 0x00}, /* U+00B4 ´ */
	{0xf8, 0x40, 0x40, 0x38, 0x00}, /* U+00B5 µ */
	{0x0c, 0x1e, 0x7e, 0x02, 0x7e}, /* U+00B6 ¶ */
	{0x00, 0x00, 0x10, 0x00, 0x00}, /* U+00B7 · */
	{0x00, 0x80, 0x40, 0x00, 0x00}, /* U+00B8 ¸ */
	{0x00, 0x12, 0x1f, 0x10, 0x00}, /* U+00B9 ¹ */
	{0x00, 0x12, 0x15, 0x12, 0x00}, /* U+00BA º */
	{0x28, 0x10, 0x28, 0x10, 0x00}, /* U+00BB » */
	{0x2f, 0x30, 0x78, 0x20, 0x00}, /* U+00BC ¼ */
	{0x0f, 0x48, 0x64, 0x58, 0x00}, /* U+00BD ½ */
	{0x35, 0x2a, 0x78, 0x20, 0x00}, /* U+00BE ¾ */
	{0x00, 0x30, 0x4a, 0x20, 0x00}, /* U+00BF ¿ */
	{0x78, 0x15, 0x16, 0x78, 0x00}, /* U+00C0 À */
	{0x78, 0x16, 0x15, 0x78, 0x00}, /* U+00C1 Á */
	{0x7a, 0x15, 0x15, 0x7a, 0x00}, /* U+00C2 Â */
	{0x7a, 0x15, 0x16, 0x79, 0x00}, /* U+00C3 Ã */
	{0x79, 0x14, 0x14, 0x79, 0x00}, /* U+00C4 Ä */
	{0x7a, 0x15, 0x15, 0x7a, 0x00}, /* U+00C5 Å */
	{0x7c, 0x12, 0x7e, 0x52, 0x00}, /* U+00C6 Æ */
	{0x3c, 0xc2, 0x42, 0x24, 0x00}, /* U+00C7 Ç */
	{0x7c, 0x55, 0x56, 0x44, 0x00}, /* U+00C8 È */
	{0x7c, 0x56, 0x55, 0x44, 0x00}, /* U+00C9 É */
	{0x7e, 0x55, 0x55, 0x46, 0x00}, /* U+00CA Ê */
	{0x7d, 0x54, 0x54, 0x45, 0x00}, /* U+00CB Ë */
	{0x00, 0x45, 0x7e, 0x44, 0x00}, /* U+00CC Ì */
	{0x00, 0x44, 0x7e, 0x45, 0x00}, /* U+00CD Í */
	{0x00, 0x46, 0x7d, 0x46, 0x00}, /* U+00CE Î */
	{0x00, 0x45, 0x7c, 0x45, 0x00}, /* U+00CF Ï */
	{0x08, 0x7e, 0x4a, 0x42, 0x3c}, /* U+00D0 Ð */
	{0x7e, 0x09, 0x12, 0x7d, 0x00}, /* U+00D1 Ñ */
	{0x38, 0x45, 0x46, 0x38, 0x00}, /* U+00D2 Ò */
	{0x38, 0x46, 0x45, 0x38, 0x00}, /* U+00D3 Ó */
	{0x3a, 0x45, 0x45, 0x3a, 0x00}, /* U+00D4 Ô */
	{0x3a, 0x45, 0x46, 0x39, 0x00}, /* U+00D5 Õ */
	{0x39, 0x44, 0x44, 0x39, 0x00}, /* U+00D6 Ö */
	{0x00, 0x50, 0x20, 0x50, 0x00}, /* U+00D7 × */
	{0x7c, 0x72, 0x4e, 0x3e, 0x00}, /* U+00D8 Ø */
	{0x3c, 0x41, 0x42, 0x3c, 0x00}, /* U+00D9 Ù */
	{0x3c, 0x42, 0x41, 0x3c, 0x00}, /* U+00DA Ú */
	{0x3e, 0x41, 0x41, 0x3e, 0x00}, /* U+00DB Û */
	{0x3d, 0x40, 0x40, 0x3d, 0x00}, /* U+00DC Ü */
	{0x04, 0x08, 0x72, 0x09, 0x04}, /* U+00DD Ý */
	{0x7e, 0x24, 0x24, 0x18, 0x00}, /* U+00DE Þ */
	{0x7c, 0x02, 0x5a, 0x24, 0x00}, /* U+00DF ß */
	{0x30, 0x49, 0x4a, 0x78, 0x00}, /* U+00E0 à */
	{0x30, 0x4a, 0x49, 0x78, 0x00}, /* U+00E1 á */
	{0x30, 0x4a, 0x49, 0x7a, 0x00}, /* U+00E2 â */
	{0x32, 0x49, 0x4a, 0x79, 0x00}, /* U+00E3 ã */
	{0x30, 0x4a, 0x48, 0x7a, 0x00}, /* U+00E4 ä */
	{0x32, 0x4d, 0x4d, 0x7a, 0x00}, /* U+00E5 å */
	{0x28, 0x58, 0x78, 0x68, 0x50}, /* U+00E6 æ */
	{0x00, 0x30, 0xc8, 0x48, 0x00}, /* U+00E7 ç */
	{0x30, 0x69, 0x5a, 0x10, 0x00}, /* U+00E8 è */
	{0x30, 0x6a, 0x59, 0x10, 0x00}, /* U+00E9 é */
	{0x32, 0x69, 0x59, 0x12, 0x00}, /* U+00EA ê */
	{0x30, 0x6a, 0x58, 0x12, 0x00}, /* U+00EB ë */
	{0x00, 0x49, 0x7a, 0x40, 0x00}, /* U+00EC ì */
	{0x00, 0x48, 0x7a, 0x41, 0x00}, /* U+00ED í */
	{0x00, 0x4a, 0x79, 0x42, 0x00}, /* U+00EE î */
	{0x00, 0x4a, 0x78, 0x42, 0x00}, /* U+00EF ï */
	{0x25, 0x52, 0x55, 0x38, 0x00}, /* U+00F0 ð */
	{0x7a, 0x09, 0x0a, 0x71, 0x00}, /* U+00F1 ñ */
	{0x30, 0x49, 0x4a, 0x30, 0x00}, /* U+00F2 ò */
	{0x30, 0x4a, 0x49, 0x30, 0x00}, /* U+00F3 ó */
	{0x32, 0x49, 0x49, 0x32, 0x00}, /* U+00F4 ô */
	{0x32, 0x49, 0x4a, 0x31, 0x00}, /* U+00F5 õ */
	{0x32, 0x48, 0x48, 0x32, 0x00}, /* U+00F6 ö */
	{0x00, 0x10, 0x54, 0x10, 0x00}, /* U+00F7 ÷ */
	{0x70, 0x68, 0x58, 0x38, 0x00}, /* U+00F8 ø */
	{0x38, 0x41, 0x42, 0x78, 0x00}, /* U+00F9 ù */
	{0x38, 0x42, 0x41, 0x78, 0x00}, /* U+00FA ú */
	{0x3a, 0x41, 0x41, 0x7a, 0x00}, /* U+00FB û */
	{0x3a, 0x40, 0x40, 0x7a, 0x00}, /* U+00FC ü */
	{0x58, 0xa2, 0xa1, 0x78, 0x00}, /* U+00FD ý */
	{0xfe, 0x28, 0x28, 0x10, 0x00}, /* U+00FE þ */
	{0x5a, 0xa0, 0xa0, 0x7a, 0x00}, /* U+00FF ÿ */
};
```

## src/font5x8.h
```c
/**
 * @file font5x8.h
 * @brief 5x8 bitmap font (public-domain X11 misc-fixed), column-major glyphs.
 */
#ifndef FONT5X8_H_
#define FONT5X8_H_

#include <stdint.h>

#define FONT_W 5
#define FONT_H 8

extern const uint8_t font5x8_ascii[95][5];   /* U+0020..U+007E */
extern const uint8_t font5x8_latin1[96][5];  /* U+00A0..U+00FF */

#endif /* FONT5X8_H_ */
```

## src/gfx.c
```c
/**
 * @file gfx.c
 * @brief Minimal 1-bpp framebuffer for the 128x64 SSD1306 (vertical tiles).
 * @copyright Copyright (c) 2026 Centro de Inovacao EDGE
 * SPDX-License-Identifier: Apache-2.0
 */
#include <string.h>

#include "font5x8.h"
#include "gfx.h"

#define MAX_I(a, b) ((a) > (b) ? (a) : (b))

static uint8_t fb[GFX_ROWS * GFX_W];

void gfx_clear(void)
{
	memset(fb, 0, sizeof(fb));
}

const uint8_t *gfx_buffer(void)
{
	return fb;
}

void gfx_pixel(int x, int y, bool on)
{
	if (x < 0 || x >= GFX_W || y < 0 || y >= GFX_H) {
		return;
	}
	uint8_t *b = &fb[(y / 8) * GFX_W + x];

	if (on) {
		*b |= (uint8_t)(1u << (y % 8));
	} else {
		*b &= (uint8_t)~(1u << (y % 8));
	}
}

void gfx_hline(int x0, int x1, int y)
{
	for (int x = x0; x <= x1; x++) {
		gfx_pixel(x, y, true);
	}
}

void gfx_vline(int x, int y0, int y1)
{
	for (int y = y0; y <= y1; y++) {
		gfx_pixel(x, y, true);
	}
}

void gfx_rect(int x0, int y0, int x1, int y1)
{
	gfx_hline(x0, x1, y0);
	gfx_hline(x0, x1, y1);
	gfx_vline(x0, y0, y1);
	gfx_vline(x1, y0, y1);
}

void gfx_fill(int x0, int y0, int x1, int y1, bool on)
{
	for (int y = y0; y <= y1; y++) {
		for (int x = x0; x <= x1; x++) {
			gfx_pixel(x, y, on);
		}
	}
}

void gfx_invert_row(int row)
{
	if (row < 0 || row >= GFX_ROWS) {
		return;
	}
	for (int x = 0; x < GFX_W; x++) {
		fb[row * GFX_W + x] ^= 0xFF;
	}
}

void gfx_invert_rect(int x0, int y0, int x1, int y1)
{
	for (int y = MAX_I(y0, 0); y <= y1 && y < GFX_H; y++) {
		for (int x = MAX_I(x0, 0); x <= x1 && x < GFX_W; x++) {
			fb[(y / 8) * GFX_W + x] ^= (uint8_t)(1u << (y % 8));
		}
	}
}

uint32_t gfx_utf8_next(const char **s)
{
	const uint8_t *p = (const uint8_t *)*s;
	uint32_t cp;
	int extra;

	if (p[0] < 0x80) {
		cp = p[0];
		extra = 0;
	} else if ((p[0] & 0xE0) == 0xC0) {
		cp = p[0] & 0x1F;
		extra = 1;
	} else if ((p[0] & 0xF0) == 0xE0) {
		cp = p[0] & 0x0F;
		extra = 2;
	} else if ((p[0] & 0xF8) == 0xF0) {
		cp = p[0] & 0x07;
		extra = 3;
	} else {
		*s += 1;
		return '?';
	}

	for (int i = 1; i <= extra; i++) {
		if ((p[i] & 0xC0) != 0x80) {
			*s += i;
			return '?';
		}
		cp = (cp << 6) | (p[i] & 0x3F);
	}
	*s += 1 + extra;
	return cp;
}

size_t gfx_utf8_put(char *out, size_t size, uint32_t cp)
{
	if (cp < 0x80 && size >= 1) {
		out[0] = (char)cp;
		return 1;
	}
	if (cp < 0x800 && size >= 2) {
		out[0] = (char)(0xC0 | (cp >> 6));
		out[1] = (char)(0x80 | (cp & 0x3F));
		return 2;
	}
	return 0;
}

static const uint8_t *glyph(uint32_t cp)
{
	if (cp >= 0x20 && cp <= 0x7E) {
		return font5x8_ascii[cp - 0x20];
	}
	if (cp >= 0xA0 && cp <= 0xFF) {
		return font5x8_latin1[cp - 0xA0];
	}
	return font5x8_ascii['?' - 0x20];
}

int gfx_text(int x, int row, const char *utf8, int x_max)
{
	if (row < 0 || row >= GFX_ROWS) {
		return x;
	}
	if (x_max > GFX_W) {
		x_max = GFX_W;
	}

	while (*utf8 && x + FONT_W <= x_max) {
		const uint8_t *g = glyph(gfx_utf8_next(&utf8));

		for (int c = 0; c < FONT_W; c++) {
			if (x + c >= 0) {
				fb[row * GFX_W + x + c] |= g[c];
			}
		}
		x += GFX_CELL_W;
	}
	return x;
}

int gfx_text_width(const char *utf8)
{
	int n = 0;

	while (*utf8) {
		gfx_utf8_next(&utf8);
		n++;
	}
	return n * GFX_CELL_W;
}
```

## src/gfx.h
```c
/**
 * @file gfx.h
 * @brief Minimal 1-bpp framebuffer for the 128x64 SSD1306 (vertical tiles).
 * @copyright Copyright (c) 2026 Centro de Inovacao EDGE
 * SPDX-License-Identifier: Apache-2.0
 *
 * Pure C, no Zephyr dependency, so it can be unit-tested on a PC.
 * Text is drawn on 8-pixel "rows" (the SSD1306 pages): 8 rows of 21
 * characters with the 6-pixel cell of the 5x8 font.
 */
#ifndef GFX_H_
#define GFX_H_

#include <stdbool.h>
#include <stddef.h>
#include <stdint.h>

#define GFX_W      128
#define GFX_H      64
#define GFX_ROWS   (GFX_H / 8)
#define GFX_CELL_W 6
#define GFX_COLS   (GFX_W / GFX_CELL_W)  /* 21 */

void gfx_clear(void);

/** Framebuffer: byte (row * GFX_W + x), bit n = pixel (x, row * 8 + n). */
const uint8_t *gfx_buffer(void);

void gfx_pixel(int x, int y, bool on);
void gfx_hline(int x0, int x1, int y);
void gfx_vline(int x, int y0, int y1);
void gfx_rect(int x0, int y0, int x1, int y1);       /* outline */
void gfx_fill(int x0, int y0, int x1, int y1, bool on);
void gfx_invert_row(int row);                         /* whole text row */
void gfx_invert_rect(int x0, int y0, int x1, int y1); /* XOR a rectangle */

/**
 * Draw UTF-8 text on a text row, starting at pixel x and clipped at x_max.
 * Characters outside ASCII/Latin-1 are drawn as '?'.
 * @return the x position after the last character drawn.
 */
int gfx_text(int x, int row, const char *utf8, int x_max);

/** Width in pixels of a UTF-8 string. */
int gfx_text_width(const char *utf8);

/** Decode one UTF-8 character, return its code point and advance *s. */
uint32_t gfx_utf8_next(const char **s);

/** Append a code point (U+0000..U+00FF) to a UTF-8 buffer. Returns bytes written. */
size_t gfx_utf8_put(char *out, size_t size, uint32_t cp);

#endif /* GFX_H_ */
```

## src/hw_models.c
```c
/**
 * @file hw_models.c
 * @brief Meshtastic HardwareModel names.
 * @copyright Copyright (c) 2026 Centro de Inovacao EDGE
 * SPDX-License-Identifier: Apache-2.0
 *
 * Generated from enum HardwareModel in meshtastic/protobufs (mesh.proto).
 */
#include <stddef.h>
#include <stdint.h>

#include "meshtastic.h"

struct hw_name {
	uint16_t id;
	const char *name;
};

static const struct hw_name hw_names[] = {
	{0, "UNSET"},
	{1, "TLORA_V2"},
	{2, "TLORA_V1"},
	{3, "TLORA_V2_1_1P6"},
	{4, "TBEAM"},
	{5, "HELTEC_V2_0"},
	{6, "TBEAM_V0P7"},
	{7, "T_ECHO"},
	{8, "TLORA_V1_1P3"},
	{9, "RAK4631"},
	{10, "HELTEC_V2_1"},
	{11, "HELTEC_V1"},
	{12, "LILYGO_TBEAM_S3_CORE"},
	{13, "RAK11200"},
	{14, "NANO_G1"},
	{15, "TLORA_V2_1_1P8"},
	{16, "TLORA_T3_S3"},
	{17, "NANO_G1_EXPLORER"},
	{18, "NANO_G2_ULTRA"},
	{19, "LORA_TYPE"},
	{20, "WIPHONE"},
	{21, "WIO_WM1110"},
	{22, "RAK2560"},
	{23, "HELTEC_HRU_3601"},
	{24, "HELTEC_WIRELESS_BRIDGE"},
	{25, "STATION_G1"},
	{26, "RAK11310"},
	{27, "MAKERFABS_TRACKER"},
	{28, "MAKERFABS_RESERVED"},
	{29, "CANARYONE"},
	{30, "RP2040_LORA"},
	{31, "STATION_G2"},
	{32, "LORA_RELAY_V1"},
	{33, "T_ECHO_PLUS"},
	{34, "PPR"},
	{35, "GENIEBLOCKS"},
	{36, "NRF52_UNKNOWN"},
	{37, "PORTDUINO"},
	{38, "ANDROID_SIM"},
	{39, "DIY_V1"},
	{40, "NRF52840_PCA10059"},
	{41, "DR_DEV"},
	{42, "M5STACK"},
	{43, "HELTEC_V3"},
	{44, "HELTEC_WSL_V3"},
	{45, "BETAFPV_2400_TX"},
	{46, "BETAFPV_900_NANO_TX"},
	{47, "RPI_PICO"},
	{48, "HELTEC_WIRELESS_TRACKER"},
	{49, "HELTEC_WIRELESS_PAPER"},
	{50, "T_DECK"},
	{51, "T_WATCH_S3"},
	{52, "PICOMPUTER_S3"},
	{53, "HELTEC_HT62"},
	{54, "EBYTE_ESP32_S3"},
	{55, "ESP32_S3_PICO"},
	{56, "CHATTER_2"},
	{57, "HELTEC_WIRELESS_PAPER_V1_0"},
	{58, "HELTEC_WIRELESS_TRACKER_V1_0"},
	{59, "UNPHONE"},
	{60, "TD_LORAC"},
	{61, "CDEBYTE_EORA_S3"},
	{62, "TWC_MESH_V4"},
	{63, "NRF52_PROMICRO_DIY"},
	{64, "RADIOMASTER_900_BANDIT_NANO"},
	{65, "HELTEC_CAPSULE_SENSOR_V3"},
	{66, "HELTEC_VISION_MASTER_T190"},
	{67, "HELTEC_VISION_MASTER_E213"},
	{68, "HELTEC_VISION_MASTER_E290"},
	{69, "HELTEC_MESH_NODE_T114"},
	{70, "SENSECAP_INDICATOR"},
	{71, "TRACKER_T1000_E"},
	{72, "RAK3172"},
	{73, "WIO_E5"},
	{74, "RADIOMASTER_900_BANDIT"},
	{75, "ME25LS01_4Y10TD"},
	{76, "RP2040_FEATHER_RFM95"},
	{77, "M5STACK_COREBASIC"},
	{78, "M5STACK_CORE2"},
	{79, "RPI_PICO2"},
	{80, "M5STACK_CORES3"},
	{81, "SEEED_XIAO_S3"},
	{82, "MS24SF1"},
	{83, "TLORA_C6"},
	{84, "WISMESH_TAP"},
	{85, "ROUTASTIC"},
	{86, "MESH_TAB"},
	{87, "MESHLINK"},
	{88, "XIAO_NRF52_KIT"},
	{89, "THINKNODE_M1"},
	{90, "THINKNODE_M2"},
	{91, "T_ETH_ELITE"},
	{92, "HELTEC_SENSOR_HUB"},
	{93, "MUZI_BASE"},
	{94, "HELTEC_MESH_POCKET"},
	{95, "SEEED_SOLAR_NODE"},
	{96, "NOMADSTAR_METEOR_PRO"},
	{97, "CROWPANEL"},
	{98, "LINK_32"},
	{99, "SEEED_WIO_TRACKER_L1"},
	{100, "SEEED_WIO_TRACKER_L1_EINK"},
	{101, "MUZI_R1_NEO"},
	{102, "T_DECK_PRO"},
	{103, "T_LORA_PAGER"},
	{104, "M5STACK_RESERVED"},
	{105, "WISMESH_TAG"},
	{106, "RAK3312"},
	{107, "THINKNODE_M5"},
	{108, "HELTEC_MESH_SOLAR"},
	{109, "T_ECHO_LITE"},
	{110, "HELTEC_V4"},
	{111, "M5STACK_C6L"},
	{112, "M5STACK_CARDPUTER_ADV"},
	{113, "HELTEC_WIRELESS_TRACKER_V2"},
	{114, "T_WATCH_ULTRA"},
	{115, "THINKNODE_M3"},
	{116, "WISMESH_TAP_V2"},
	{117, "RAK3401"},
	{118, "RAK6421"},
	{119, "THINKNODE_M4"},
	{120, "THINKNODE_M6"},
	{121, "MESHSTICK_1262"},
	{122, "TBEAM_1_WATT"},
	{123, "T5_S3_EPAPER_PRO"},
	{124, "TBEAM_BPF"},
	{125, "MINI_EPAPER_S3"},
	{126, "TDISPLAY_S3_PRO"},
	{127, "HELTEC_MESH_NODE_T096"},
	{128, "MESH_TRACKER_X1"},
	{129, "THINKNODE_M7"},
	{130, "THINKNODE_M8"},
	{131, "THINKNODE_M9"},
	{132, "HELTEC_V4_R8"},
	{133, "HELTEC_MESH_NODE_T1"},
	{134, "STATION_G3"},
	{135, "T_IMPULSE_PLUS"},
	{136, "T_ECHO_CARD"},
	{137, "SEEED_WIO_TRACKER_L2"},
	{138, "CROWPANEL_P4"},
	{139, "HELTEC_MESH_TOWER_V2"},
	{140, "MESHNOLOGY_W10"},
	{141, "HELTEC_RC32"},
	{142, "HELTEC_RC52"},
	{143, "HELTEC_RCC6"},
	{144, "SEEED_WIO_TRACKER_L1_PRO_1W"},
	{145, "MESHNOLOGY_W12"},
	{146, "MESHPAGER_X2"},
	{147, "T_CONNECT_PRO"},
	{148, "AXIOMETA_GENESIS_MINI"},
	{149, "MAKERFABS_NOMAD_TERMINAL"},
	{150, "THINKNODE_MX"},
	{151, "NODARA"},
	{152, "HELTEC_MESH_POCKET_V2"},
	{255, "PRIVATE_HW"},
};

const char *mesh_hw_model_name(uint32_t hw_model)
{
	for (size_t i = 0; i < sizeof(hw_names) / sizeof(hw_names[0]); i++) {
		if (hw_names[i].id == hw_model) {
			return hw_names[i].name;
		}
	}
	return "UNKNOWN";
}
```

## src/input.c
```c
/**
 * @file input.c
 * @brief Board buttons and rotary encoder -> ui_input_chan.
 * @copyright Copyright (c) 2026 Centro de Inovacao EDGE
 * SPDX-License-Identifier: Apache-2.0
 *
 * The ZBook devicetree already exposes the hardware through the Zephyr input
 * subsystem: gpio-keys for BTN0..BTN3 (INPUT_BTN_0..3) and the encoder push
 * button (INPUT_KEY_ENTER), gpio-qdec for the encoder (INPUT_REL_WHEEL).
 * This module only translates those events into UI events.
 */
#include <zephyr/input/input.h>
#include <zephyr/kernel.h>
#include <zephyr/logging/log.h>

#include "events.h"

LOG_MODULE_REGISTER(ui_input, LOG_LEVEL_INF);

static void on_input(struct input_event *evt, void *user_data)
{
	struct ui_input in = {0};

	ARG_UNUSED(user_data);

	if (evt->type == INPUT_EV_REL && evt->code == INPUT_REL_WHEEL) {
		int v = CLAMP(evt->value, -100, 100);

		in.rotate = true;
		in.delta = (int8_t)(IS_ENABLED(CONFIG_APP_UI_ENCODER_REVERSE) ? -v : v);
	} else if (evt->type == INPUT_EV_KEY && evt->value == 1) { /* press only */
		switch (evt->code) {
		case INPUT_BTN_0:
			in.key = UI_KEY_BACK;
			break;
		case INPUT_BTN_1:
		case INPUT_KEY_ENTER:
			in.key = UI_KEY_OK;
			break;
		case INPUT_BTN_2:
			in.key = UI_KEY_ACTION;
			break;
		case INPUT_BTN_3:
			in.key = UI_KEY_HOME;
			break;
		default:
			return;
		}
	} else {
		return;
	}

	if (zbus_chan_pub(&ui_input_chan, &in, K_MSEC(10)) != 0) {
		LOG_WRN("UI busy, input dropped");
	}
}

INPUT_CALLBACK_DEFINE(NULL, on_input, NULL);
```
