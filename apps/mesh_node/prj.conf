## CMakeLists.txt
```
# Copyright (c) 2026 Centro de Inovacao EDGE
# SPDX-License-Identifier: Apache-2.0

cmake_minimum_required(VERSION 3.20.0)

find_package(Zephyr REQUIRED HINTS $ENV{ZEPHYR_BASE})
project(mesh_node)

target_sources(app PRIVATE
  src/main.c
  src/mesh.c
  src/radio.c
  src/meshtastic.c
  src/nodedb.c
  src/pb.c
  src/aes128.c
  src/hw_models.c
)
```

## prj.conf
```kconfig
# Copyright (c) 2026 Centro de Inovacao EDGE
# SPDX-License-Identifier: Apache-2.0

# The RFM95W is driven directly over SPI by src/radio.c, so the Zephyr LoRa
# driver (enabled by default by the zbook_lora shield) is left out.
CONFIG_LORA=n
CONFIG_SPI=y
CONFIG_GPIO=y

# Chip unique ID -> Meshtastic node number
CONFIG_HWINFO=y

# Interactive console on the PROG USB serial port
CONFIG_SHELL=y
CONFIG_SHELL_STACK_SIZE=4096
CONFIG_SHELL_BACKEND_SERIAL=y
CONFIG_SHELL_CMD_BUFF_SIZE=320
CONFIG_SHELL_ARGC_MAX=40

# Logs go through the shell
CONFIG_LOG=y
CONFIG_LOG_BUFFER_SIZE=4096

CONFIG_MAIN_STACK_SIZE=2048
```

## src/main.c
```c
/**
 * @file main.c
 *
 * @brief Meshtastic node for the ZBook + RFM95W.
 *
 * Joins the Meshtastic primary channel (LongFast, default key) as a CLIENT
 * node: announces itself (NODEINFO), relays packets for its neighbours
 * (managed flooding), answers ACKs and NODEINFO requests, and sends and
 * receives text messages. Everything is driven from the Zephyr shell
 * ("mesh" commands) on the PROG USB serial port.
 *
 * @author Vinicius RM Carvalho
 * @date 2026-11-12
 * @copyright Copyright (c) 2026 Centro de Inovacao EDGE
 * SPDX-License-Identifier: Apache-2.0
 */
#include <stdlib.h>
#include <string.h>

#include <zephyr/kernel.h>
#include <zephyr/logging/log.h>
#include <zephyr/shell/shell.h>

#include "mesh.h"
#include "meshtastic.h"
#include "nodedb.h"
#include "radio.h"

LOG_MODULE_REGISTER(app, LOG_LEVEL_INF);

#define DEFAULT_REGION       "US"
#define DEFAULT_PRESET       "LongFast"
#define NODEINFO_PERIOD      K_HOURS(3)    /* Meshtastic default */
#define POSITION_PERIOD      K_MINUTES(30)

/* ------------------------------------------------------- periodic sends */

static void nodeinfo_work_fn(struct k_work *work);
static void position_work_fn(struct k_work *work);
static K_WORK_DELAYABLE_DEFINE(nodeinfo_work, nodeinfo_work_fn);
static K_WORK_DELAYABLE_DEFINE(position_work, position_work_fn);

static void nodeinfo_work_fn(struct k_work *work)
{
	mesh_send_nodeinfo(MESH_BROADCAST, false);
	k_work_reschedule(k_work_delayable_from_work(work), NODEINFO_PERIOD);
}

static void position_work_fn(struct k_work *work)
{
	if (mesh_has_position()) {
		mesh_send_position(MESH_BROADCAST);
	}
	k_work_reschedule(k_work_delayable_from_work(work), POSITION_PERIOD);
}

/* ---------------------------------------------------------------- helpers */

/* Degrees * 1e7 -> "-9.64980" without floating point. */
static void fmt_coord(char *buf, size_t size, int32_t v)
{
	uint32_t a = v < 0 ? (uint32_t)(-(int64_t)v) : (uint32_t)v;

	snprintk(buf, size, "%s%u.%05u", v < 0 ? "-" : "", a / 10000000U, (a % 10000000U) / 100U);
}

/* "-9.6498" -> -96498000 (degrees * 1e7) without floating point. */
static bool parse_coord(const char *s, int32_t *out)
{
	bool neg = false;
	int64_t ip = 0, frac = 0, scale = 10000000;

	if (*s == '-' || *s == '+') {
		neg = (*s == '-');
		s++;
	}
	if (*s < '0' || *s > '9') {
		return false;
	}
	while (*s >= '0' && *s <= '9') {
		ip = ip * 10 + (*s++ - '0');
	}
	if (*s == '.') {
		s++;
		while (*s >= '0' && *s <= '9') {
			if (scale > 1) {
				scale /= 10;
				frac += (*s - '0') * scale;
			}
			s++;
		}
	}
	if (*s != '\0' || ip > 180) {
		return false;
	}
	*out = (int32_t)((ip * 10000000 + frac) * (neg ? -1 : 1));
	return true;
}

static void fmt_ago(char *buf, size_t size, int64_t since_ms)
{
	int s = (int)((k_uptime_get() - since_ms) / 1000);

	if (s < 60) {
		snprintk(buf, size, "%ds", s);
	} else if (s < 3600) {
		snprintk(buf, size, "%dm", s / 60);
	} else {
		snprintk(buf, size, "%dh", s / 3600);
	}
}

static bool parse_node_id(const char *s, uint32_t *num)
{
	char *end;

	if (*s == '!') {
		s++;
	}
	*num = strtoul(s, &end, 16);
	return *s != '\0' && *end == '\0';
}

/* Join argv[first..] with spaces (shell splits the message into words). */
static bool join_args(char *buf, size_t size, size_t argc, char **argv, size_t first)
{
	size_t len = 0;

	buf[0] = '\0';
	for (size_t i = first; i < argc; i++) {
		size_t n = strlen(argv[i]);

		if (len + n + 2 > size) {
			return false;
		}
		if (len) {
			buf[len++] = ' ';
		}
		memcpy(&buf[len], argv[i], n);
		len += n;
		buf[len] = '\0';
	}
	return len > 0;
}

/* ----------------------------------------------------------------- shell */

static int cmd_id(const struct shell *sh, size_t argc, char **argv)
{
	const struct mesh_identity *me = mesh_identity();

	ARG_UNUSED(argc);
	ARG_UNUSED(argv);
	shell_print(sh, "Node      : !%08x", me->num);
	shell_print(sh, "Name      : %s (%s)", me->long_name, me->short_name);
	shell_print(sh, "Hardware  : PRIVATE_HW, role CLIENT");
	shell_print(sh, "Relay     : %s", mesh_relay_enabled() ? "on" : "off");
	return 0;
}

static int cmd_name(const struct shell *sh, size_t argc, char **argv)
{
	if (strlen(argv[1]) > 39 || (argc > 2 && strlen(argv[2]) > 4)) {
		shell_error(sh, "Long name up to 39 characters, short name up to 4");
		return -EINVAL;
	}
	mesh_set_name(argv[1], argc > 2 ? argv[2] : NULL);
	shell_print(sh, "Name set (not saved across resets). Announcing...");
	return mesh_send_nodeinfo(MESH_BROADCAST, false);
}

static int cmd_announce(const struct shell *sh, size_t argc, char **argv)
{
	ARG_UNUSED(argc);
	ARG_UNUSED(argv);
	shell_print(sh, "Sending NODEINFO and asking neighbours for theirs...");
	return mesh_send_nodeinfo(MESH_BROADCAST, true);
}

static int cmd_send(const struct shell *sh, size_t argc, char **argv)
{
	char text[201];
	uint32_t id;
	int ret;

	if (!join_args(text, sizeof(text), argc, argv, 1)) {
		shell_error(sh, "Message too long (200 characters max)");
		return -EINVAL;
	}
	ret = mesh_send_text(MESH_BROADCAST, text, false, &id);
	if (ret == 0) {
		shell_print(sh, "Queued to everyone on %s (id %08x)", radio_get()->preset->name, id);
	}
	return ret;
}

static int cmd_dm(const struct shell *sh, size_t argc, char **argv)
{
	char text[201];
	uint32_t to, id;
	int ret;

	if (!parse_node_id(argv[1], &to)) {
		shell_error(sh, "Invalid node id: %s (use !a1b2c3d4)", argv[1]);
		return -EINVAL;
	}
	if (!join_args(text, sizeof(text), argc, argv, 2)) {
		shell_error(sh, "Message too long (200 characters max)");
		return -EINVAL;
	}
	ret = mesh_send_text(to, text, true, &id);
	if (ret == 0) {
		shell_print(sh, "Queued to !%08x (id %08x), waiting for ACK...", to, id);
	}
	return ret;
}

static int cmd_pos(const struct shell *sh, size_t argc, char **argv)
{
	int32_t lat, lon, alt = 0;
	char a[16], b[16];

	if (argc == 2 && strcmp(argv[1], "off") == 0) {
		mesh_clear_position();
		shell_print(sh, "Position cleared.");
		return 0;
	}
	if (argc < 3 || !parse_coord(argv[1], &lat) || !parse_coord(argv[2], &lon)) {
		shell_error(sh, "Use: mesh pos <lat> <lon> [alt_m]   e.g. mesh pos -9.6498 -35.7089 10");
		return -EINVAL;
	}
	if (argc > 3) {
		alt = atoi(argv[3]);
	}
	mesh_set_position(lat, lon, alt);
	fmt_coord(a, sizeof(a), lat);
	fmt_coord(b, sizeof(b), lon);
	shell_print(sh, "Position %s, %s, %d m. Sending...", a, b, alt);
	return mesh_send_position(MESH_BROADCAST);
}

static int cmd_nodes(const struct shell *sh, size_t argc, char **argv)
{
	static struct node_entry list[NODEDB_MAX_NODES];
	int n = nodedb_snapshot(list, ARRAY_SIZE(list));
	char ago[8], rssi[8], snr[8], hops[4];

	ARG_UNUSED(argc);
	ARG_UNUSED(argv);

	if (n == 0) {
		shell_print(sh, "No nodes heard yet. Try 'mesh announce'.");
		return 0;
	}

	shell_print(sh, "%-10s %-5s %-24s %4s %5s %4s %5s %5s  %s", "ID", "Short", "Long name",
		    "Hops", "RSSI", "SNR", "Seen", "Pkts", "Hardware");
	for (int i = 0; i < n; i++) {
		const struct node_entry *e = &list[i];

		fmt_ago(ago, sizeof(ago), e->last_heard_ms);
		if (e->hops_away < 0) {
			strcpy(hops, "?");
		} else {
			snprintk(hops, sizeof(hops), "%d", e->hops_away);
		}
		if (e->has_signal) {
			snprintk(rssi, sizeof(rssi), "%d", e->rssi);
			snprintk(snr, sizeof(snr), "%d", e->snr);
		} else {
			strcpy(rssi, "-");
			strcpy(snr, "-");
		}
		shell_print(sh, "!%08x  %-5s %-24.24s %4s %5s %4s %5s %5u  %s", e->num,
			    e->has_user ? e->short_name : "?", e->has_user ? e->long_name : "",
			    hops, rssi, snr, ago, e->packets,
			    e->has_user ? mesh_hw_model_name(e->hw_model) : "");
	}
	shell_print(sh, "%d node(s). RSSI/SNR only for nodes heard directly (0 hops).", n);
	return 0;
}

static int cmd_node(const struct shell *sh, size_t argc, char **argv)
{
	struct node_entry e;
	uint32_t num;
	char ago[8], lat[16], lon[16];

	ARG_UNUSED(argc);
	if (!parse_node_id(argv[1], &num)) {
		shell_error(sh, "Invalid node id: %s (use !a1b2c3d4)", argv[1]);
		return -EINVAL;
	}
	if (!nodedb_get(num, &e)) {
		shell_error(sh, "Node !%08x not heard yet", num);
		return -ENOENT;
	}

	fmt_ago(ago, sizeof(ago), e.last_heard_ms);
	shell_print(sh, "Node      : !%08x", e.num);
	if (e.has_user) {
		shell_print(sh, "Name      : %s (%s)", e.long_name, e.short_name);
		shell_print(sh, "Hardware  : %s", mesh_hw_model_name(e.hw_model));
		shell_print(sh, "Role      : %s", mesh_role_name(e.role));
	} else {
		shell_print(sh, "Name      : unknown (no NODEINFO heard yet)");
	}
	shell_print(sh, "Last heard: %s ago, %u packet(s), last port %s%s", ago, e.packets,
		    mesh_port_name(e.last_port), e.last_decrypted ? "" : " (not decrypted)");
	if (e.hops_away >= 0) {
		shell_print(sh, "Hops away : %d", e.hops_away);
	}
	if (e.has_signal) {
		shell_print(sh, "Signal    : %d dBm, SNR %d dB (direct)", e.rssi, e.snr);
	} else {
		shell_print(sh, "Signal    : only heard through relays (last relay ..%02x)",
			    e.last_relay);
	}
	if (e.has_pos) {
		fmt_coord(lat, sizeof(lat), e.lat_i);
		fmt_coord(lon, sizeof(lon), e.lon_i);
		shell_print(sh, "Position  : %s, %s, %d m", lat, lon, e.alt_m);
	}
	if (e.has_battery) {
		shell_print(sh, "Battery   : %u%%", e.battery_level);
	}
	return 0;
}

static int cmd_radio(const struct shell *sh, size_t argc, char **argv)
{
	const struct radio_state *s = radio_get();
	struct radio_stats rs;
	struct mesh_stats ms;

	ARG_UNUSED(argc);
	ARG_UNUSED(argv);
	radio_get_stats(&rs);
	mesh_get_stats(&ms);

	shell_print(sh, "Region   : %s", s->region->name);
	shell_print(sh, "Preset   : %s (SF%u, BW %u kHz, CR 4/%u)", s->preset->name,
		    s->preset->sf, s->preset->bw_khz, s->preset->cr);
	shell_print(sh, "Frequency: %u.%03u MHz (slot %u of %u)", s->freq_hz / 1000000U,
		    (s->freq_hz / 1000U) % 1000U, s->slot + 1, s->num_slots);
	shell_print(sh, "Channel  : hash 0x%02x, default key", s->channel_hash);
	shell_print(sh, "TX power : %u dBm", s->tx_power_dbm);
	shell_print(sh, "DIO0     : %s (%u by interrupt, %u found by polling)",
		    !rs.dio0_configured ? "not configured"
		    : rs.dio0_hits ? "working" : "no edge seen yet",
		    rs.dio0_hits, rs.dio0_misses);
	shell_print(sh, "Radio    : %u RX, %u CRC errors, %u TX (%u ms on air)", rs.rx_frames,
		    rs.crc_errors, rs.tx_frames, rs.tx_airtime_ms);
	shell_print(sh, "Mesh     : %u new, %u decrypted, %u other channel, %u duplicates",
		    ms.received, ms.decrypted, ms.other_channel, ms.duplicates);
	shell_print(sh, "Routing  : %u sent, %u relayed, %u relays cancelled", ms.sent,
		    ms.relayed, ms.relays_cancelled);
	return 0;
}

static int cmd_region(const struct shell *sh, size_t argc, char **argv)
{
	const struct mesh_region *r = radio_find_region(argv[1]);

	ARG_UNUSED(argc);
	if (r == NULL) {
		shell_error(sh, "Unknown region. Options:");
		for (size_t i = 0; i < mesh_region_count; i++) {
			shell_print(sh, "  %s", mesh_regions[i].name);
		}
		return -EINVAL;
	}
	return radio_set(r, radio_get()->preset);
}

static int cmd_preset(const struct shell *sh, size_t argc, char **argv)
{
	const struct mesh_preset *p = radio_find_preset(argv[1]);

	ARG_UNUSED(argc);
	if (p == NULL) {
		shell_error(sh, "Unknown preset. Options:");
		for (size_t i = 0; i < mesh_preset_count; i++) {
			shell_print(sh, "  %s", mesh_presets[i].name);
		}
		return -EINVAL;
	}
	return radio_set(radio_get()->region, p);
}

static int cmd_txpower(const struct shell *sh, size_t argc, char **argv)
{
	int dbm = atoi(argv[1]);

	ARG_UNUSED(argc);
	if (radio_set_tx_power((uint8_t)CLAMP(dbm, 0, 255)) < 0) {
		shell_error(sh, "Use 2..17 dBm");
		return -EINVAL;
	}
	shell_print(sh, "TX power %d dBm", dbm);
	return 0;
}

static int on_off(const struct shell *sh, const char *arg, bool *out)
{
	if (strcmp(arg, "on") == 0) {
		*out = true;
	} else if (strcmp(arg, "off") == 0) {
		*out = false;
	} else {
		shell_error(sh, "Use on or off");
		return -EINVAL;
	}
	return 0;
}

static int cmd_relay(const struct shell *sh, size_t argc, char **argv)
{
	bool on;

	ARG_UNUSED(argc);
	if (on_off(sh, argv[1], &on) == 0) {
		mesh_set_relay(on);
		return 0;
	}
	return -EINVAL;
}

static int cmd_live(const struct shell *sh, size_t argc, char **argv)
{
	bool on;

	ARG_UNUSED(argc);
	if (on_off(sh, argv[1], &on) == 0) {
		mesh_set_live(on);
		return 0;
	}
	return -EINVAL;
}

static void diag_line(const struct shell *sh, const char *name, uint32_t got, uint32_t want,
		      int width)
{
	shell_print(sh, "  %-14s 0x%0*x  (expected 0x%0*x)  %s", name, width, got, width, want,
		    got == want ? "OK" : "<-- MISMATCH");
}

static int cmd_diag(const struct shell *sh, size_t argc, char **argv)
{
	struct radio_diag d, want;
	int seconds = argc > 1 ? atoi(argv[1]) : 10;

	if (radio_read_diag(&d) < 0) {
		shell_error(sh, "SPI error while reading the radio");
		return -EIO;
	}
	radio_expected_diag(&want);

	shell_print(sh, "SX1276 registers (version 0x%02x):", d.version);
	diag_line(sh, "OpMode", d.op_mode, want.op_mode, 2);
	diag_line(sh, "Frequency", d.frf, want.frf, 6);
	diag_line(sh, "ModemConfig1", d.modem_config_1, want.modem_config_1, 2);
	diag_line(sh, "ModemConfig2", d.modem_config_2, want.modem_config_2, 2);
	diag_line(sh, "ModemConfig3", d.modem_config_3, want.modem_config_3, 2);
	diag_line(sh, "SyncWord", d.sync_word, want.sync_word, 2);
	diag_line(sh, "Preamble", d.preamble, want.preamble, 4);
	diag_line(sh, "PaConfig", d.pa_config, want.pa_config, 2);

	shell_print(sh, "Channel RSSI for %d s:", seconds);
	for (int i = 0; i < seconds; i++) {
		if (radio_read_diag(&d) == 0) {
			shell_print(sh, "  %2d s: %4d dBm%s", i + 1, d.rssi_now,
				    (d.modem_stat & 0x01) ? "  (LoRa signal detected)" : "");
		}
		k_sleep(K_SECONDS(1));
	}
	return 0;
}

static int cmd_clear(const struct shell *sh, size_t argc, char **argv)
{
	ARG_UNUSED(argc);
	ARG_UNUSED(argv);
	nodedb_clear();
	shell_print(sh, "Node table cleared.");
	return 0;
}

SHELL_STATIC_SUBCMD_SET_CREATE(mesh_cmds,
	SHELL_CMD(id, NULL, "This node's ID and name", cmd_id),
	SHELL_CMD_ARG(name, NULL, "Set name: mesh name <long> [short]", cmd_name, 2, 1),
	SHELL_CMD(announce, NULL, "Send NODEINFO and ask neighbours for theirs", cmd_announce),
	SHELL_CMD_ARG(send, NULL, "Message to everyone: mesh send <text>", cmd_send, 2, 30),
	SHELL_CMD_ARG(dm, NULL, "Direct message with ACK: mesh dm !id <text>", cmd_dm, 3, 30),
	SHELL_CMD_ARG(pos, NULL, "Fixed position: mesh pos <lat> <lon> [alt] | off", cmd_pos, 2, 2),
	SHELL_CMD(nodes, NULL, "List the nodes heard", cmd_nodes),
	SHELL_CMD_ARG(node, NULL, "Details of one node: mesh node !a1b2c3d4", cmd_node, 2, 0),
	SHELL_CMD(radio, NULL, "Radio settings and counters", cmd_radio),
	SHELL_CMD_ARG(region, NULL, "Set region: US | ANZ | BR_902", cmd_region, 2, 0),
	SHELL_CMD_ARG(preset, NULL, "Set modem preset: LongFast, MediumFast, ...", cmd_preset, 2, 0),
	SHELL_CMD_ARG(txpower, NULL, "TX power in dBm: mesh txpower 2..17", cmd_txpower, 2, 0),
	SHELL_CMD_ARG(relay, NULL, "Relay other nodes' packets: mesh relay on|off", cmd_relay, 2, 0),
	SHELL_CMD_ARG(live, NULL, "Print each packet: mesh live on|off", cmd_live, 2, 0),
	SHELL_CMD_ARG(diag, NULL, "Check radio registers and RSSI: mesh diag [s]", cmd_diag, 1, 1),
	SHELL_CMD(clear, NULL, "Clear the node table", cmd_clear),
	SHELL_SUBCMD_SET_END);

SHELL_CMD_REGISTER(mesh, &mesh_cmds, "Meshtastic node", NULL);

/* ------------------------------------------------------------------ main */

int main(void)
{
	int ret = radio_init(radio_find_region(DEFAULT_REGION), radio_find_preset(DEFAULT_PRESET));

	if (ret < 0) {
		LOG_ERR("Radio init failed (%d). Check the SPI wiring.", ret);
		return 0;
	}

	mesh_start();
	k_work_schedule(&nodeinfo_work, K_SECONDS(15));
	k_work_schedule(&position_work, K_SECONDS(20));

	LOG_INF("Meshtastic node ready. Type 'mesh help'. Antenna must be connected!");
	return 0;
}
```

## src/aes128.c
```c
/**
 * @file aes128.c
 * @brief Minimal AES-128 (FIPS-197), encrypt direction only, plus CTR mode.
 * @copyright Copyright (c) 2026 Centro de Inovacao EDGE
 * SPDX-License-Identifier: Apache-2.0
 */
#include <string.h>

#include "aes128.h"

static const uint8_t sbox[256] = {
	0x63, 0x7c, 0x77, 0x7b, 0xf2, 0x6b, 0x6f, 0xc5, 0x30, 0x01, 0x67, 0x2b, 0xfe, 0xd7, 0xab, 0x76,
	0xca, 0x82, 0xc9, 0x7d, 0xfa, 0x59, 0x47, 0xf0, 0xad, 0xd4, 0xa2, 0xaf, 0x9c, 0xa4, 0x72, 0xc0,
	0xb7, 0xfd, 0x93, 0x26, 0x36, 0x3f, 0xf7, 0xcc, 0x34, 0xa5, 0xe5, 0xf1, 0x71, 0xd8, 0x31, 0x15,
	0x04, 0xc7, 0x23, 0xc3, 0x18, 0x96, 0x05, 0x9a, 0x07, 0x12, 0x80, 0xe2, 0xeb, 0x27, 0xb2, 0x75,
	0x09, 0x83, 0x2c, 0x1a, 0x1b, 0x6e, 0x5a, 0xa0, 0x52, 0x3b, 0xd6, 0xb3, 0x29, 0xe3, 0x2f, 0x84,
	0x53, 0xd1, 0x00, 0xed, 0x20, 0xfc, 0xb1, 0x5b, 0x6a, 0xcb, 0xbe, 0x39, 0x4a, 0x4c, 0x58, 0xcf,
	0xd0, 0xef, 0xaa, 0xfb, 0x43, 0x4d, 0x33, 0x85, 0x45, 0xf9, 0x02, 0x7f, 0x50, 0x3c, 0x9f, 0xa8,
	0x51, 0xa3, 0x40, 0x8f, 0x92, 0x9d, 0x38, 0xf5, 0xbc, 0xb6, 0xda, 0x21, 0x10, 0xff, 0xf3, 0xd2,
	0xcd, 0x0c, 0x13, 0xec, 0x5f, 0x97, 0x44, 0x17, 0xc4, 0xa7, 0x7e, 0x3d, 0x64, 0x5d, 0x19, 0x73,
	0x60, 0x81, 0x4f, 0xdc, 0x22, 0x2a, 0x90, 0x88, 0x46, 0xee, 0xb8, 0x14, 0xde, 0x5e, 0x0b, 0xdb,
	0xe0, 0x32, 0x3a, 0x0a, 0x49, 0x06, 0x24, 0x5c, 0xc2, 0xd3, 0xac, 0x62, 0x91, 0x95, 0xe4, 0x79,
	0xe7, 0xc8, 0x37, 0x6d, 0x8d, 0xd5, 0x4e, 0xa9, 0x6c, 0x56, 0xf4, 0xea, 0x65, 0x7a, 0xae, 0x08,
	0xba, 0x78, 0x25, 0x2e, 0x1c, 0xa6, 0xb4, 0xc6, 0xe8, 0xdd, 0x74, 0x1f, 0x4b, 0xbd, 0x8b, 0x8a,
	0x70, 0x3e, 0xb5, 0x66, 0x48, 0x03, 0xf6, 0x0e, 0x61, 0x35, 0x57, 0xb9, 0x86, 0xc1, 0x1d, 0x9e,
	0xe1, 0xf8, 0x98, 0x11, 0x69, 0xd9, 0x8e, 0x94, 0x9b, 0x1e, 0x87, 0xe9, 0xce, 0x55, 0x28, 0xdf,
	0x8c, 0xa1, 0x89, 0x0d, 0xbf, 0xe6, 0x42, 0x68, 0x41, 0x99, 0x2d, 0x0f, 0xb0, 0x54, 0xbb, 0x16,
};

static const uint8_t rcon[10] = {0x01, 0x02, 0x04, 0x08, 0x10, 0x20, 0x40, 0x80, 0x1b, 0x36};

static uint8_t xtime(uint8_t x)
{
	return (uint8_t)((x << 1) ^ ((x & 0x80) ? 0x1b : 0x00));
}

void aes128_init(struct aes128_ctx *ctx, const uint8_t key[16])
{
	uint8_t *rk = ctx->round_key;

	memcpy(rk, key, 16);
	for (int i = 4; i < 44; i++) {
		uint8_t t[4];

		memcpy(t, &rk[(i - 1) * 4], 4);
		if (i % 4 == 0) {
			uint8_t first = t[0];

			t[0] = sbox[t[1]] ^ rcon[i / 4 - 1];
			t[1] = sbox[t[2]];
			t[2] = sbox[t[3]];
			t[3] = sbox[first];
		}
		for (int j = 0; j < 4; j++) {
			rk[i * 4 + j] = rk[(i - 4) * 4 + j] ^ t[j];
		}
	}
}

static void add_round_key(uint8_t s[16], const uint8_t *rk)
{
	for (int i = 0; i < 16; i++) {
		s[i] ^= rk[i];
	}
}

static void sub_bytes_shift_rows(uint8_t s[16])
{
	uint8_t t[16];

	/* State is column-major: s[col * 4 + row]. Row r shifts left by r. */
	for (int c = 0; c < 4; c++) {
		for (int r = 0; r < 4; r++) {
			t[c * 4 + r] = sbox[s[((c + r) % 4) * 4 + r]];
		}
	}
	memcpy(s, t, 16);
}

static void mix_columns(uint8_t s[16])
{
	for (int c = 0; c < 4; c++) {
		uint8_t *col = &s[c * 4];
		uint8_t a0 = col[0], a1 = col[1], a2 = col[2], a3 = col[3];
		uint8_t all = a0 ^ a1 ^ a2 ^ a3;

		col[0] ^= all ^ xtime(a0 ^ a1);
		col[1] ^= all ^ xtime(a1 ^ a2);
		col[2] ^= all ^ xtime(a2 ^ a3);
		col[3] ^= all ^ xtime(a3 ^ a0);
	}
}

void aes128_encrypt_block(const struct aes128_ctx *ctx, const uint8_t in[16], uint8_t out[16])
{
	uint8_t s[16];

	memcpy(s, in, 16);
	add_round_key(s, &ctx->round_key[0]);
	for (int round = 1; round < 10; round++) {
		sub_bytes_shift_rows(s);
		mix_columns(s);
		add_round_key(s, &ctx->round_key[round * 16]);
	}
	sub_bytes_shift_rows(s);
	add_round_key(s, &ctx->round_key[160]);
	memcpy(out, s, 16);
}

void aes128_ctr_xcrypt(const struct aes128_ctx *ctx, const uint8_t iv[16], uint8_t *buf, size_t len)
{
	uint8_t counter[16];
	uint8_t keystream[16];

	memcpy(counter, iv, 16);
	for (size_t off = 0; off < len; off += 16) {
		aes128_encrypt_block(ctx, counter, keystream);
		for (size_t i = 0; i < 16 && off + i < len; i++) {
			buf[off + i] ^= keystream[i];
		}
		/* Increment the last 4 bytes as a big-endian counter. */
		for (int i = 15; i >= 12; i--) {
			if (++counter[i] != 0) {
				break;
			}
		}
	}
}
```

## src/hw_models.c
```c
/**
 * @file hw_models.c
 * @brief Meshtastic HardwareModel names.
 * @copyright Copyright (c) 2026 Centro de Inovacao EDGE
 * SPDX-License-Identifier: Apache-2.0
 *
 * Generated from enum HardwareModel in meshtastic/protobufs (mesh.proto).
 */
#include <stddef.h>
#include <stdint.h>

#include "meshtastic.h"

struct hw_name {
	uint16_t id;
	const char *name;
};

static const struct hw_name hw_names[] = {
	{0, "UNSET"},
	{1, "TLORA_V2"},
	{2, "TLORA_V1"},
	{3, "TLORA_V2_1_1P6"},
	{4, "TBEAM"},
	{5, "HELTEC_V2_0"},
	{6, "TBEAM_V0P7"},
	{7, "T_ECHO"},
	{8, "TLORA_V1_1P3"},
	{9, "RAK4631"},
	{10, "HELTEC_V2_1"},
	{11, "HELTEC_V1"},
	{12, "LILYGO_TBEAM_S3_CORE"},
	{13, "RAK11200"},
	{14, "NANO_G1"},
	{15, "TLORA_V2_1_1P8"},
	{16, "TLORA_T3_S3"},
	{17, "NANO_G1_EXPLORER"},
	{18, "NANO_G2_ULTRA"},
	{19, "LORA_TYPE"},
	{20, "WIPHONE"},
	{21, "WIO_WM1110"},
	{22, "RAK2560"},
	{23, "HELTEC_HRU_3601"},
	{24, "HELTEC_WIRELESS_BRIDGE"},
	{25, "STATION_G1"},
	{26, "RAK11310"},
	{27, "MAKERFABS_TRACKER"},
	{28, "MAKERFABS_RESERVED"},
	{29, "CANARYONE"},
	{30, "RP2040_LORA"},
	{31, "STATION_G2"},
	{32, "LORA_RELAY_V1"},
	{33, "T_ECHO_PLUS"},
	{34, "PPR"},
	{35, "GENIEBLOCKS"},
	{36, "NRF52_UNKNOWN"},
	{37, "PORTDUINO"},
	{38, "ANDROID_SIM"},
	{39, "DIY_V1"},
	{40, "NRF52840_PCA10059"},
	{41, "DR_DEV"},
	{42, "M5STACK"},
	{43, "HELTEC_V3"},
	{44, "HELTEC_WSL_V3"},
	{45, "BETAFPV_2400_TX"},
	{46, "BETAFPV_900_NANO_TX"},
	{47, "RPI_PICO"},
	{48, "HELTEC_WIRELESS_TRACKER"},
	{49, "HELTEC_WIRELESS_PAPER"},
	{50, "T_DECK"},
	{51, "T_WATCH_S3"},
	{52, "PICOMPUTER_S3"},
	{53, "HELTEC_HT62"},
	{54, "EBYTE_ESP32_S3"},
	{55, "ESP32_S3_PICO"},
	{56, "CHATTER_2"},
	{57, "HELTEC_WIRELESS_PAPER_V1_0"},
	{58, "HELTEC_WIRELESS_TRACKER_V1_0"},
	{59, "UNPHONE"},
	{60, "TD_LORAC"},
	{61, "CDEBYTE_EORA_S3"},
	{62, "TWC_MESH_V4"},
	{63, "NRF52_PROMICRO_DIY"},
	{64, "RADIOMASTER_900_BANDIT_NANO"},
	{65, "HELTEC_CAPSULE_SENSOR_V3"},
	{66, "HELTEC_VISION_MASTER_T190"},
	{67, "HELTEC_VISION_MASTER_E213"},
	{68, "HELTEC_VISION_MASTER_E290"},
	{69, "HELTEC_MESH_NODE_T114"},
	{70, "SENSECAP_INDICATOR"},
	{71, "TRACKER_T1000_E"},
	{72, "RAK3172"},
	{73, "WIO_E5"},
	{74, "RADIOMASTER_900_BANDIT"},
	{75, "ME25LS01_4Y10TD"},
	{76, "RP2040_FEATHER_RFM95"},
	{77, "M5STACK_COREBASIC"},
	{78, "M5STACK_CORE2"},
	{79, "RPI_PICO2"},
	{80, "M5STACK_CORES3"},
	{81, "SEEED_XIAO_S3"},
	{82, "MS24SF1"},
	{83, "TLORA_C6"},
	{84, "WISMESH_TAP"},
	{85, "ROUTASTIC"},
	{86, "MESH_TAB"},
	{87, "MESHLINK"},
	{88, "XIAO_NRF52_KIT"},
	{89, "THINKNODE_M1"},
	{90, "THINKNODE_M2"},
	{91, "T_ETH_ELITE"},
	{92, "HELTEC_SENSOR_HUB"},
	{93, "MUZI_BASE"},
	{94, "HELTEC_MESH_POCKET"},
	{95, "SEEED_SOLAR_NODE"},
	{96, "NOMADSTAR_METEOR_PRO"},
	{97, "CROWPANEL"},
	{98, "LINK_32"},
	{99, "SEEED_WIO_TRACKER_L1"},
	{100, "SEEED_WIO_TRACKER_L1_EINK"},
	{101, "MUZI_R1_NEO"},
	{102, "T_DECK_PRO"},
	{103, "T_LORA_PAGER"},
	{104, "M5STACK_RESERVED"},
	{105, "WISMESH_TAG"},
	{106, "RAK3312"},
	{107, "THINKNODE_M5"},
	{108, "HELTEC_MESH_SOLAR"},
	{109, "T_ECHO_LITE"},
	{110, "HELTEC_V4"},
	{111, "M5STACK_C6L"},
	{112, "M5STACK_CARDPUTER_ADV"},
	{113, "HELTEC_WIRELESS_TRACKER_V2"},
	{114, "T_WATCH_ULTRA"},
	{115, "THINKNODE_M3"},
	{116, "WISMESH_TAP_V2"},
	{117, "RAK3401"},
	{118, "RAK6421"},
	{119, "THINKNODE_M4"},
	{120, "THINKNODE_M6"},
	{121, "MESHSTICK_1262"},
	{122, "TBEAM_1_WATT"},
	{123, "T5_S3_EPAPER_PRO"},
	{124, "TBEAM_BPF"},
	{125, "MINI_EPAPER_S3"},
	{126, "TDISPLAY_S3_PRO"},
	{127, "HELTEC_MESH_NODE_T096"},
	{128, "MESH_TRACKER_X1"},
	{129, "THINKNODE_M7"},
	{130, "THINKNODE_M8"},
	{131, "THINKNODE_M9"},
	{132, "HELTEC_V4_R8"},
	{133, "HELTEC_MESH_NODE_T1"},
	{134, "STATION_G3"},
	{135, "T_IMPULSE_PLUS"},
	{136, "T_ECHO_CARD"},
	{137, "SEEED_WIO_TRACKER_L2"},
	{138, "CROWPANEL_P4"},
	{139, "HELTEC_MESH_TOWER_V2"},
	{140, "MESHNOLOGY_W10"},
	{141, "HELTEC_RC32"},
	{142, "HELTEC_RC52"},
	{143, "HELTEC_RCC6"},
	{144, "SEEED_WIO_TRACKER_L1_PRO_1W"},
	{145, "MESHNOLOGY_W12"},
	{146, "MESHPAGER_X2"},
	{147, "T_CONNECT_PRO"},
	{148, "AXIOMETA_GENESIS_MINI"},
	{149, "MAKERFABS_NOMAD_TERMINAL"},
	{150, "THINKNODE_MX"},
	{151, "NODARA"},
	{152, "HELTEC_MESH_POCKET_V2"},
	{255, "PRIVATE_HW"},
};

const char *mesh_hw_model_name(uint32_t hw_model)
{
	for (size_t i = 0; i < sizeof(hw_names) / sizeof(hw_names[0]); i++) {
		if (hw_names[i].id == hw_model) {
			return hw_names[i].name;
		}
	}
	return "UNKNOWN";
}
```

## src/mesh.c
```c
/**
 * @file mesh.c
 * @brief Meshtastic node: identity, flooding router, sending and receiving.
 * @copyright Copyright (c) 2026 Centro de Inovacao EDGE
 * SPDX-License-Identifier: Apache-2.0
 *
 * Behaves like a Meshtastic CLIENT node on the primary channel (default key):
 *  - managed flooding (src/mesh/FloodingRouter.cpp): every new packet that
 *    still has hops left is rebroadcast after an SNR-weighted random delay,
 *    and the rebroadcast is cancelled if another node relays it first;
 *  - duplicate detection by (sender, packet id);
 *  - routing ACKs for packets addressed to us that ask for one;
 *  - NODEINFO replies when a node asks for them (want_response).
 * Public-key (PKI) direct messages are relayed but cannot be read.
 */
#include <stdio.h>
#include <string.h>

#include <zephyr/kernel.h>
#include <zephyr/drivers/hwinfo.h>
#include <zephyr/sys/byteorder.h>
#include <zephyr/logging/log.h>

#include "mesh.h"
#include "meshtastic.h"
#include "nodedb.h"
#include "radio.h"

LOG_MODULE_REGISTER(mesh, LOG_LEVEL_INF);

#define HOP_LIMIT          3
#define CW_MIN             3     /* RadioInterface.h */
#define CW_MAX             8
#define TX_QUEUE_LEN       8
#define HISTORY_LEN        64
#define PENDING_ACKS       4
#define NODEINFO_REPLY_GAP_MS (5 * 60 * 1000)
#define HW_MODEL_PRIVATE   255   /* HardwareModel.PRIVATE_HW */
#define ROLE_CLIENT        0

struct tx_item {
	bool active;
	bool relay;
	uint32_t from;
	uint32_t id;
	int64_t due_ms;
	uint16_t len;
	uint8_t data[256];
};

struct seen {
	uint32_t from;
	uint32_t id;
};

static struct mesh_identity me;
static struct mesh_stats stats;
static bool relay_on = true;
static bool live_on = true;

static int32_t pos_lat, pos_lon, pos_alt;
static bool pos_set;

static struct tx_item txq[TX_QUEUE_LEN];
static struct seen history[HISTORY_LEN];
static size_t history_next;
static uint32_t pending_acks[PENDING_ACKS];
static size_t pending_next;
static struct {
	uint32_t node;
	int64_t at_ms;
} nodeinfo_replies[8];

static K_MUTEX_DEFINE(lock);
static K_SEM_DEFINE(started, 0, 1);

/* ------------------------------------------------------------- helpers */

static uint32_t rng_state;

static uint32_t rand32(void)
{
	/* xorshift32, seeded from the chip ID and the cycle counter */
	rng_state ^= rng_state << 13;
	rng_state ^= rng_state >> 17;
	rng_state ^= rng_state << 5;
	return rng_state;
}

static uint32_t rand_range(uint32_t n)
{
	return n ? rand32() % n : 0;
}

static uint32_t next_packet_id(void)
{
	static uint32_t id;

	if (id == 0) {
		id = rand32() & 0x7fffffff;
	}
	return ++id;
}

static uint8_t our_byte(void)
{
	return (uint8_t)(me.num & 0xFF);
}

static bool history_seen(uint32_t from, uint32_t id)
{
	for (size_t i = 0; i < HISTORY_LEN; i++) {
		if (history[i].id == id && history[i].from == from) {
			return true;
		}
	}
	return false;
}

static void history_add(uint32_t from, uint32_t id)
{
	history[history_next].from = from;
	history[history_next].id = id;
	history_next = (history_next + 1) % HISTORY_LEN;
}

/* SNR-weighted rebroadcast delay (RadioInterface::getTxDelayMsecWeighted, CLIENT):
 * nodes that heard the packet weakly (likely farther away) relay first.
 */
static uint32_t relay_delay_ms(int8_t snr)
{
	int32_t cw = CW_MIN + ((int32_t)snr + 20) * (CW_MAX - CW_MIN) / 30;

	cw = CLAMP(cw, CW_MIN, CW_MAX);
	return (2U * CW_MAX + rand_range(1U << cw)) * radio_slot_time_ms();
}

/* Random delay before sending our own packets (RadioInterface::getTxDelayMsec). */
static uint32_t send_delay_ms(void)
{
	return rand_range(1U << CW_MIN) * radio_slot_time_ms();
}

/* ------------------------------------------------------------ TX queue */

static int enqueue(const uint8_t *frame, size_t len, bool relay, uint32_t from, uint32_t id,
		   uint32_t delay_ms)
{
	int ret = -ENOMEM;

	k_mutex_lock(&lock, K_FOREVER);
	for (size_t i = 0; i < TX_QUEUE_LEN; i++) {
		if (!txq[i].active) {
			txq[i].active = true;
			txq[i].relay = relay;
			txq[i].from = from;
			txq[i].id = id;
			txq[i].due_ms = k_uptime_get() + delay_ms;
			txq[i].len = (uint16_t)len;
			memcpy(txq[i].data, frame, len);
			ret = 0;
			break;
		}
	}
	k_mutex_unlock(&lock);

	if (ret != 0) {
		LOG_WRN("TX queue full, packet dropped");
	}
	return ret;
}

static void cancel_relay(uint32_t from, uint32_t id)
{
	k_mutex_lock(&lock, K_FOREVER);
	for (size_t i = 0; i < TX_QUEUE_LEN; i++) {
		if (txq[i].active && txq[i].relay && txq[i].from == from && txq[i].id == id) {
			txq[i].active = false;
			stats.relays_cancelled++;
		}
	}
	k_mutex_unlock(&lock);
}

/* Build and queue one of our own packets on the primary channel. */
static int send_data(uint32_t to, uint32_t portnum, const uint8_t *payload, size_t payload_len,
		     bool want_ack, bool want_response, uint32_t request_id, uint32_t *id_out)
{
	uint8_t frame[256];
	struct mesh_tx_header hdr = {
		.to = to,
		.from = me.num,
		.id = next_packet_id(),
		.hop_limit = HOP_LIMIT,
		.want_ack = want_ack,
		.channel_hash = radio_get()->channel_hash,
		.relay_node = our_byte(),
	};
	struct mesh_tx_data data = {
		.portnum = portnum,
		.payload = payload,
		.payload_len = payload_len,
		.want_response = want_response,
		.request_id = request_id,
	};
	int len = mesh_encode(frame, sizeof(frame), &hdr, &data, mesh_default_key);

	if (len < 0) {
		return -EMSGSIZE;
	}
	if (id_out) {
		*id_out = hdr.id;
	}
	return enqueue(frame, (size_t)len, false, me.num, hdr.id, send_delay_ms());
}

static void service_tx(void)
{
	static struct tx_item item;
	int64_t now = k_uptime_get();
	int best = -1;

	k_mutex_lock(&lock, K_FOREVER);
	for (size_t i = 0; i < TX_QUEUE_LEN; i++) {
		if (txq[i].active && txq[i].due_ms <= now &&
		    (best < 0 || txq[i].due_ms < txq[best].due_ms)) {
			best = (int)i;
		}
	}
	if (best >= 0) {
		item = txq[best];
		txq[best].active = false;
	}
	k_mutex_unlock(&lock);

	if (best < 0) {
		return;
	}

		/* Listen before talk: someone is transmitting, try again a bit later.
	 * After several attempts in a row, send anyway rather than starve.
	 */
	static int busy_streak;

	if (radio_channel_busy() && busy_streak < 10) {
		busy_streak++;
		LOG_DBG("Channel busy, retrying later (%d)", busy_streak);
		enqueue(item.data, item.len, item.relay, item.from, item.id,
			radio_airtime_ms(64) + send_delay_ms());
		return;
	}
	
	busy_streak = 0;

	if (radio_transmit(item.data, item.len) == 0) {
		if (item.relay) {
			stats.relayed++;
			LOG_DBG("Relayed !%08x id %08x", item.from, item.id);
		} else {
			stats.sent++;
			history_add(item.from, item.id); /* so our own echoes are not new */
		}
	}
}

/* --------------------------------------------------------------- receive */

static const char *name_of(uint32_t num, char *buf, size_t size)
{
	struct node_entry n;

	if (nodedb_get(num, &n) && n.has_user) {
		snprintf(buf, size, "%s", n.short_name);
	} else {
		snprintf(buf, size, "!%08x", num);
	}
	return buf;
}

static void print_packet(const struct mesh_packet *p, const struct radio_frame *f)
{
	char who[12];
	int hops = p->hop_start >= p->hop_limit && p->hop_start ? p->hop_start - p->hop_limit : -1;

	name_of(p->from, who, sizeof(who));
	if (!p->decrypted) {
		LOG_INF("%-9s ch=0x%02x (other channel/PKI) hops=%d %d dBm %d dB", who,
			p->channel_hash, hops, f->rssi, f->snr);
		return;
	}
	switch (p->kind) {
	case MESH_INFO_USER:
		LOG_INF("%-9s NODEINFO \"%s\" %s hops=%d %d dBm %d dB", who,
			p->info.user.long_name, mesh_hw_model_name(p->info.user.hw_model), hops,
			f->rssi, f->snr);
		break;
	case MESH_INFO_TEXT:
		LOG_INF("%-9s %s: \"%s\" hops=%d %d dBm %d dB", who,
			p->to == me.num ? "DM to you" : "TEXT", p->info.text, hops, f->rssi, f->snr);
		break;
	case MESH_INFO_BATTERY:
		LOG_INF("%-9s TELEMETRY battery=%u%% hops=%d %d dBm %d dB", who,
			p->info.battery_level, hops, f->rssi, f->snr);
		break;
	default:
		LOG_INF("%-9s %s hops=%d %d dBm %d dB", who, mesh_port_name(p->portnum), hops,
			f->rssi, f->snr);
		break;
	}
}

static bool nodeinfo_reply_allowed(uint32_t node)
{
	int64_t now = k_uptime_get();
	size_t oldest = 0;

	for (size_t i = 0; i < ARRAY_SIZE(nodeinfo_replies); i++) {
		if (nodeinfo_replies[i].node == node) {
			if (now - nodeinfo_replies[i].at_ms < NODEINFO_REPLY_GAP_MS) {
				return false;
			}
			nodeinfo_replies[i].at_ms = now;
			return true;
		}
		if (nodeinfo_replies[i].at_ms < nodeinfo_replies[oldest].at_ms) {
			oldest = i;
		}
	}
	nodeinfo_replies[oldest].node = node;
	nodeinfo_replies[oldest].at_ms = now;
	return true;
}

static void check_ack(const struct mesh_packet *p)
{
	char who[12];

	k_mutex_lock(&lock, K_FOREVER);
	for (size_t i = 0; i < PENDING_ACKS; i++) {
		if (pending_acks[i] != 0 && pending_acks[i] == p->request_id) {
			pending_acks[i] = 0;
			k_mutex_unlock(&lock);
			if (p->info.routing_error == 0) {
				LOG_INF("ACK from %s for message id %08x", name_of(p->from, who, sizeof(who)),
					p->request_id);
			} else {
				LOG_WRN("NAK from %s for id %08x (error %u)",
					name_of(p->from, who, sizeof(who)), p->request_id,
					p->info.routing_error);
			}
			return;
		}
	}
	k_mutex_unlock(&lock);
}

static void deliver(const struct mesh_packet *p)
{
	bool for_us = p->to == me.num;
	bool broadcast = p->to == MESH_BROADCAST;

	if (!p->decrypted || !(for_us || broadcast)) {
		return;
	}

	if (p->kind == MESH_INFO_ROUTING && for_us) {
		check_ack(p);
	}

	if (p->portnum == PORT_NODEINFO && p->want_response && nodeinfo_reply_allowed(p->from)) {
		mesh_send_nodeinfo(p->from, false);
	}

	if (for_us && p->want_ack && p->portnum != PORT_ROUTING) {
		uint8_t ack[8];
		size_t n = mesh_build_routing_ack(ack, sizeof(ack));

		send_data(p->from, PORT_ROUTING, ack, n, false, false, p->id, NULL);
	}
}

static void maybe_relay(const struct radio_frame *raw, const struct mesh_packet *p)
{
	uint8_t frame[256];

	if (!relay_on || p->to == me.num || p->hop_limit == 0) {
		return;
	}
	/* Next-hop routing (2.6+): only the chosen relay forwards directed packets. */
	if (p->next_hop != 0 && p->next_hop != our_byte()) {
		return;
	}

	/* Rebroadcast the original encrypted bytes, one hop less, with us as relay. */
	memcpy(frame, raw->data, raw->len);
	frame[12] = (frame[12] & ~0x07) | ((p->hop_limit - 1) & 0x07);
	frame[15] = our_byte();
	enqueue(frame, raw->len, true, p->from, p->id, relay_delay_ms(raw->snr));
}

static void handle_rx(const struct radio_frame *f)
{
	static struct mesh_packet pkt;
	static uint8_t buf[256];
	char who[12];

	memcpy(buf, f->data, f->len);
	if (mesh_decode(buf, f->len, radio_get()->channel_hash, mesh_default_key, &pkt) < 0) {
		return; /* shorter than a Meshtastic header */
	}

	if (pkt.from == me.num) {
		/* Our own packet coming back: another node relayed it (implicit ACK). */
		if (live_on && pkt.relay_node != our_byte()) {
			LOG_INF("Our packet %08x was relayed by node ..%02x", pkt.id, pkt.relay_node);
		}
		return;
	}

	if (history_seen(pkt.from, pkt.id)) {
		stats.duplicates++;
		cancel_relay(pkt.from, pkt.id); /* someone else already relayed it */
		nodedb_update(&pkt, f->rssi, f->snr);
		return;
	}
	history_add(pkt.from, pkt.id);

	stats.received++;
	if (pkt.decrypted) {
		stats.decrypted++;
	} else {
		stats.other_channel++;
	}

	if (nodedb_update(&pkt, f->rssi, f->snr)) {
		LOG_INF("New node: %s", name_of(pkt.from, who, sizeof(who)));
	}
	if (live_on || (pkt.kind == MESH_INFO_TEXT)) {
		print_packet(&pkt, f);
	}

	deliver(&pkt);
	maybe_relay(f, &pkt);
}

/* --------------------------------------------------------------- thread */

static void mesh_thread(void *a, void *b, void *c)
{
	static struct radio_frame frame;

	ARG_UNUSED(a);
	ARG_UNUSED(b);
	ARG_UNUSED(c);

	k_sem_take(&started, K_FOREVER);
	while (1) {
		radio_wait_event(10);
		if (radio_poll_rx(&frame)) {
			handle_rx(&frame);
		}
		service_tx();
	}
}

K_THREAD_DEFINE(mesh_tid, 4096, mesh_thread, NULL, NULL, NULL, 6, 0, 0);

/* ------------------------------------------------------------ public API */

void mesh_start(void)
{
	uint8_t id[16] = {0};
	ssize_t n = hwinfo_get_device_id(id, sizeof(id));

	/* Node number: last 4 bytes of the chip unique ID (like the MAC on an ESP32). */
	if (n >= 4) {
		me.num = sys_get_be32(&id[n - 4]);
	}
	if (me.num == 0 || me.num == MESH_BROADCAST) {
		me.num = 0x2b2b0000 | (k_cycle_get_32() & 0xFFFF);
	}
	rng_state = me.num ^ k_cycle_get_32() ^ 0x9e3779b9;
	if (rng_state == 0) {
		rng_state = 0x1234567;
	}

	snprintf(me.short_name, sizeof(me.short_name), "%04x", me.num & 0xFFFF);
	snprintf(me.long_name, sizeof(me.long_name), "ZBook %s", me.short_name);

	LOG_INF("This node: !%08x \"%s\" (%s)", me.num, me.long_name, me.short_name);
	k_sem_give(&started);
}

const struct mesh_identity *mesh_identity(void)
{
	return &me;
}

void mesh_set_name(const char *long_name, const char *short_name)
{
	k_mutex_lock(&lock, K_FOREVER);
	snprintf(me.long_name, sizeof(me.long_name), "%s", long_name);
	if (short_name) {
		snprintf(me.short_name, sizeof(me.short_name), "%s", short_name);
	}
	k_mutex_unlock(&lock);
}

int mesh_send_text(uint32_t to, const char *text, bool want_ack, uint32_t *id_out)
{
	uint32_t id = 0;
	size_t len = strlen(text);
	int ret;

	if (len == 0 || len > 200) {
		return -EINVAL;
	}
	ret = send_data(to, PORT_TEXT_MESSAGE, (const uint8_t *)text, len, want_ack, false, 0, &id);
	if (ret == 0 && want_ack) {
		k_mutex_lock(&lock, K_FOREVER);
		pending_acks[pending_next] = id;
		pending_next = (pending_next + 1) % PENDING_ACKS;
		k_mutex_unlock(&lock);
	}
	if (id_out) {
		*id_out = id;
	}
	return ret;
}

int mesh_send_nodeinfo(uint32_t to, bool want_response)
{
	uint8_t payload[96];
	size_t n;

	k_mutex_lock(&lock, K_FOREVER);
	n = mesh_build_user(payload, sizeof(payload), me.num, me.long_name, me.short_name,
			    HW_MODEL_PRIVATE, ROLE_CLIENT);
	k_mutex_unlock(&lock);
	if (n == 0) {
		return -EMSGSIZE;
	}
	return send_data(to, PORT_NODEINFO, payload, n, false, want_response, 0, NULL);
}

int mesh_send_position(uint32_t to)
{
	uint8_t payload[32];
	size_t n;

	if (!pos_set) {
		return -ENODATA;
	}
	n = mesh_build_position(payload, sizeof(payload), pos_lat, pos_lon, pos_alt, true);
	return send_data(to, PORT_POSITION, payload, n, false, false, 0, NULL);
}

void mesh_set_position(int32_t lat_i, int32_t lon_i, int32_t alt_m)
{
	pos_lat = lat_i;
	pos_lon = lon_i;
	pos_alt = alt_m;
	pos_set = true;
}

void mesh_clear_position(void)
{
	pos_set = false;
}

bool mesh_has_position(void)
{
	return pos_set;
}

void mesh_set_relay(bool on)
{
	relay_on = on;
}

bool mesh_relay_enabled(void)
{
	return relay_on;
}

void mesh_set_live(bool on)
{
	live_on = on;
}

void mesh_get_stats(struct mesh_stats *s)
{
	*s = stats;
}
```

## src/mesh.h
```c
/**
 * @file mesh.h
 * @brief Meshtastic node: identity, flooding router, sending and receiving.
 * @copyright Copyright (c) 2026 Centro de Inovacao EDGE
 * SPDX-License-Identifier: Apache-2.0
 */
#ifndef MESH_H_
#define MESH_H_

#include <stdbool.h>
#include <stdint.h>

struct mesh_identity {
	uint32_t num;            /* node number, from the chip unique ID */
	char long_name[40];
	char short_name[5];
};

struct mesh_stats {
	uint32_t received;       /* new packets (duplicates excluded) */
	uint32_t decrypted;
	uint32_t other_channel;
	uint32_t duplicates;
	uint32_t relayed;
	uint32_t relays_cancelled;
	uint32_t sent;           /* our own packets */
};

/** Initialize the identity and start the mesh thread (radio must be up). */
void mesh_start(void);

const struct mesh_identity *mesh_identity(void);
void mesh_set_name(const char *long_name, const char *short_name);

/** Queue packets for transmission. Return 0 or a negative errno. */
int mesh_send_text(uint32_t to, const char *text, bool want_ack, uint32_t *id_out);
int mesh_send_nodeinfo(uint32_t to, bool want_response);
int mesh_send_position(uint32_t to);

/** Fixed position to announce (degrees * 1e7). */
void mesh_set_position(int32_t lat_i, int32_t lon_i, int32_t alt_m);
void mesh_clear_position(void);
bool mesh_has_position(void);

void mesh_set_relay(bool on);
bool mesh_relay_enabled(void);
void mesh_set_live(bool on);

void mesh_get_stats(struct mesh_stats *s);

#endif /* MESH_H_ */
```

## src/meshtastic.h
```c
/**
 * @file meshtastic.h
 * @brief Meshtastic over-the-air packets: decoding and encoding.
 * @copyright Copyright (c) 2026 Centro de Inovacao EDGE
 * SPDX-License-Identifier: Apache-2.0
 *
 * Over-the-air frame (src/mesh/RadioInterface.h, meshtastic/firmware):
 *   16-byte header, all fields little-endian:
 *     to(4) from(4) id(4) flags(1) channel_hash(1) next_hop(1) relay_node(1)
 *   then the payload: a `Data` protobuf, AES-CTR encrypted with the channel key.
 */
#ifndef MESHTASTIC_H_
#define MESHTASTIC_H_

#include <stdbool.h>
#include <stddef.h>
#include <stdint.h>

#define MESH_HEADER_LEN   16
#define MESH_BROADCAST    0xFFFFFFFFu

/* PortNum values (meshtastic/portnums.proto) */
#define PORT_TEXT_MESSAGE 1
#define PORT_POSITION     3
#define PORT_NODEINFO     4
#define PORT_ROUTING      5
#define PORT_TELEMETRY    67
#define PORT_TRACEROUTE   70
#define PORT_NEIGHBORINFO 71
#define PORT_MAP_REPORT   73

enum mesh_info_kind {
	MESH_INFO_NONE = 0,
	MESH_INFO_USER,
	MESH_INFO_POSITION,
	MESH_INFO_TEXT,
	MESH_INFO_BATTERY,
	MESH_INFO_ROUTING,
};

struct mesh_packet {
	/* Header */
	uint32_t to;
	uint32_t from;
	uint32_t id;
	uint8_t hop_limit;
	uint8_t hop_start;
	bool want_ack;
	bool via_mqtt;
	uint8_t channel_hash;
	uint8_t next_hop;
	uint8_t relay_node;

	/* Payload */
	bool decrypted;   /* decrypted with our channel key and parsed as Data */
	uint32_t portnum;
	bool want_response;
	uint32_t request_id;    /* for replies and ACKs: id of the original packet */
	enum mesh_info_kind kind;
	union {
		struct {
			char id[16];
			char long_name[40];
			char short_name[8];
			uint32_t hw_model;
			uint32_t role;
		} user;
		struct {
			int32_t lat_i;   /* degrees * 1e7 */
			int32_t lon_i;   /* degrees * 1e7 */
			int32_t alt_m;
			bool has_alt;
		} pos;
		char text[200];
		uint32_t battery_level; /* percent; 101 = powered */
		uint32_t routing_error; /* Routing.error_reason, 0 = ACK */
	} info;
};

/** djb2 hash used by Meshtastic to pick the frequency slot from the channel name. */
uint32_t mesh_djb2(const char *str);

/** Channel hash: XOR of the channel name bytes XOR the key bytes. */
uint8_t mesh_channel_hash(const char *channel_name, const uint8_t *key, size_t key_len);

/** The well-known default channel key ("AQ==", PSK index 1). */
extern const uint8_t mesh_default_key[16];

/**
 * Parse the header and, if channel_hash matches, decrypt and decode the payload.
 *
 * @param buf          Received frame. The payload part is decrypted in place.
 * @param len          Frame length.
 * @param channel_hash Hash of the channel we hold the key for.
 * @param key          AES-128 channel key.
 * @param out          Decoded packet.
 * @return 0 on success (header valid), negative if the frame is too short.
 */
int mesh_decode(uint8_t *buf, size_t len, uint8_t channel_hash, const uint8_t key[16],
		struct mesh_packet *out);

/** Payload of an outgoing packet (the Data protobuf, before encryption). */
struct mesh_tx_data {
	uint32_t portnum;
	const uint8_t *payload;
	size_t payload_len;
	bool want_response;
	uint32_t request_id;
};

/** Header fields of an outgoing packet. */
struct mesh_tx_header {
	uint32_t to;
	uint32_t from;
	uint32_t id;
	uint8_t hop_limit;      /* also used as hop_start */
	bool want_ack;
	uint8_t channel_hash;
	uint8_t relay_node;     /* last byte of our node number */
};

/**
 * Build a complete over-the-air frame: header + encrypted Data protobuf.
 * @return frame length, or a negative value if it does not fit.
 */
int mesh_encode(uint8_t *out, size_t out_size, const struct mesh_tx_header *hdr,
		const struct mesh_tx_data *data, const uint8_t key[16]);

/** Payload builders. Each returns the payload length (0 on overflow). */
size_t mesh_build_user(uint8_t *buf, size_t size, uint32_t node_num, const char *long_name,
		       const char *short_name, uint32_t hw_model, uint32_t role);
size_t mesh_build_position(uint8_t *buf, size_t size, int32_t lat_i, int32_t lon_i,
			   int32_t alt_m, bool has_alt);
size_t mesh_build_routing_ack(uint8_t *buf, size_t size);

/** Short name for a port number ("NODEINFO", "POSITION", ...). */
const char *mesh_port_name(uint32_t portnum);

/** Device role name ("CLIENT", "ROUTER", ...). */
const char *mesh_role_name(uint32_t role);

/** Hardware model name from meshtastic/mesh.proto HardwareModel. */
const char *mesh_hw_model_name(uint32_t hw_model);

#endif /* MESHTASTIC_H_ */
```

## src/nodedb.h
```c
/**
 * @file nodedb.h
 * @brief Table of Meshtastic nodes heard over the air.
 * @copyright Copyright (c) 2026 Centro de Inovacao EDGE
 * SPDX-License-Identifier: Apache-2.0
 */
#ifndef NODEDB_H_
#define NODEDB_H_

#include <stdbool.h>
#include <stdint.h>

#include "meshtastic.h"

#define NODEDB_MAX_NODES 64

struct node_entry {
	uint32_t num;
	char long_name[40];
	char short_name[8];
	uint32_t hw_model;
	uint32_t role;
	bool has_user;

	int64_t last_heard_ms;   /* k_uptime_get() */
	uint32_t packets;
	uint32_t last_id;

	int16_t rssi;            /* last direct (0-hop) reception */
	int8_t snr;
	bool has_signal;
	int8_t hops_away;        /* -1 unknown */
	uint8_t last_relay;      /* relay_node byte of the last relayed packet */

	int32_t lat_i;
	int32_t lon_i;
	int32_t alt_m;
	bool has_pos;

	uint32_t battery_level;
	bool has_battery;

	uint32_t last_port;
	bool last_decrypted;
};

/** Update the table with a decoded packet. Returns true for a new node. */
bool nodedb_update(const struct mesh_packet *pkt, int16_t rssi, int8_t snr);

/**
 * Copy the table, most recently heard first.
 * @return number of entries copied.
 */
int nodedb_snapshot(struct node_entry *out, int max);

/** Copy one node. Returns false if unknown. */
bool nodedb_get(uint32_t num, struct node_entry *out);

void nodedb_clear(void);

#endif /* NODEDB_H_ */
```

## src/pb.h
```c
/**
 * @file pb.h
 * @brief Tiny protobuf wire-format reader and writer.
 * @copyright Copyright (c) 2026 Centro de Inovacao EDGE
 * SPDX-License-Identifier: Apache-2.0
 */
#ifndef PB_H_
#define PB_H_

#include <stdbool.h>
#include <stddef.h>
#include <stdint.h>

enum pb_wire {
	PB_VARINT = 0,
	PB_FIXED64 = 1,
	PB_LEN = 2,
	PB_FIXED32 = 5,
};

/** One decoded field. For PB_LEN, data/len point into the input buffer. */
struct pb_field {
	uint32_t num;
	enum pb_wire wire;
	uint64_t value;      /* PB_VARINT, PB_FIXED32, PB_FIXED64 */
	const uint8_t *data; /* PB_LEN */
	size_t len;          /* PB_LEN */
};

struct pb_reader {
	const uint8_t *p;
	const uint8_t *end;
	bool error;
};

void pb_reader_init(struct pb_reader *r, const uint8_t *buf, size_t len);

/**
 * Read the next field.
 * @return true if a field was read; false at end of buffer or on malformed
 *         input (check r->error to tell the two apart).
 */
bool pb_next(struct pb_reader *r, struct pb_field *f);

/** Copy a PB_LEN field into a NUL-terminated string, truncating if needed. */
void pb_copy_string(const struct pb_field *f, char *dst, size_t dst_size);

/** Append-only protobuf writer into a fixed buffer. */
struct pb_writer {
	uint8_t *buf;
	size_t size;
	size_t len;
	bool overflow;
};

void pb_writer_init(struct pb_writer *w, uint8_t *buf, size_t size);
void pb_write_varint(struct pb_writer *w, uint32_t field, uint64_t value);
void pb_write_fixed32(struct pb_writer *w, uint32_t field, uint32_t value);
void pb_write_bytes(struct pb_writer *w, uint32_t field, const void *data, size_t len);
void pb_write_string(struct pb_writer *w, uint32_t field, const char *str);

#endif /* PB_H_ */
```
