## CMakeLists.txt
```
# Copyright (c) 2026 Centro de Inovacao EDGE
# SPDX-License-Identifier: Apache-2.0

cmake_minimum_required(VERSION 3.20.0)

find_package(Zephyr REQUIRED HINTS $ENV{ZEPHYR_BASE})
project(mesh_scanner)

target_sources(app PRIVATE
  src/main.c
  src/radio.c
  src/meshtastic.c
  src/nodedb.c
  src/pb.c
  src/aes128.c
  src/hw_models.c
)
```

## prj.conf
```kconfig
# Copyright (c) 2026 Centro de Inovacao EDGE
# SPDX-License-Identifier: Apache-2.0

# The RFM95W is driven directly over SPI (polling, no DIO0), so the Zephyr
# LoRa driver enabled by default by the zbook_lora shield is left out.
CONFIG_LORA=n
CONFIG_SPI=y
CONFIG_GPIO=y

# Interactive console on the PROG USB serial port
CONFIG_SHELL=y
CONFIG_SHELL_STACK_SIZE=4096
CONFIG_SHELL_BACKEND_SERIAL=y
CONFIG_GPIO_SHELL=y

# Logs go through the shell
CONFIG_LOG=y
CONFIG_LOG_BUFFER_SIZE=4096

CONFIG_MAIN_STACK_SIZE=2048
```

## src/main.c
```c
/**
 * @file main.c
 *
 * @brief Meshtastic node scanner for the ZBook + RFM95W (receive only).
 *
 * Listens on a Meshtastic channel (default: LongFast, default key), decodes
 * the packets it can and keeps a table of the nodes heard. The table and the
 * radio settings are available through the Zephyr shell ("mesh" commands).
 * Nothing is ever transmitted.
 *
 * @author Vinicius RM Carvalho
 * @date 2026-11-11
 * @copyright Copyright (c) 2026 Centro de Inovacao EDGE
 * SPDX-License-Identifier: Apache-2.0
 */
#include <stdlib.h>
#include <string.h>

#include <zephyr/kernel.h>
#include <zephyr/logging/log.h>
#include <zephyr/shell/shell.h>

#include "meshtastic.h"
#include "nodedb.h"
#include "radio.h"

LOG_MODULE_REGISTER(mesh, LOG_LEVEL_INF);

#define DEFAULT_REGION "US"
#define DEFAULT_PRESET "LongFast"

static bool live_output = true;
static uint32_t stat_frames, stat_decrypted, stat_other_channel, stat_bad;

/* ---------------------------------------------------------------- helpers */

/* Degrees * 1e7 -> "-9.64980" without floating point. */
static void fmt_coord(char *buf, size_t size, int32_t v)
{
	uint32_t a = v < 0 ? (uint32_t)(-(int64_t)v) : (uint32_t)v;

	snprintk(buf, size, "%s%u.%05u", v < 0 ? "-" : "", a / 10000000U, (a % 10000000U) / 100U);
}

static void fmt_ago(char *buf, size_t size, int64_t since_ms)
{
	int s = (int)((k_uptime_get() - since_ms) / 1000);

	if (s < 60) {
		snprintk(buf, size, "%ds", s);
	} else if (s < 3600) {
		snprintk(buf, size, "%dm", s / 60);
	} else {
		snprintk(buf, size, "%dh", s / 3600);
	}
}

static bool parse_node_id(const char *s, uint32_t *num)
{
	char *end;

	if (*s == '!') {
		s++;
	}
	*num = strtoul(s, &end, 16);
	return *s != '\0' && *end == '\0';
}

/* ------------------------------------------------------------ RX thread */

static void print_packet(const struct mesh_packet *p, const struct radio_frame *f)
{
	struct node_entry n;
	const char *name = "";
	int hops = p->hop_start >= p->hop_limit && p->hop_start ? p->hop_start - p->hop_limit : -1;
	char coord_lat[16], coord_lon[16];

	if (nodedb_get(p->from, &n) && n.has_user) {
		name = n.short_name;
	}

	if (!p->decrypted) {
		LOG_INF("!%08x %-4s ch=0x%02x (other channel/encrypted) hops=%d %d dBm %d dB",
			p->from, name, p->channel_hash, hops, f->rssi, f->snr);
		return;
	}

	switch (p->kind) {
	case MESH_INFO_USER:
		LOG_INF("!%08x %-4s NODEINFO \"%s\" %s %s hops=%d %d dBm %d dB", p->from, name,
			p->info.user.long_name, mesh_hw_model_name(p->info.user.hw_model),
			mesh_role_name(p->info.user.role), hops, f->rssi, f->snr);
		break;
	case MESH_INFO_POSITION:
		fmt_coord(coord_lat, sizeof(coord_lat), p->info.pos.lat_i);
		fmt_coord(coord_lon, sizeof(coord_lon), p->info.pos.lon_i);
		LOG_INF("!%08x %-4s POSITION %s, %s hops=%d %d dBm %d dB", p->from, name,
			coord_lat, coord_lon, hops, f->rssi, f->snr);
		break;
	case MESH_INFO_TEXT:
		LOG_INF("!%08x %-4s TEXT \"%s\" hops=%d %d dBm %d dB", p->from, name,
			p->info.text, hops, f->rssi, f->snr);
		break;
	case MESH_INFO_BATTERY:
		LOG_INF("!%08x %-4s TELEMETRY battery=%u%% hops=%d %d dBm %d dB", p->from, name,
			p->info.battery_level, hops, f->rssi, f->snr);
		break;
	default:
		LOG_INF("!%08x %-4s %s hops=%d %d dBm %d dB", p->from, name,
			mesh_port_name(p->portnum), hops, f->rssi, f->snr);
		break;
	}
}

/* Raw test mode (sync word other than Meshtastic's): show the frame as is. */
static void print_raw_frame(const struct radio_frame *f)
{
	char hex[3 * 32 + 1];
	char text[32 + 1];
	size_t n = MIN(f->len, 32U);

	for (size_t i = 0; i < n; i++) {
		snprintk(&hex[3 * i], 4, "%02x ", f->data[i]);
		text[i] = (f->data[i] >= 0x20 && f->data[i] < 0x7F) ? f->data[i] : '.';
	}
	hex[3 * n] = '\0';
	text[n] = '\0';

	LOG_INF("RAW %u bytes, %d dBm, SNR %d dB: %s| %s%s", f->len, f->rssi, f->snr, hex, text,
		f->len > n ? " ..." : "");
}

static void rx_thread(void *a, void *b, void *c)
{
	static struct radio_frame frame;
	static struct mesh_packet pkt;

	ARG_UNUSED(a);
	ARG_UNUSED(b);
	ARG_UNUSED(c);

	while (1) {
		if (radio_get_frame(&frame, -1) != 0) {
			continue;
		}
		stat_frames++;

		if (radio_get()->sync_word != MESHTASTIC_SYNC_WORD) {
			print_raw_frame(&frame);
			continue;
		}

		if (mesh_decode(frame.data, frame.len, radio_get()->channel_hash, mesh_default_key,
				&pkt) < 0) {
			stat_bad++;
			if (live_output) {
				LOG_WRN("Frame too short (%u bytes), not Meshtastic", frame.len);
			}
			continue;
		}

		if (pkt.decrypted) {
			stat_decrypted++;
		} else {
			stat_other_channel++;
		}

		if (nodedb_update(&pkt, frame.rssi, frame.snr)) {
			LOG_INF("New node: !%08x", pkt.from);
		}
		if (live_output) {
			print_packet(&pkt, &frame);
		}
	}
}

K_THREAD_DEFINE(rx_tid, 4096, rx_thread, NULL, NULL, NULL, 7, 0, 0);

/* --------------------------------------------------------------- shell */

static int cmd_nodes(const struct shell *sh, size_t argc, char **argv)
{
	static struct node_entry list[NODEDB_MAX_NODES];
	int n = nodedb_snapshot(list, ARRAY_SIZE(list));
	char ago[8], rssi[8], snr[8], hops[4];

	ARG_UNUSED(argc);
	ARG_UNUSED(argv);

	if (n == 0) {
		shell_print(sh, "No nodes heard yet.");
		return 0;
	}

	shell_print(sh, "%-10s %-5s %-24s %4s %5s %4s %5s %5s  %s", "ID", "Short", "Long name",
		    "Hops", "RSSI", "SNR", "Seen", "Pkts", "Hardware");
	for (int i = 0; i < n; i++) {
		const struct node_entry *e = &list[i];

		fmt_ago(ago, sizeof(ago), e->last_heard_ms);
		if (e->hops_away < 0) {
			strcpy(hops, "?");
		} else {
			snprintk(hops, sizeof(hops), "%d", e->hops_away);
		}
		if (e->has_signal) {
			snprintk(rssi, sizeof(rssi), "%d", e->rssi);
			snprintk(snr, sizeof(snr), "%d", e->snr);
		} else {
			strcpy(rssi, "-");
			strcpy(snr, "-");
		}
		shell_print(sh, "!%08x  %-5s %-24.24s %4s %5s %4s %5s %5u  %s", e->num,
			    e->has_user ? e->short_name : "?", e->has_user ? e->long_name : "",
			    hops, rssi, snr, ago, e->packets,
			    e->has_user ? mesh_hw_model_name(e->hw_model) : "");
	}
	shell_print(sh, "%d node(s). RSSI/SNR only for nodes heard directly (0 hops).", n);
	return 0;
}

static int cmd_node(const struct shell *sh, size_t argc, char **argv)
{
	struct node_entry e;
	uint32_t num;
	char ago[8], lat[16], lon[16];

	if (!parse_node_id(argv[1], &num)) {
		shell_error(sh, "Invalid node id: %s (use !a1b2c3d4)", argv[1]);
		return -EINVAL;
	}
	if (!nodedb_get(num, &e)) {
		shell_error(sh, "Node !%08x not heard yet", num);
		return -ENOENT;
	}

	fmt_ago(ago, sizeof(ago), e.last_heard_ms);
	shell_print(sh, "Node      : !%08x", e.num);
	if (e.has_user) {
		shell_print(sh, "Name      : %s (%s)", e.long_name, e.short_name);
		shell_print(sh, "Hardware  : %s", mesh_hw_model_name(e.hw_model));
		shell_print(sh, "Role      : %s", mesh_role_name(e.role));
	} else {
		shell_print(sh, "Name      : unknown (no NODEINFO heard yet)");
	}
	shell_print(sh, "Last heard: %s ago, %u packet(s), last port %s%s", ago, e.packets,
		    mesh_port_name(e.last_port), e.last_decrypted ? "" : " (not decrypted)");
	if (e.hops_away >= 0) {
		shell_print(sh, "Hops away : %d", e.hops_away);
	}
	if (e.has_signal) {
		shell_print(sh, "Signal    : %d dBm, SNR %d dB (direct)", e.rssi, e.snr);
	} else {
		shell_print(sh, "Signal    : only heard through relays (last relay ..%02x)",
			    e.last_relay);
	}
	if (e.has_pos) {
		fmt_coord(lat, sizeof(lat), e.lat_i);
		fmt_coord(lon, sizeof(lon), e.lon_i);
		shell_print(sh, "Position  : %s, %s, %d m", lat, lon, e.alt_m);
	}
	if (e.has_battery) {
		shell_print(sh, "Battery   : %u%%", e.battery_level);
	}
	return 0;
}

static int cmd_radio(const struct shell *sh, size_t argc, char **argv)
{
	const struct radio_state *s = radio_get();

	ARG_UNUSED(argc);
	ARG_UNUSED(argv);

	shell_print(sh, "Region   : %s", s->region->name);
	shell_print(sh, "Preset   : %s (SF%u, BW %u kHz, CR 4/%u)", s->preset->name,
		    s->preset->sf, s->preset->bw_khz, s->preset->cr);
	shell_print(sh, "Frequency: %u.%03u MHz (slot %u of %u)", s->freq_hz / 1000000U,
		    (s->freq_hz / 1000U) % 1000U, s->slot + 1, s->num_slots);
	shell_print(sh, "Channel  : hash 0x%02x, default key", s->channel_hash);
	shell_print(sh, "Sync word: 0x%02x%s", s->sync_word,
		    s->sync_word == MESHTASTIC_SYNC_WORD ? " (Meshtastic)" : " (raw test mode)");
	shell_print(sh, "Frames   : %u total, %u decrypted, %u other channel, %u invalid",
		    stat_frames, stat_decrypted, stat_other_channel, stat_bad);
	shell_print(sh, "CRC errors: %u (packets heard but corrupted)", radio_crc_errors());
	return 0;
}

static int cmd_region(const struct shell *sh, size_t argc, char **argv)
{
	const struct mesh_region *r = radio_find_region(argv[1]);

	if (r == NULL) {
		shell_error(sh, "Unknown region. Options:");
		for (size_t i = 0; i < mesh_region_count; i++) {
			shell_print(sh, "  %s", mesh_regions[i].name);
		}
		return -EINVAL;
	}
	return radio_set(r, radio_get()->preset);
}

static int cmd_preset(const struct shell *sh, size_t argc, char **argv)
{
	const struct mesh_preset *p = radio_find_preset(argv[1]);

	if (p == NULL) {
		shell_error(sh, "Unknown preset. Options:");
		for (size_t i = 0; i < mesh_preset_count; i++) {
			shell_print(sh, "  %s", mesh_presets[i].name);
		}
		return -EINVAL;
	}
	return radio_set(radio_get()->region, p);
}

static int cmd_live(const struct shell *sh, size_t argc, char **argv)
{
	if (strcmp(argv[1], "on") == 0) {
		live_output = true;
	} else if (strcmp(argv[1], "off") == 0) {
		live_output = false;
	} else {
		shell_error(sh, "Use: mesh live on|off");
		return -EINVAL;
	}
	return 0;
}

static int cmd_scan(const struct shell *sh, size_t argc, char **argv)
{
	const struct mesh_preset *preset = radio_get()->preset;
	const struct mesh_region *best = radio_get()->region;
	uint32_t best_count = 0;
	int seconds = argc > 1 ? atoi(argv[1]) : 60;

	if (seconds <= 0) {
		shell_error(sh, "Invalid duration");
		return -EINVAL;
	}

	shell_print(sh, "Listening %d s on each region with %s...", seconds, preset->name);
	for (size_t i = 0; i < mesh_region_count; i++) {
		uint32_t before;

		if (radio_set(&mesh_regions[i], preset) < 0) {
			continue;
		}
		before = radio_rx_count();
		k_sleep(K_SECONDS(seconds));

		uint32_t heard = radio_rx_count() - before;

		shell_print(sh, "  %-7s %u.%03u MHz: %u frame(s)", mesh_regions[i].name,
			    radio_get()->freq_hz / 1000000U, (radio_get()->freq_hz / 1000U) % 1000U,
			    heard);
		if (heard > best_count) {
			best_count = heard;
			best = &mesh_regions[i];
		}
	}

	shell_print(sh, best_count ? "Staying on %s." : "Nothing heard; back to %s.", best->name);
	return radio_set(best, preset);
}

static void diag_line(const struct shell *sh, const char *name, uint32_t got, uint32_t want,
		      int width)
{
	shell_print(sh, "  %-14s 0x%0*x  (expected 0x%0*x)  %s", name, width, got, width, want,
		    got == want ? "OK" : "<-- MISMATCH");
}

static int cmd_diag(const struct shell *sh, size_t argc, char **argv)
{
	struct radio_diag d, want;
	int seconds = argc > 1 ? atoi(argv[1]) : 10;

	if (radio_read_diag(&d) < 0) {
		shell_error(sh, "SPI error while reading the radio");
		return -EIO;
	}
	radio_expected_diag(&want);

	shell_print(sh, "SX1276 registers (version 0x%02x):", d.version);
	diag_line(sh, "OpMode", d.op_mode, want.op_mode, 2);
	diag_line(sh, "Frequency", d.frf, want.frf, 6);
	diag_line(sh, "ModemConfig1", d.modem_config_1, want.modem_config_1, 2);
	diag_line(sh, "ModemConfig2", d.modem_config_2, want.modem_config_2, 2);
	diag_line(sh, "ModemConfig3", d.modem_config_3, want.modem_config_3, 2);
	diag_line(sh, "SyncWord", d.sync_word, want.sync_word, 2);
	diag_line(sh, "Preamble", d.preamble, want.preamble, 4);
	shell_print(sh, "Since RX started: %u valid header(s), %u packet(s) with good CRC",
		    d.valid_headers, d.valid_packets);

	shell_print(sh, "Channel RSSI for %d s (noise floor is usually -125..-105 dBm):", seconds);
	for (int i = 0; i < seconds; i++) {
		if (radio_read_diag(&d) == 0) {
			shell_print(sh, "  %2d s: %4d dBm%s", i + 1, d.rssi_now,
				    (d.modem_stat & 0x01) ? "  (LoRa signal detected)" : "");
		}
		k_sleep(K_SECONDS(1));
	}
	return 0;
}

static int cmd_sync(const struct shell *sh, size_t argc, char **argv)
{
	char *end;
	unsigned long v = strtoul(argv[1], &end, 16);

	if (*argv[1] == '\0' || *end != '\0' || v == 0 || v > 0xFF) {
		shell_error(sh, "Use a hex byte: mesh sync 2b (Meshtastic) or mesh sync 12");
		return -EINVAL;
	}
	return radio_set_sync_word((uint8_t)v);
}

static int cmd_clear(const struct shell *sh, size_t argc, char **argv)
{
	ARG_UNUSED(argc);
	ARG_UNUSED(argv);

	nodedb_clear();
	stat_frames = stat_decrypted = stat_other_channel = stat_bad = 0;
	shell_print(sh, "Node table cleared.");
	return 0;
}

SHELL_STATIC_SUBCMD_SET_CREATE(mesh_cmds,
	SHELL_CMD(nodes, NULL, "List the nodes heard", cmd_nodes),
	SHELL_CMD_ARG(node, NULL, "Details of one node: mesh node !a1b2c3d4", cmd_node, 2, 0),
	SHELL_CMD(radio, NULL, "Radio settings and counters", cmd_radio),
	SHELL_CMD_ARG(region, NULL, "Set region: US | ANZ | BR_902", cmd_region, 2, 0),
	SHELL_CMD_ARG(preset, NULL, "Set modem preset: LongFast, MediumFast, ...", cmd_preset, 2, 0),
	SHELL_CMD_ARG(live, NULL, "Print each packet: mesh live on|off", cmd_live, 2, 0),
	SHELL_CMD_ARG(scan, NULL, "Try every region: mesh scan [seconds per region]", cmd_scan, 1, 1),
	SHELL_CMD_ARG(diag, NULL, "Check radio registers and RSSI: mesh diag [seconds]", cmd_diag, 1, 1),
	SHELL_CMD_ARG(sync, NULL, "Sync word in hex: 2b = Meshtastic, other = raw test mode",
		      cmd_sync, 2, 0),
	SHELL_CMD(clear, NULL, "Clear the node table and counters", cmd_clear),
	SHELL_SUBCMD_SET_END);

SHELL_CMD_REGISTER(mesh, &mesh_cmds, "Meshtastic scanner", NULL);

/* ---------------------------------------------------------------- main */

int main(void)
{
	int ret = radio_init(radio_find_region(DEFAULT_REGION), radio_find_preset(DEFAULT_PRESET));

	if (ret < 0) {
		LOG_ERR("Radio init failed (%d). Check the SPI wiring.", ret);
		return 0;
	}

	LOG_INF("Meshtastic scanner ready (receive only). Type 'mesh help'.");
	return 0;
}
```

## src/aes128.h
```c
/**
 * @file aes128.h
 * @brief Minimal AES-128 (encrypt direction only) and AES-128-CTR.
 * @copyright Copyright (c) 2026 Centro de Inovacao EDGE
 * SPDX-License-Identifier: Apache-2.0
 */
#ifndef AES128_H_
#define AES128_H_

#include <stddef.h>
#include <stdint.h>

/** Expanded key: 11 round keys of 16 bytes. */
struct aes128_ctx {
	uint8_t round_key[176];
};

void aes128_init(struct aes128_ctx *ctx, const uint8_t key[16]);
void aes128_encrypt_block(const struct aes128_ctx *ctx, const uint8_t in[16], uint8_t out[16]);

/**
 * AES-128-CTR, in place. Encryption and decryption are the same operation.
 * The last 4 bytes of the 16-byte IV are a big-endian block counter, as in
 * the Meshtastic firmware (rweather Crypto, counter size 4).
 */
void aes128_ctr_xcrypt(const struct aes128_ctx *ctx, const uint8_t iv[16], uint8_t *buf, size_t len);

#endif /* AES128_H_ */
```

## src/meshtastic.c
```c
/**
 * @file meshtastic.c
 * @brief Meshtastic over-the-air packet decoding (receive side only).
 * @copyright Copyright (c) 2026 Centro de Inovacao EDGE
 * SPDX-License-Identifier: Apache-2.0
 */
#include <string.h>

#include "aes128.h"
#include "meshtastic.h"
#include "pb.h"

/* src/mesh/Channels.h, meshtastic/firmware */
const uint8_t mesh_default_key[16] = {
	0xd4, 0xf1, 0xbb, 0x3a, 0x20, 0x29, 0x07, 0x59,
	0xf0, 0xbc, 0xff, 0xab, 0xcf, 0x4e, 0x69, 0x01,
};

/* Flags byte layout (src/mesh/RadioInterface.h) */
#define FLAG_HOP_LIMIT_MASK  0x07
#define FLAG_WANT_ACK_MASK   0x08
#define FLAG_VIA_MQTT_MASK   0x10
#define FLAG_HOP_START_SHIFT 5

uint32_t mesh_djb2(const char *str)
{
	uint32_t h = 5381;

	while (*str) {
		h = (h << 5) + h + (uint8_t)*str++;
	}
	return h;
}

uint8_t mesh_channel_hash(const char *channel_name, const uint8_t *key, size_t key_len)
{
	uint8_t h = 0;

	while (*channel_name) {
		h ^= (uint8_t)*channel_name++;
	}
	for (size_t i = 0; i < key_len; i++) {
		h ^= key[i];
	}
	return h;
}

static uint32_t le32(const uint8_t *p)
{
	return (uint32_t)p[0] | ((uint32_t)p[1] << 8) | ((uint32_t)p[2] << 16) |
	       ((uint32_t)p[3] << 24);
}

static void decode_user(const uint8_t *buf, size_t len, struct mesh_packet *out)
{
	struct pb_reader r;
	struct pb_field f;

	memset(&out->info.user, 0, sizeof(out->info.user));
	pb_reader_init(&r, buf, len);
	while (pb_next(&r, &f)) {
		switch (f.num) {
		case 1: pb_copy_string(&f, out->info.user.id, sizeof(out->info.user.id)); break;
		case 2: pb_copy_string(&f, out->info.user.long_name, sizeof(out->info.user.long_name)); break;
		case 3: pb_copy_string(&f, out->info.user.short_name, sizeof(out->info.user.short_name)); break;
		case 5: out->info.user.hw_model = (uint32_t)f.value; break;
		case 7: out->info.user.role = (uint32_t)f.value; break;
		default: break;
		}
	}
	out->kind = MESH_INFO_USER;
}

static void decode_position(const uint8_t *buf, size_t len, struct mesh_packet *out)
{
	struct pb_reader r;
	struct pb_field f;
	bool has_lat = false, has_lon = false;

	memset(&out->info.pos, 0, sizeof(out->info.pos));
	pb_reader_init(&r, buf, len);
	while (pb_next(&r, &f)) {
		switch (f.num) {
		case 1: out->info.pos.lat_i = (int32_t)(uint32_t)f.value; has_lat = true; break;
		case 2: out->info.pos.lon_i = (int32_t)(uint32_t)f.value; has_lon = true; break;
		case 3: out->info.pos.alt_m = (int32_t)f.value; out->info.pos.has_alt = true; break;
		default: break;
		}
	}
	/* Nodes that share no location send an empty Position. */
	if (has_lat && has_lon && (out->info.pos.lat_i != 0 || out->info.pos.lon_i != 0)) {
		out->kind = MESH_INFO_POSITION;
	}
}

static void decode_telemetry(const uint8_t *buf, size_t len, struct mesh_packet *out)
{
	struct pb_reader r, dm;
	struct pb_field f, g;

	pb_reader_init(&r, buf, len);
	while (pb_next(&r, &f)) {
		if (f.num != 2 || f.wire != PB_LEN) { /* device_metrics */
			continue;
		}
		pb_reader_init(&dm, f.data, f.len);
		while (pb_next(&dm, &g)) {
			if (g.num == 1 && g.wire == PB_VARINT) { /* battery_level */
				out->info.battery_level = (uint32_t)g.value;
				out->kind = MESH_INFO_BATTERY;
			}
		}
	}
}

static bool decode_data(const uint8_t *buf, size_t len, struct mesh_packet *out)
{
	struct pb_reader r;
	struct pb_field f;
	const uint8_t *payload = NULL;
	size_t payload_len = 0;
	bool has_port = false;

	pb_reader_init(&r, buf, len);
	while (pb_next(&r, &f)) {
		if (f.num == 1 && f.wire == PB_VARINT) {
			out->portnum = (uint32_t)f.value;
			has_port = true;
		} else if (f.num == 2 && f.wire == PB_LEN) {
			payload = f.data;
			payload_len = f.len;
		}
	}
	/* A wrong key yields random bytes that rarely parse cleanly. */
	if (r.error || !has_port || out->portnum == 0 || out->portnum > 511) {
		return false;
	}

	switch (out->portnum) {
	case PORT_NODEINFO:
		decode_user(payload, payload_len, out);
		break;
	case PORT_POSITION:
		decode_position(payload, payload_len, out);
		break;
	case PORT_TELEMETRY:
		decode_telemetry(payload, payload_len, out);
		break;
	case PORT_TEXT_MESSAGE: {
		size_t n = payload_len < sizeof(out->info.text) - 1 ? payload_len
								      : sizeof(out->info.text) - 1;
		if (payload) {
			memcpy(out->info.text, payload, n);
		}
		out->info.text[n] = '\0';
		out->kind = MESH_INFO_TEXT;
		break;
	}
	default:
		break;
	}
	return true;
}

int mesh_decode(uint8_t *buf, size_t len, uint8_t channel_hash, const uint8_t key[16],
		struct mesh_packet *out)
{
	memset(out, 0, sizeof(*out));
	if (len < MESH_HEADER_LEN) {
		return -1;
	}

	out->to = le32(&buf[0]);
	out->from = le32(&buf[4]);
	out->id = le32(&buf[8]);
	out->hop_limit = buf[12] & FLAG_HOP_LIMIT_MASK;
	out->want_ack = (buf[12] & FLAG_WANT_ACK_MASK) != 0;
	out->via_mqtt = (buf[12] & FLAG_VIA_MQTT_MASK) != 0;
	out->hop_start = buf[12] >> FLAG_HOP_START_SHIFT;
	out->channel_hash = buf[13];
	out->next_hop = buf[14];
	out->relay_node = buf[15];

	if (out->channel_hash != channel_hash || len == MESH_HEADER_LEN) {
		return 0; /* not our channel (or a PKI direct message): header only */
	}

	/* Nonce (CryptoEngine::initNonce): packet id as uint64 LE, then sender as uint32 LE. */
	uint8_t nonce[16] = {0};
	struct aes128_ctx aes;

	memcpy(&nonce[0], &buf[8], 4);
	memcpy(&nonce[8], &buf[4], 4);
	aes128_init(&aes, key);
	aes128_ctr_xcrypt(&aes, nonce, &buf[MESH_HEADER_LEN], len - MESH_HEADER_LEN);

	out->decrypted = decode_data(&buf[MESH_HEADER_LEN], len - MESH_HEADER_LEN, out);
	return 0;
}

const char *mesh_port_name(uint32_t portnum)
{
	switch (portnum) {
	case PORT_TEXT_MESSAGE: return "TEXT";
	case PORT_POSITION: return "POSITION";
	case PORT_NODEINFO: return "NODEINFO";
	case PORT_ROUTING: return "ROUTING";
	case PORT_TELEMETRY: return "TELEMETRY";
	case PORT_TRACEROUTE: return "TRACEROUTE";
	case PORT_NEIGHBORINFO: return "NEIGHBORINFO";
	case PORT_MAP_REPORT: return "MAP_REPORT";
	default: return "OTHER";
	}
}

const char *mesh_role_name(uint32_t role)
{
	/* meshtastic/config.proto, Config.DeviceConfig.Role */
	static const char *const names[] = {
		"CLIENT", "CLIENT_MUTE", "ROUTER", "ROUTER_CLIENT", "REPEATER",
		"TRACKER", "SENSOR", "TAK", "CLIENT_HIDDEN", "LOST_AND_FOUND",
		"TAK_TRACKER", "ROUTER_LATE", "CLIENT_BASE",
	};

	return role < sizeof(names) / sizeof(names[0]) ? names[role] : "?";
}
```

## src/meshtastic.h
```c
/**
 * @file meshtastic.h
 * @brief Meshtastic over-the-air packet decoding (receive side only).
 * @copyright Copyright (c) 2026 Centro de Inovacao EDGE
 * SPDX-License-Identifier: Apache-2.0
 *
 * Over-the-air frame (src/mesh/RadioInterface.h, meshtastic/firmware):
 *   16-byte header, all fields little-endian:
 *     to(4) from(4) id(4) flags(1) channel_hash(1) next_hop(1) relay_node(1)
 *   then the payload: a `Data` protobuf, AES-CTR encrypted with the channel key.
 */
#ifndef MESHTASTIC_H_
#define MESHTASTIC_H_

#include <stdbool.h>
#include <stddef.h>
#include <stdint.h>

#define MESH_HEADER_LEN   16
#define MESH_BROADCAST    0xFFFFFFFFu

/* PortNum values (meshtastic/portnums.proto) */
#define PORT_TEXT_MESSAGE 1
#define PORT_POSITION     3
#define PORT_NODEINFO     4
#define PORT_ROUTING      5
#define PORT_TELEMETRY    67
#define PORT_TRACEROUTE   70
#define PORT_NEIGHBORINFO 71
#define PORT_MAP_REPORT   73

enum mesh_info_kind {
	MESH_INFO_NONE = 0,
	MESH_INFO_USER,
	MESH_INFO_POSITION,
	MESH_INFO_TEXT,
	MESH_INFO_BATTERY,
};

struct mesh_packet {
	/* Header */
	uint32_t to;
	uint32_t from;
	uint32_t id;
	uint8_t hop_limit;
	uint8_t hop_start;
	bool want_ack;
	bool via_mqtt;
	uint8_t channel_hash;
	uint8_t next_hop;
	uint8_t relay_node;

	/* Payload */
	bool decrypted;   /* decrypted with our channel key and parsed as Data */
	uint32_t portnum;
	enum mesh_info_kind kind;
	union {
		struct {
			char id[16];
			char long_name[40];
			char short_name[8];
			uint32_t hw_model;
			uint32_t role;
		} user;
		struct {
			int32_t lat_i;   /* degrees * 1e7 */
			int32_t lon_i;   /* degrees * 1e7 */
			int32_t alt_m;
			bool has_alt;
		} pos;
		char text[200];
		uint32_t battery_level; /* percent; 101 = powered */
	} info;
};

/** djb2 hash used by Meshtastic to pick the frequency slot from the channel name. */
uint32_t mesh_djb2(const char *str);

/** Channel hash: XOR of the channel name bytes XOR the key bytes. */
uint8_t mesh_channel_hash(const char *channel_name, const uint8_t *key, size_t key_len);

/** The well-known default channel key ("AQ==", PSK index 1). */
extern const uint8_t mesh_default_key[16];

/**
 * Parse the header and, if channel_hash matches, decrypt and decode the payload.
 *
 * @param buf          Received frame. The payload part is decrypted in place.
 * @param len          Frame length.
 * @param channel_hash Hash of the channel we hold the key for.
 * @param key          AES-128 channel key.
 * @param out          Decoded packet.
 * @return 0 on success (header valid), negative if the frame is too short.
 */
int mesh_decode(uint8_t *buf, size_t len, uint8_t channel_hash, const uint8_t key[16],
		struct mesh_packet *out);

/** Short name for a port number ("NODEINFO", "POSITION", ...). */
const char *mesh_port_name(uint32_t portnum);

/** Device role name ("CLIENT", "ROUTER", ...). */
const char *mesh_role_name(uint32_t role);

/** Hardware model name from meshtastic/mesh.proto HardwareModel. */
const char *mesh_hw_model_name(uint32_t hw_model);

#endif /* MESHTASTIC_H_ */
```

## src/nodedb.c
```c
/**
 * @file nodedb.c
 * @brief Table of Meshtastic nodes heard over the air.
 * @copyright Copyright (c) 2026 Centro de Inovacao EDGE
 * SPDX-License-Identifier: Apache-2.0
 */
#include <string.h>

#include <zephyr/kernel.h>

#include "nodedb.h"

static struct node_entry nodes[NODEDB_MAX_NODES];
static int node_count;
static K_MUTEX_DEFINE(lock);

static struct node_entry *find_or_add(uint32_t num, bool *is_new)
{
	int oldest = 0;

	*is_new = false;
	for (int i = 0; i < node_count; i++) {
		if (nodes[i].num == num) {
			return &nodes[i];
		}
		if (nodes[i].last_heard_ms < nodes[oldest].last_heard_ms) {
			oldest = i;
		}
	}

	/* New node: append, or replace the one heard longest ago. */
	int slot = node_count < NODEDB_MAX_NODES ? node_count++ : oldest;

	memset(&nodes[slot], 0, sizeof(nodes[slot]));
	nodes[slot].num = num;
	nodes[slot].hops_away = -1;
	*is_new = true;
	return &nodes[slot];
}

bool nodedb_update(const struct mesh_packet *pkt, int16_t rssi, int8_t snr)
{
	bool is_new;
	int hops = (pkt->hop_start >= pkt->hop_limit && pkt->hop_start != 0)
			   ? pkt->hop_start - pkt->hop_limit
			   : -1;

	k_mutex_lock(&lock, K_FOREVER);

	struct node_entry *n = find_or_add(pkt->from, &is_new);
	bool duplicate = !is_new && n->last_id == pkt->id;

	n->last_heard_ms = k_uptime_get();
	if (!duplicate) {
		n->packets++;
		n->last_id = pkt->id;
		n->last_port = pkt->portnum;
		n->last_decrypted = pkt->decrypted;
	}

	/* Keep the shortest path seen; RSSI/SNR only mean something for 0 hops. */
	if (hops >= 0 && (n->hops_away < 0 || hops < n->hops_away || !duplicate)) {
		n->hops_away = (int8_t)hops;
	}
	if (hops == 0) {
		n->rssi = rssi;
		n->snr = snr;
		n->has_signal = true;
	} else {
		n->last_relay = pkt->relay_node;
	}

	switch (pkt->kind) {
	case MESH_INFO_USER:
		strncpy(n->long_name, pkt->info.user.long_name, sizeof(n->long_name) - 1);
		strncpy(n->short_name, pkt->info.user.short_name, sizeof(n->short_name) - 1);
		n->hw_model = pkt->info.user.hw_model;
		n->role = pkt->info.user.role;
		n->has_user = true;
		break;
	case MESH_INFO_POSITION:
		n->lat_i = pkt->info.pos.lat_i;
		n->lon_i = pkt->info.pos.lon_i;
		n->alt_m = pkt->info.pos.alt_m;
		n->has_pos = true;
		break;
	case MESH_INFO_BATTERY:
		n->battery_level = pkt->info.battery_level;
		n->has_battery = true;
		break;
	default:
		break;
	}

	k_mutex_unlock(&lock);
	return is_new;
}

int nodedb_snapshot(struct node_entry *out, int max)
{
	int n;

	k_mutex_lock(&lock, K_FOREVER);
	n = MIN(node_count, max);
	memcpy(out, nodes, n * sizeof(*out));
	k_mutex_unlock(&lock);

	/* Insertion sort, most recently heard first (n is small). */
	for (int i = 1; i < n; i++) {
		struct node_entry tmp = out[i];
		int j = i - 1;

		while (j >= 0 && out[j].last_heard_ms < tmp.last_heard_ms) {
			out[j + 1] = out[j];
			j--;
		}
		out[j + 1] = tmp;
	}
	return n;
}

bool nodedb_get(uint32_t num, struct node_entry *out)
{
	bool found = false;

	k_mutex_lock(&lock, K_FOREVER);
	for (int i = 0; i < node_count; i++) {
		if (nodes[i].num == num) {
			*out = nodes[i];
			found = true;
			break;
		}
	}
	k_mutex_unlock(&lock);
	return found;
}

void nodedb_clear(void)
{
	k_mutex_lock(&lock, K_FOREVER);
	node_count = 0;
	k_mutex_unlock(&lock);
}
```

## src/pb.c
```c
/**
 * @file pb.c
 * @brief Tiny read-only protobuf wire-format walker.
 * @copyright Copyright (c) 2026 Centro de Inovacao EDGE
 * SPDX-License-Identifier: Apache-2.0
 */
#include <string.h>

#include "pb.h"

void pb_reader_init(struct pb_reader *r, const uint8_t *buf, size_t len)
{
	r->p = buf;
	r->end = buf + len;
	r->error = false;
}

static bool read_varint(struct pb_reader *r, uint64_t *out)
{
	uint64_t v = 0;

	for (int shift = 0; shift < 64; shift += 7) {
		if (r->p >= r->end) {
			return false;
		}
		uint8_t b = *r->p++;

		v |= (uint64_t)(b & 0x7f) << shift;
		if (!(b & 0x80)) {
			*out = v;
			return true;
		}
	}
	return false;
}

static bool read_fixed(struct pb_reader *r, size_t n, uint64_t *out)
{
	uint64_t v = 0;

	if ((size_t)(r->end - r->p) < n) {
		return false;
	}
	for (size_t i = 0; i < n; i++) {
		v |= (uint64_t)r->p[i] << (8 * i); /* little-endian */
	}
	r->p += n;
	*out = v;
	return true;
}

bool pb_next(struct pb_reader *r, struct pb_field *f)
{
	uint64_t key, len;

	if (r->error || r->p >= r->end) {
		return false;
	}
	if (!read_varint(r, &key) || (key >> 3) == 0) {
		goto fail;
	}

	f->num = (uint32_t)(key >> 3);
	f->wire = (enum pb_wire)(key & 0x7);
	f->value = 0;
	f->data = NULL;
	f->len = 0;

	switch (f->wire) {
	case PB_VARINT:
		if (!read_varint(r, &f->value)) {
			goto fail;
		}
		break;
	case PB_FIXED64:
		if (!read_fixed(r, 8, &f->value)) {
			goto fail;
		}
		break;
	case PB_FIXED32:
		if (!read_fixed(r, 4, &f->value)) {
			goto fail;
		}
		break;
	case PB_LEN:
		if (!read_varint(r, &len) || len > (uint64_t)(r->end - r->p)) {
			goto fail;
		}
		f->data = r->p;
		f->len = (size_t)len;
		r->p += len;
		break;
	default:
		goto fail; /* groups (3, 4) and invalid types */
	}
	return true;

fail:
	r->error = true;
	return false;
}

void pb_copy_string(const struct pb_field *f, char *dst, size_t dst_size)
{
	size_t n = 0;

	if (dst_size == 0) {
		return;
	}
	if (f->wire == PB_LEN) {
		n = f->len < dst_size - 1 ? f->len : dst_size - 1;
		memcpy(dst, f->data, n);
	}
	dst[n] = '\0';
}
```

## src/pb.h
```c
/**
 * @file pb.h
 * @brief Tiny read-only protobuf wire-format walker.
 * @copyright Copyright (c) 2026 Centro de Inovacao EDGE
 * SPDX-License-Identifier: Apache-2.0
 */
#ifndef PB_H_
#define PB_H_

#include <stdbool.h>
#include <stddef.h>
#include <stdint.h>

enum pb_wire {
	PB_VARINT = 0,
	PB_FIXED64 = 1,
	PB_LEN = 2,
	PB_FIXED32 = 5,
};

/** One decoded field. For PB_LEN, data/len point into the input buffer. */
struct pb_field {
	uint32_t num;
	enum pb_wire wire;
	uint64_t value;      /* PB_VARINT, PB_FIXED32, PB_FIXED64 */
	const uint8_t *data; /* PB_LEN */
	size_t len;          /* PB_LEN */
};

struct pb_reader {
	const uint8_t *p;
	const uint8_t *end;
	bool error;
};

void pb_reader_init(struct pb_reader *r, const uint8_t *buf, size_t len);

/**
 * Read the next field.
 * @return true if a field was read; false at end of buffer or on malformed
 *         input (check r->error to tell the two apart).
 */
bool pb_next(struct pb_reader *r, struct pb_field *f);

/** Copy a PB_LEN field into a NUL-terminated string, truncating if needed. */
void pb_copy_string(const struct pb_field *f, char *dst, size_t dst_size);

#endif /* PB_H_ */
```

## src/radio.c
```c
/**
 * @file radio.c
 * @brief RFM95W (SX1276) Meshtastic receiver driven directly over SPI.
 * @copyright Copyright (c) 2026 Centro de Inovacao EDGE
 * SPDX-License-Identifier: Apache-2.0
 *
 * This version does not use the Zephyr LoRa driver and does not need DIO0:
 * the radio is configured register by register and a thread polls
 * RegIrqFlags over SPI to detect received packets. Only the SPI lines
 * (MOSI, MISO, SCK, NSS) are required. RESET is pulsed if wired, harmless
 * otherwise. Register map: Semtech SX1276/77/78/79 datasheet, LoRa mode.
 */
#include <ctype.h>
#include <string.h>

#include <zephyr/kernel.h>
#include <zephyr/drivers/gpio.h>
#include <zephyr/drivers/spi.h>
#include <zephyr/logging/log.h>

#include "meshtastic.h"
#include "radio.h"

LOG_MODULE_REGISTER(radio, LOG_LEVEL_INF);

#define LORA_NODE DT_ALIAS(lora0)

/* SX1276 registers (LoRa mode) */
#define REG_FIFO                 0x00
#define REG_OP_MODE              0x01
#define REG_FRF_MSB              0x06
#define REG_FRF_MID              0x07
#define REG_FRF_LSB              0x08
#define REG_LNA                  0x0C
#define REG_FIFO_ADDR_PTR        0x0D
#define REG_FIFO_RX_BASE_ADDR    0x0F
#define REG_FIFO_RX_CURRENT_ADDR 0x10
#define REG_IRQ_FLAGS_MASK       0x11
#define REG_IRQ_FLAGS            0x12
#define REG_RX_NB_BYTES          0x13
#define REG_RX_HEADER_CNT_MSB    0x14
#define REG_RX_HEADER_CNT_LSB    0x15
#define REG_RX_PACKET_CNT_MSB    0x16
#define REG_RX_PACKET_CNT_LSB    0x17
#define REG_MODEM_STAT           0x18
#define REG_PKT_SNR_VALUE        0x19
#define REG_PKT_RSSI_VALUE       0x1A
#define REG_RSSI_VALUE           0x1B
#define REG_MODEM_CONFIG_1       0x1D
#define REG_MODEM_CONFIG_2       0x1E
#define REG_PREAMBLE_MSB         0x20
#define REG_PREAMBLE_LSB         0x21
#define REG_MAX_PAYLOAD_LENGTH   0x23
#define REG_MODEM_CONFIG_3       0x26
#define REG_DETECT_OPTIMIZE      0x31
#define REG_INVERT_IQ            0x33
#define REG_HIGH_BW_OPTIMIZE_1   0x36
#define REG_DETECTION_THRESHOLD  0x37
#define REG_SYNC_WORD            0x39
#define REG_HIGH_BW_OPTIMIZE_2   0x3A
#define REG_INVERT_IQ_2          0x3B
#define REG_VERSION              0x42

#define MODE_LONG_RANGE  0x80
#define MODE_SLEEP       0x00
#define MODE_STDBY       0x01
#define MODE_RX_CONT     0x05

#define IRQ_RX_DONE          0x40
#define IRQ_PAYLOAD_CRC_ERR  0x20

#define MESHTASTIC_PREAMBLE  16
#define POLL_INTERVAL_MS     5

const struct mesh_region mesh_regions[] = {
	{"US", 902000000, 928000000},
	{"ANZ", 915000000, 928000000},
	{"BR_902", 902000000, 907500000},
};
const size_t mesh_region_count = ARRAY_SIZE(mesh_regions);

const struct mesh_preset mesh_presets[] = {
	{"LongFast", 250, 11, 5},
	{"LongMod", 125, 11, 8},
	{"LongSlow", 125, 12, 8},
	{"LongTurbo", 500, 11, 8},
	{"MediumFast", 250, 9, 5},
	{"MediumSlow", 250, 10, 5},
	{"ShortFast", 250, 7, 5},
	{"ShortSlow", 250, 8, 5},
	{"ShortTurbo", 500, 7, 5},
};
const size_t mesh_preset_count = ARRAY_SIZE(mesh_presets);

static const struct spi_dt_spec lora_spi =
	SPI_DT_SPEC_GET(LORA_NODE, SPI_WORD_SET(8) | SPI_TRANSFER_MSB);
static const struct gpio_dt_spec lora_reset = GPIO_DT_SPEC_GET_OR(LORA_NODE, reset_gpios, {0});

K_MSGQ_DEFINE(rx_queue, sizeof(struct radio_frame), 4, 4);
static K_MUTEX_DEFINE(radio_lock);

static struct radio_state state = {.sync_word = MESHTASTIC_SYNC_WORD};
static atomic_t rx_count;
static atomic_t crc_errors;
static bool radio_ready;

/* ------------------------------------------------------------ SPI access */

static int reg_read(uint8_t reg, uint8_t *value)
{
	uint8_t tx[2] = {reg & 0x7F, 0x00};
	uint8_t rx[2] = {0};
	const struct spi_buf tx_buf = {.buf = tx, .len = sizeof(tx)};
	const struct spi_buf rx_buf = {.buf = rx, .len = sizeof(rx)};
	const struct spi_buf_set tx_set = {.buffers = &tx_buf, .count = 1};
	const struct spi_buf_set rx_set = {.buffers = &rx_buf, .count = 1};
	int ret = spi_transceive_dt(&lora_spi, &tx_set, &rx_set);

	*value = rx[1];
	return ret;
}

static int reg_write(uint8_t reg, uint8_t value)
{
	uint8_t tx[2] = {reg | 0x80, value};
	const struct spi_buf tx_buf = {.buf = tx, .len = sizeof(tx)};
	const struct spi_buf_set tx_set = {.buffers = &tx_buf, .count = 1};

	return spi_write_dt(&lora_spi, &tx_set);
}

/* Burst read of the FIFO: address byte, then len data bytes. */
static int fifo_read(uint8_t *data, size_t len)
{
	static uint8_t tx[257];
	static uint8_t rx[257];
	const struct spi_buf tx_buf = {.buf = tx, .len = len + 1};
	const struct spi_buf rx_buf = {.buf = rx, .len = len + 1};
	const struct spi_buf_set tx_set = {.buffers = &tx_buf, .count = 1};
	const struct spi_buf_set rx_set = {.buffers = &rx_buf, .count = 1};
	int ret;

	memset(tx, 0, len + 1);
	tx[0] = REG_FIFO;
	ret = spi_transceive_dt(&lora_spi, &tx_set, &rx_set);
	memcpy(data, &rx[1], len);
	return ret;
}

/* -------------------------------------------------------------- lookups */

static bool name_equals(const char *a, const char *b)
{
	while (*a && *b) {
		if (tolower((unsigned char)*a++) != tolower((unsigned char)*b++)) {
			return false;
		}
	}
	return *a == *b;
}

const struct mesh_region *radio_find_region(const char *name)
{
	for (size_t i = 0; i < mesh_region_count; i++) {
		if (name_equals(name, mesh_regions[i].name)) {
			return &mesh_regions[i];
		}
	}
	return NULL;
}

const struct mesh_preset *radio_find_preset(const char *name)
{
	for (size_t i = 0; i < mesh_preset_count; i++) {
		if (name_equals(name, mesh_presets[i].name)) {
			return &mesh_presets[i];
		}
	}
	return NULL;
}

static uint8_t bw_code(uint16_t khz)
{
	switch (khz) {
	case 125: return 0x7;
	case 500: return 0x9;
	default: return 0x8; /* 250 kHz */
	}
}

/* ------------------------------------------------------- configuration */

static int configure(const struct mesh_region *region, const struct mesh_preset *preset)
{
	uint32_t bw_hz = (uint32_t)preset->bw_khz * 1000U;
	uint32_t symbol_us = (1U << preset->sf) * 1000U / preset->bw_khz;
	uint64_t frf;
	int ret = 0;

	/* Frequency slot (RadioInterface::applyModemConfig): the default channel
	 * name is the preset name, hashed with djb2.
	 */
	state.region = region;
	state.preset = preset;
	state.num_slots = (region->end_hz - region->start_hz) / bw_hz;
	state.slot = mesh_djb2(preset->name) % state.num_slots;
	state.freq_hz = region->start_hz + bw_hz / 2U + state.slot * bw_hz;
	state.channel_hash = mesh_channel_hash(preset->name, mesh_default_key,
					       sizeof(mesh_default_key));
	frf = ((uint64_t)state.freq_hz << 19) / 32000000U;

	/* LoRa mode can only be selected in sleep. */
	ret |= reg_write(REG_OP_MODE, MODE_SLEEP);
	ret |= reg_write(REG_OP_MODE, MODE_LONG_RANGE | MODE_SLEEP);
	ret |= reg_write(REG_OP_MODE, MODE_LONG_RANGE | MODE_STDBY);

	ret |= reg_write(REG_FRF_MSB, (uint8_t)(frf >> 16));
	ret |= reg_write(REG_FRF_MID, (uint8_t)(frf >> 8));
	ret |= reg_write(REG_FRF_LSB, (uint8_t)frf);

	ret |= reg_write(REG_LNA, 0x23); /* max gain, LNA boost for the HF port */

	/* Bandwidth, coding rate, explicit header */
	ret |= reg_write(REG_MODEM_CONFIG_1, (bw_code(preset->bw_khz) << 4) |
					     ((preset->cr - 4) << 1));
	/* Spreading factor, payload CRC on */
	ret |= reg_write(REG_MODEM_CONFIG_2, (preset->sf << 4) | 0x04);
	/* AGC on; low data rate optimize when a symbol lasts more than 16 ms */
	ret |= reg_write(REG_MODEM_CONFIG_3, 0x04 | (symbol_us > 16000U ? 0x08 : 0x00));

	ret |= reg_write(REG_PREAMBLE_MSB, MESHTASTIC_PREAMBLE >> 8);
	ret |= reg_write(REG_PREAMBLE_LSB, MESHTASTIC_PREAMBLE & 0xFF);
	ret |= reg_write(REG_SYNC_WORD, state.sync_word);

	/* SF7..SF12 detection settings, normal IQ */
	ret |= reg_write(REG_DETECT_OPTIMIZE, 0xC3);
	ret |= reg_write(REG_DETECTION_THRESHOLD, 0x0A);
	ret |= reg_write(REG_INVERT_IQ, 0x27);
	ret |= reg_write(REG_INVERT_IQ_2, 0x1D);

	/* Errata 2.1: sensitivity optimization with a 500 kHz bandwidth */
	if (preset->bw_khz == 500) {
		ret |= reg_write(REG_HIGH_BW_OPTIMIZE_1, 0x02);
		ret |= reg_write(REG_HIGH_BW_OPTIMIZE_2, 0x64);
	} else {
		ret |= reg_write(REG_HIGH_BW_OPTIMIZE_1, 0x03);
	}

	ret |= reg_write(REG_MAX_PAYLOAD_LENGTH, 0xFF);
	ret |= reg_write(REG_FIFO_RX_BASE_ADDR, 0x00);
	ret |= reg_write(REG_FIFO_ADDR_PTR, 0x00);
	ret |= reg_write(REG_IRQ_FLAGS_MASK, 0x00);
	ret |= reg_write(REG_IRQ_FLAGS, 0xFF);

	ret |= reg_write(REG_OP_MODE, MODE_LONG_RANGE | MODE_RX_CONT);
	return ret ? -EIO : 0;
}

int radio_set(const struct mesh_region *region, const struct mesh_preset *preset)
{
	int ret;

	k_mutex_lock(&radio_lock, K_FOREVER);
	ret = configure(region, preset);
	k_mutex_unlock(&radio_lock);

	if (ret < 0) {
		LOG_ERR("Radio configuration failed: %d", ret);
		return ret;
	}

	LOG_INF("Listening: %s %s, %u.%03u MHz (slot %u/%u), SF%u BW%u CR4/%u, sync 0x%02x%s",
		region->name, preset->name, state.freq_hz / 1000000U,
		(state.freq_hz / 1000U) % 1000U, state.slot + 1, state.num_slots, preset->sf,
		preset->bw_khz, preset->cr, state.sync_word,
		state.sync_word == MESHTASTIC_SYNC_WORD ? "" : " (raw test mode)");
	return 0;
}

int radio_init(const struct mesh_region *region, const struct mesh_preset *preset)
{
	uint8_t version = 0;

	if (!spi_is_ready_dt(&lora_spi)) {
		LOG_ERR("SPI bus not ready");
		return -ENODEV;
	}

	/* Hardware reset, if the RESET line is wired (harmless if it is not). */
	if (lora_reset.port != NULL && gpio_is_ready_dt(&lora_reset)) {
		gpio_pin_configure_dt(&lora_reset, GPIO_OUTPUT_ACTIVE);
		k_msleep(1);
		gpio_pin_set_dt(&lora_reset, 0);
		k_msleep(10);
	}

	if (reg_read(REG_VERSION, &version) < 0 || (version != 0x11 && version != 0x12)) {
		LOG_ERR("SX1276 not found (RegVersion = 0x%02x). Check the SPI wiring.", version);
		return -ENODEV;
	}
	LOG_INF("SX1276 found (RegVersion = 0x%02x), polling mode (no DIO0)", version);

	radio_ready = true;
	return radio_set(region, preset);
}

/* ----------------------------------------------------- polling thread */

/* Packet RSSI, HF port (datasheet 5.5.5). */
static int16_t packet_rssi(uint8_t raw_rssi, int8_t snr_quarter_db)
{
	int16_t rssi = -157 + raw_rssi;

	if (snr_quarter_db < 0) {
		rssi += snr_quarter_db / 4;
	}
	return rssi;
}

static void poll_thread(void *a, void *b, void *c)
{
	static struct radio_frame frame;

	ARG_UNUSED(a);
	ARG_UNUSED(b);
	ARG_UNUSED(c);

	while (1) {
		uint8_t flags = 0, nb = 0, addr = 0, raw_snr = 0, raw_rssi = 0;
		bool got_frame = false;

		k_msleep(POLL_INTERVAL_MS);
		if (!radio_ready) {
			continue;
		}

		k_mutex_lock(&radio_lock, K_FOREVER);
		if (reg_read(REG_IRQ_FLAGS, &flags) == 0 && (flags & IRQ_RX_DONE)) {
			if (flags & IRQ_PAYLOAD_CRC_ERR) {
				atomic_inc(&crc_errors);
			} else {
				reg_read(REG_RX_NB_BYTES, &nb);
				reg_read(REG_FIFO_RX_CURRENT_ADDR, &addr);
				reg_read(REG_PKT_SNR_VALUE, &raw_snr);
				reg_read(REG_PKT_RSSI_VALUE, &raw_rssi);
				reg_write(REG_FIFO_ADDR_PTR, addr);
				fifo_read(frame.data, nb);
				frame.len = nb;
				frame.snr = (int8_t)raw_snr / 4;
				frame.rssi = packet_rssi(raw_rssi, (int8_t)raw_snr);
				got_frame = true;
			}
			reg_write(REG_IRQ_FLAGS, 0xFF);
		}
		k_mutex_unlock(&radio_lock);

		if (got_frame) {
			atomic_inc(&rx_count);
			if (k_msgq_put(&rx_queue, &frame, K_NO_WAIT) != 0) {
				LOG_WRN("RX queue full, frame dropped");
			}
		}
	}
}

K_THREAD_DEFINE(radio_poll_tid, 2048, poll_thread, NULL, NULL, NULL, 6, 0, 0);

/* -------------------------------------------------------------- queries */

int radio_set_sync_word(uint8_t sync_word)
{
	state.sync_word = sync_word;
	return radio_set(state.region, state.preset);
}

const struct radio_state *radio_get(void)
{
	return &state;
}

int radio_get_frame(struct radio_frame *frame, int32_t timeout_ms)
{
	return k_msgq_get(&rx_queue, frame, timeout_ms < 0 ? K_FOREVER : K_MSEC(timeout_ms));
}

uint32_t radio_rx_count(void)
{
	return (uint32_t)atomic_get(&rx_count);
}

uint32_t radio_crc_errors(void)
{
	return (uint32_t)atomic_get(&crc_errors);
}

/* ---------------------------------------------------------- diagnostics */

int radio_read_diag(struct radio_diag *d)
{
	uint8_t f[3], h[2], p[2], pre[2], rssi = 0;
	int ret = 0;

	k_mutex_lock(&radio_lock, K_FOREVER);
	ret |= reg_read(REG_VERSION, &d->version);
	ret |= reg_read(REG_OP_MODE, &d->op_mode);
	ret |= reg_read(REG_FRF_MSB, &f[0]);
	ret |= reg_read(REG_FRF_MID, &f[1]);
	ret |= reg_read(REG_FRF_LSB, &f[2]);
	ret |= reg_read(REG_MODEM_CONFIG_1, &d->modem_config_1);
	ret |= reg_read(REG_MODEM_CONFIG_2, &d->modem_config_2);
	ret |= reg_read(REG_MODEM_CONFIG_3, &d->modem_config_3);
	ret |= reg_read(REG_SYNC_WORD, &d->sync_word);
	ret |= reg_read(REG_PREAMBLE_MSB, &pre[0]);
	ret |= reg_read(REG_PREAMBLE_LSB, &pre[1]);
	ret |= reg_read(REG_MODEM_STAT, &d->modem_stat);
	ret |= reg_read(REG_RX_HEADER_CNT_MSB, &h[0]);
	ret |= reg_read(REG_RX_HEADER_CNT_LSB, &h[1]);
	ret |= reg_read(REG_RX_PACKET_CNT_MSB, &p[0]);
	ret |= reg_read(REG_RX_PACKET_CNT_LSB, &p[1]);
	ret |= reg_read(REG_RSSI_VALUE, &rssi);
	k_mutex_unlock(&radio_lock);

	d->frf = ((uint32_t)f[0] << 16) | ((uint32_t)f[1] << 8) | f[2];
	d->preamble = ((uint16_t)pre[0] << 8) | pre[1];
	d->valid_headers = ((uint16_t)h[0] << 8) | h[1];
	d->valid_packets = ((uint16_t)p[0] << 8) | p[1];
	d->rssi_now = -157 + rssi; /* HF port, datasheet 5.5.5 */
	return ret ? -EIO : 0;
}

void radio_expected_diag(struct radio_diag *d)
{
	const struct mesh_preset *p = state.preset;
	uint32_t symbol_us = (1U << p->sf) * 1000U / p->bw_khz;

	memset(d, 0, sizeof(*d));
	d->op_mode = MODE_LONG_RANGE | MODE_RX_CONT;
	d->frf = (uint32_t)(((uint64_t)state.freq_hz << 19) / 32000000U);
	d->modem_config_1 = (bw_code(p->bw_khz) << 4) | ((p->cr - 4) << 1);
	d->modem_config_2 = (p->sf << 4) | 0x04;
	d->modem_config_3 = 0x04 | (symbol_us > 16000U ? 0x08 : 0x00);
	d->sync_word = state.sync_word;
	d->preamble = MESHTASTIC_PREAMBLE;
}
```

## src/radio.h
```c
/**
 * @file radio.h
 * @brief RFM95W (SX1276) Meshtastic receiver: regions, presets, frequency slot.
 * @copyright Copyright (c) 2026 Centro de Inovacao EDGE
 * SPDX-License-Identifier: Apache-2.0
 */
#ifndef RADIO_H_
#define RADIO_H_

#include <stddef.h>
#include <stdint.h>

/** Meshtastic region (src/mesh/RadioInterface.cpp, RDEF table). */
struct mesh_region {
	const char *name;
	uint32_t start_hz;
	uint32_t end_hz;
};

/** Meshtastic modem preset (src/mesh/MeshRadio.h, modemPresetToParams). */
struct mesh_preset {
	const char *name;    /* display name, also the default channel name */
	uint16_t bw_khz;
	uint8_t sf;
	uint8_t cr;          /* 5..8 -> 4/5..4/8 */
};

struct radio_state {
	const struct mesh_region *region;
	const struct mesh_preset *preset;
	uint32_t freq_hz;
	uint32_t num_slots;
	uint32_t slot;          /* 0-based */
	uint8_t channel_hash;
	uint8_t sync_word;      /* 0x2B = Meshtastic */
};

/** Raw received frame handed to the application. */
struct radio_frame {
	uint16_t len;
	int16_t rssi;
	int8_t snr;
	uint8_t data[256];
};

extern const struct mesh_region mesh_regions[];
extern const size_t mesh_region_count;
extern const struct mesh_preset mesh_presets[];
extern const size_t mesh_preset_count;

const struct mesh_region *radio_find_region(const char *name);
const struct mesh_preset *radio_find_preset(const char *name);

/** Check the radio and start receiving with the given settings. */
int radio_init(const struct mesh_region *region, const struct mesh_preset *preset);

/** Retune: stop RX, reconfigure, restart RX. */
int radio_set(const struct mesh_region *region, const struct mesh_preset *preset);

const struct radio_state *radio_get(void);

/** Meshtastic sync word. Any other value puts the app in raw test mode. */
#define MESHTASTIC_SYNC_WORD 0x2B

/** Change the LoRa sync word (re-applies the current settings). */
int radio_set_sync_word(uint8_t sync_word);

/** Block until a frame arrives (or timeout). Returns 0 on success. */
int radio_get_frame(struct radio_frame *frame, int32_t timeout_ms);

/** Number of frames received since boot. */
uint32_t radio_rx_count(void);

/** Number of frames dropped because of a payload CRC error. */
uint32_t radio_crc_errors(void);

/** Raw SX1276 registers, read back from the chip for diagnostics. */
struct radio_diag {
	uint8_t version;
	uint8_t op_mode;
	uint32_t frf;
	uint8_t modem_config_1;
	uint8_t modem_config_2;
	uint8_t modem_config_3;
	uint8_t sync_word;
	uint16_t preamble;
	uint8_t modem_stat;
	uint16_t valid_headers;  /* headers decoded since RX started */
	uint16_t valid_packets;  /* packets with a good CRC since RX started */
	int16_t rssi_now;        /* current channel RSSI, dBm */
};

int radio_read_diag(struct radio_diag *d);

/** Expected register values for the current settings. */
void radio_expected_diag(struct radio_diag *d);

#endif /* RADIO_H_ */
```
