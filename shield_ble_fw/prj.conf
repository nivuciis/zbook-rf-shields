## CMakeLists.txt
```
# SPDX-License-Identifier: Apache-2.0

cmake_minimum_required(VERSION 3.20.0)

# Registra o módulo zbook (pasta pai) para o build encontrar a placa
list(APPEND ZEPHYR_EXTRA_MODULES ${CMAKE_CURRENT_SOURCE_DIR}/..)

find_package(Zephyr REQUIRED HINTS $ENV{ZEPHYR_BASE})
project(shield_ble)

target_sources(app PRIVATE src/main.c src/ch592_isp.c src/ble_uart.c)

# Firmware do CH592 embutido no build: hex -> bin -> array C (ch592_fw.inc).
# Por padrão é a ponte BLE <-> UART de ch592/ble_uart, recompilada (make) a
# cada build; -DCH592_HEX=... grava outro hex no lugar.
set(ch592_ble_dir ${CMAKE_CURRENT_SOURCE_DIR}/ch592/ble_uart)
set(CH592_HEX ${ch592_ble_dir}/ble_uart.hex CACHE FILEPATH
    "Firmware (Intel HEX) a gravar no CH592")
set(ch592_bin ${CMAKE_CURRENT_BINARY_DIR}/ch592_fw.bin)

if(CH592_HEX STREQUAL ${ch592_ble_dir}/ble_uart.hex)
  add_custom_target(ch592_ble_uart
    COMMAND make -s -C ${ch592_ble_dir}
    BYPRODUCTS ${CH592_HEX}
    COMMENT "Compilando o firmware BLE do CH592"
  )
  set(ch592_deps ch592_ble_uart)
endif()

add_custom_command(
  OUTPUT ${ch592_bin}
  COMMAND ${CMAKE_OBJCOPY} -I ihex -O binary ${CH592_HEX} ${ch592_bin}
  DEPENDS ${CH592_HEX} ${ch592_deps}
)

generate_inc_file_for_target(app ${ch592_bin}
  ${ZEPHYR_BINARY_DIR}/include/generated/ch592_fw.inc)
```

## prj.conf
```kconfig
CONFIG_GPIO=y
CONFIG_SERIAL=y
CONFIG_UART_INTERRUPT_DRIVEN=y
CONFIG_CRC=y

# A placa liga o log em modo deferred, que imprime numa thread de baixa
# prioridade; como o gravador fica em polling, o printk nunca sairia.
CONFIG_LOG_MODE_IMMEDIATE=y

# CRC do ultimo firmware gravado no CH592, em /lfs (LittleFS da placa)
CONFIG_FLASH=y
CONFIG_FLASH_MAP=y
CONFIG_FLASH_PAGE_LAYOUT=y
CONFIG_FILE_SYSTEM=y
CONFIG_FILE_SYSTEM_LITTLEFS=y
CONFIG_MAIN_STACK_SIZE=4096

# Linhas digitadas no console (uart0) sao enviadas ao celular
CONFIG_CONSOLE_SUBSYS=y
CONFIG_CONSOLE_GETLINE=y
```

## app.overlay
```dts
/*
 * TX da uart1 (GPIO20) com mais corrente e borda rapida: no kit CH592X o
 * PA8 (RX do CH592) tambem vai a um segmento do LCD, que carrega a linha.
 */
&uart1_default {
	group1 {
		drive-strength = <12>;
		slew-rate = <1>;
	};
};
```

## src/main.c
```c
#include <string.h>
#include <zephyr/kernel.h>
#include <zephyr/console/console.h>
#include <zephyr/drivers/gpio.h>
#include <zephyr/drivers/uart.h>
#include <zephyr/fs/fs.h>
#include <zephyr/sys/crc.h>
#include <zephyr/sys/printk.h>

#include "ble_uart.h"
#include "ch592_isp.h"

/*
 * Bluetooth da zbook pelo kit CH592X-EVT-R1, ligado na uart1 (header H2):
 *
 *   zbook TX  (GPIO20) -> P4 UART1_RX (PA8)
 *   zbook RX  (GPIO21) <- P4 UART1_TX (PA9)
 *   zbook GND          -- P4 GND
 *
 * Ao ligar, a zbook grava o firmware embutido (CH592_HEX, CMakeLists.txt) no
 * CH592 se ele mudou desde a ultima gravacao, ou se BUTTON0 estiver apertado.
 * Depois usa o CH592 como ponte BLE <-> UART (ch592/ble_uart): o que o
 * celular envia e impresso no console (uart0) e cada linha digitada no
 * console e enviada ao celular.
 *
 * Mapa do arquivo:
 *   ch592_fw[]       firmware do CH592 embutido (array gerado no build)
 *   ch592_update()   decide se grava: CRC do array x CRC salvo no LittleFS
 *   ch592_program()  grava pelo protocolo ISP (ch592_isp.c)
 *   console_to_ble() thread da volta: console -> celular
 *   ble_bridge()     ida: celular -> console (regra dos 50 ms)
 *   main()           update -> liga interrupcao -> ponte
 */

/*
 * O CMake gera ch592_fw.inc (texto "0x13, 0x05, ...") a partir do .bin; o
 * include entre as chaves vira um array constante na flash da zbook.
 */
static const uint8_t ch592_fw[] = {
#include "ch592_fw.inc"
};

/* CRC do ultimo firmware gravado no CH592 */
#define FW_INFO_PATH "/lfs/ch592.crc"

static const struct device *uart = DEVICE_DT_GET(DT_NODELABEL(uart1));
static const struct gpio_dt_spec button = GPIO_DT_SPEC_GET(DT_ALIAS(button0), gpios);

/* O firmware ble_uart contem o texto que dispara o reset para o bootloader */
static bool ch592_fw_is_ble_uart(void)
{
	static const char magic[] = "MCU ISP & WCH.CN";

	for (size_t i = 0; i + sizeof(magic) - 1 <= sizeof(ch592_fw); i++) {
		if (memcmp(&ch592_fw[i], magic, sizeof(magic) - 1) == 0) {
			return true;
		}
	}
	return false;
}

/* O que fica salvo em /lfs/ch592.crc: so o CRC e o tamanho, nao o firmware */
struct fw_info {
	uint32_t crc;
	uint32_t len;
};

/* Le o CRC da ultima gravacao; false se o arquivo nao existe (primeira vez) */
static bool fw_info_read(struct fw_info *info)
{
	struct fs_dirent entry;
	struct fs_file_t file;
	ssize_t n;

	if (fs_stat(FW_INFO_PATH, &entry) != 0) {
		return false;
	}
	fs_file_t_init(&file);
	if (fs_open(&file, FW_INFO_PATH, FS_O_READ) != 0) {
		return false;
	}
	n = fs_read(&file, info, sizeof(*info));
	fs_close(&file);
	return n == sizeof(*info);
}

/* Salva o CRC do firmware que acabou de ser gravado */
static void fw_info_write(const struct fw_info *info)
{
	struct fs_file_t file;

	fs_file_t_init(&file);
	if (fs_open(&file, FW_INFO_PATH, FS_O_CREATE | FS_O_WRITE | FS_O_TRUNC) != 0) {
		printk("Aviso: nao foi possivel salvar %s\n", FW_INFO_PATH);
		return;
	}
	fs_write(&file, info, sizeof(*info));
	fs_close(&file);
}

/* Acha o bootloader e grava; insiste ate conseguir */
static void ch592_program(void)
{
	printk("Gravando o CH592 (%zu bytes) pela uart1...\n", sizeof(ch592_fw));
	printk("Se o firmware atual do CH592 nao for o ble_uart, desligue o kit, "
	       "tire o fio TX da zbook, ligue segurando Download e recoloque o fio.\n");

	/* Depois de uma falha o CH592 continua no bootloader: tenta de novo */
	for (int tries = 1;; tries++) {
		while (ch592_isp_connect(uart, 10000) != 0) {
			printk("Nenhum bootloader respondeu, tentando de novo...\n");
		}
		if (ch592_isp_flash(uart, ch592_fw, sizeof(ch592_fw)) == 0) {
			return;
		}
		printk("Gravacao FALHOU (tentativa %d), repetindo...\n", tries);
		k_msleep(500);
	}
}

/*
 * Autoteste da regravacao sem botao: o firmware ble_uart reinicia no
 * bootloader quando recebe o IDENTIFY. Se o bootloader responder, o firmware
 * esta rodando e a proxima atualizacao sera automatica.
 */
static void ch592_selftest(void)
{
	k_msleep(1500); /* tempo para o firmware BLE iniciar */
	if (ch592_isp_connect(uart, 3000) == 0) {
		printk("Autoteste OK: o CH592 volta ao bootloader pela uart1, "
		       "as proximas gravacoes serao automaticas\n");
		ch592_isp_end(uart);
		k_msleep(500);
	} else {
		printk("Autoteste FALHOU: o firmware BLE nao respondeu ao pedido de "
		       "regravacao (ele esta rodando?)\n");
	}
}

/*
 * Roda uma vez por boot. Nao grava se o CRC do array for igual ao salvo E o
 * BUTTON0 estiver solto; senao grava, salva o CRC novo e faz o autoteste.
 * O firmware nao e recompilado aqui: isso acontece no PC (west build).
 */
static void ch592_update(void)
{
	struct fw_info now = {
		.crc = crc32_ieee(ch592_fw, sizeof(ch592_fw)),
		.len = sizeof(ch592_fw),
	};
	struct fw_info last;
	bool forced = gpio_pin_get_dt(&button) > 0;

	if (!forced && fw_info_read(&last) && last.crc == now.crc && last.len == now.len) {
		printk("CH592 ja esta com o firmware atual (crc 0x%08x)\n", now.crc);
		return;
	}

	printk("CH592: firmware novo (crc 0x%08x)%s\n", now.crc,
	       forced ? ", gravacao forcada por BUTTON0" : "");
	ch592_program();
	fw_info_write(&now);
	if (ch592_fw_is_ble_uart()) {
		ch592_selftest();
	}
}

/*
 * Volta: zbook -> celular. Cada linha digitada no console (uart0) e enviada
 * ao celular pela ponte. A thread so comeca depois que a gravacao do CH592
 * terminou (ble_ready), para nao misturar texto com o protocolo ISP.
 * O semaforo e esperado uma vez so, no inicio; depois as linhas passam direto.
 */
static K_SEM_DEFINE(ble_ready, 0, 1);

static void console_to_ble(void *p1, void *p2, void *p3)
{
	static const char magic[] = "MCU ISP & WCH.CN";

	ARG_UNUSED(p1);
	ARG_UNUSED(p2);
	ARG_UNUSED(p3);

	k_sem_take(&ble_ready, K_FOREVER);
	console_getline_init();

	while (1) {
		char *line = console_getline();

		if (line == NULL || line[0] == '\0') {
			continue;
		}
		/* Esse texto faria o CH592 reiniciar no bootloader */
		if (strstr(line, magic) != NULL) {
			printk("Nao enviado: o texto reinicia o CH592 no bootloader\n");
			continue;
		}
		ble_uart_send(line, strlen(line));
		ble_uart_send("\r\n", 2);
		printk("%s\n", line);
	}
}

/* Thread criada no boot: pilha de 1 KB, prioridade 7, comeca ja (e para no semaforo) */
K_THREAD_DEFINE(console_tid, 1024, console_to_ble, NULL, NULL, NULL, 7, 0, 0);

/*
 * Ida: celular -> zbook. Cada mensagem recebida e impressa no console. Uma
 * mensagem termina em fim de linha ou depois de 50 ms sem bytes novos (apps
 * como o nRF Connect nao mandam fim de linha).
 */
static void print_msg(char *line, size_t len)
{
	line[len] = '\0';
	printk("%s\n", line);
}

/*
 * Laco eterno da thread main: tira bytes do ring buffer, junta em linha e
 * imprime. Libera a thread da volta (k_sem_give) logo no comeco.
 */
static void ble_bridge(void)
{
	char line[128];
	size_t len = 0;
	int64_t last_rx = 0;
	uint8_t c;

	printk("BLE pronto: conecte no dispositivo \"ch592_ble_uart\" (ex.: nRF Connect), "
	       "ative as notificacoes de 0xFFF1 e escreva em 0xFFF2.\n"
	       "O que o celular enviar aparece aqui; digite uma linha e Enter para "
	       "enviar ao celular.\n");
	k_sem_give(&ble_ready);

	while (1) {
		while (ble_uart_read(&c, 1) == 1) {
			last_rx = k_uptime_get();
			if (c == '\r' || c == '\n' || len == sizeof(line) - 1) {
				if (len > 0) {
					print_msg(line, len);
					len = 0;
				}
			} else {
				line[len++] = c;
			}
		}
		if (len > 0 && k_uptime_get() - last_rx > 50) {
			print_msg(line, len);
			len = 0;
		}

		k_msleep(10);
	}
}

/* A ordem importa: primeiro grava (uart1 em polling), depois a ponte (interrupcao) */
int main(void)
{
	if (!device_is_ready(uart) || !gpio_is_ready_dt(&button)) {
		printk("uart1 ou BUTTON0 nao estao prontos\n");
		return 0;
	}
	gpio_pin_configure_dt(&button, GPIO_INPUT);

	ch592_update();

	if (ble_uart_init(uart) != 0) {
		printk("Falha ao ligar a recepcao da uart1\n");
		return 0;
	}
	ble_bridge();
	return 0;
}
```

## src/ble_uart.c
```c
/*
 * Lado da zbook na ponte: a uart1 depois da gravacao.
 *
 *   Recebe (CH592 -> zbook): interrupcao -> ring buffer -> ble_uart_read()
 *   Envia  (zbook -> CH592): ble_uart_send(), byte a byte por polling
 *
 * Usa so a API generica de UART do Zephyr; o driver por baixo e o PL011.
 */
#include <zephyr/kernel.h>
#include <zephyr/drivers/uart.h>
#include <zephyr/sys/ring_buffer.h>

#include "ble_uart.h"

/*
 * Buffer circular entre a interrupcao (produtor) e a thread main (consumidor).
 * Se encher, ring_buf_put recusa os bytes novos (os antigos ficam).
 */
RING_BUF_DECLARE(rx_buf, 1024);

static const struct device *ble_dev;

/*
 * Roda na interrupcao da uart1: so copia o FIFO de hardware (32 bytes) para o
 * ring buffer e sai. Nada de printk ou espera aqui.
 */
static void uart_isr(const struct device *dev, void *user_data)
{
	uint8_t chunk[32];
	int n;

	ARG_UNUSED(user_data);

	if (!uart_irq_update(dev)) {
		return;
	}
	while (uart_irq_rx_ready(dev)) {
		n = uart_fifo_read(dev, chunk, sizeof(chunk));
		if (n <= 0) {
			break;
		}
		ring_buf_put(&rx_buf, chunk, n);
	}
}

/* Chamada uma vez, depois da gravacao: troca o polling do ISP por interrupcao */
int ble_uart_init(const struct device *uart)
{
	uint8_t c;
	int ret;

	ble_dev = uart;

	/* Descarta o que sobrou da gravacao */
	while (uart_poll_in(uart, &c) == 0) {
	}

	ret = uart_irq_callback_user_data_set(uart, uart_isr, NULL);
	if (ret) {
		return ret;
	}
	uart_irq_rx_enable(uart);
	return 0;
}

/* Envio simples por polling: a 115200 e com mensagens curtas e suficiente */
void ble_uart_send(const void *data, size_t len)
{
	const uint8_t *p = data;

	for (size_t i = 0; i < len; i++) {
		uart_poll_out(ble_dev, p[i]);
	}
}

/* Lado consumidor: a thread main tira do ring buffer no ritmo dela */
size_t ble_uart_read(void *buf, size_t len)
{
	return ring_buf_get(&rx_buf, buf, len);
}
```

## src/ble_uart.h
```c
#ifndef BLE_UART_H_
#define BLE_UART_H_

#include <stddef.h>
#include <zephyr/device.h>

/*
 * Bluetooth da zbook pelo CH592: o firmware ch592/ble_uart e uma ponte
 * transparente. O que a zbook escreve na uart1 vai para o celular (notify) e o
 * que o celular escreve chega na uart1.
 *
 * Nao envie o texto "MCU ISP & WCH.CN": ele faz o CH592 reiniciar no
 * bootloader para ser regravado.
 */

/* Liga a recepcao por interrupcao (depois de gravar o CH592) */
int ble_uart_init(const struct device *uart);

/* Envia dados para o celular conectado */
void ble_uart_send(const void *data, size_t len);

/* Copia ate len bytes recebidos do celular; retorna quantos copiou */
size_t ble_uart_read(void *buf, size_t len);

#endif /* BLE_UART_H_ */
```

## src/ch592_isp.c
```c
/*
 * Gravador do CH592: fala com o bootloader (ROM) do chip pela uart1, no
 * protocolo ISP serial da WCH. Pedido e resposta, um comando por vez, tudo
 * por polling (uart_poll_out / uart_poll_in).
 *
 * Sequencia (ch592_isp_flash):
 *   IDENTIFY -> READ_CONFIG (UID) -> ISP_KEY (chave XOR) -> ERASE
 *   -> PROGRAM (blocos de 56 B) -> VERIFY -> ISP_END (roda o firmware novo)
 *
 * Mapa do arquivo:
 *   isp_xfer()          monta e envia um frame, le e confere a resposta
 *   ch592_isp_connect() IDENTIFY ate o bootloader responder
 *   isp_session()       READ_CONFIG + ISP_KEY (calcula a chave)
 *   isp_resync()        refaz a sessao depois de um bloco perdido
 *   write_chunks()      PROGRAM ou VERIFY, bloco a bloco
 *   ch592_isp_flash()   a sequencia completa
 */
#include <errno.h>
#include <string.h>
#include <zephyr/kernel.h>
#include <zephyr/drivers/uart.h>
#include <zephyr/sys/byteorder.h>
#include <zephyr/sys/printk.h>

#include "ch592_isp.h"

/* Comandos do bootloader */
#define CMD_IDENTIFY    0xA1
#define CMD_ISP_END     0xA2
#define CMD_ISP_KEY     0xA3
#define CMD_ERASE       0xA4
#define CMD_PROGRAM     0xA5
#define CMD_VERIFY      0xA6
#define CMD_READ_CONFIG 0xA7

#define CH592_CHIP_ID     0x92
#define CH59X_DEVICE_TYPE 0x22
#define CFG_MASK_ALL      0x1F

#define ISP_SEED         0xFF   /* semente enviada no ISP_KEY */
#define SECTOR_SIZE      1024   /* ERASE trabalha em setores de 1 KB */
#define MIN_ERASE_SECTOR 8      /* o bootloader apaga no minimo 8 setores */
#define CHUNK            56     /* bytes de firmware por PROGRAM/VERIFY */
#define CHUNK_TRIES      6      /* tentativas por bloco antes de desistir */
#define CHUNK_TIMEOUT_MS 3000   /* prazo para a resposta de um bloco */
#define MAX_DATA         64     /* maior resposta que esperamos */

struct isp_resp {
	uint8_t cmd;
	uint8_t status;
	uint16_t len;
	uint8_t data[MAX_DATA];
};

/* Diagnostico: bytes recebidos na uart1 desde o ultimo relatorio */
static uint32_t rx_count;
static uint8_t rx_last[16];

static int rx_poll(const struct device *uart, uint8_t *c)
{
	if (uart_poll_in(uart, c) != 0) {
		return -1;
	}
	rx_last[rx_count % sizeof(rx_last)] = *c;
	rx_count++;
	return 0;
}

static void rx_drain(const struct device *uart)
{
	uint8_t c;

	while (rx_poll(uart, &c) == 0) {
	}
}

static int rx_byte(const struct device *uart, uint8_t *c, int64_t deadline)
{
	while (rx_poll(uart, c) != 0) {
		if (k_uptime_get() > deadline) {
			return -ETIMEDOUT;
		}
	}
	return 0;
}

/*
 * Um comando completo: todos os comandos do gravador passam por aqui.
 *
 * Pedido:   57 AB | cmd | len(LE16) | dados | soma(cmd..dados)
 * Resposta: 55 AA | cmd | status | len(LE16) | dados | soma(cmd..dados)
 *
 * Retorna 0 se chegou resposta valida (checksum e cmd conferem).
 */
static int isp_xfer(const struct device *uart, uint8_t cmd, const uint8_t *data,
		    uint16_t len, struct isp_resp *resp, uint32_t timeout_ms)
{
	uint8_t hdr[4] = { cmd, len & 0xFF, len >> 8 };
	uint8_t sum = 0;
	uint8_t c;
	int64_t deadline;

	rx_drain(uart);

	uart_poll_out(uart, 0x57);
	uart_poll_out(uart, 0xAB);
	for (int i = 0; i < 3; i++) {
		uart_poll_out(uart, hdr[i]);
		sum += hdr[i];
	}
	for (int i = 0; i < len; i++) {
		uart_poll_out(uart, data[i]);
		sum += data[i];
	}
	uart_poll_out(uart, sum);

	deadline = k_uptime_get() + timeout_ms;

	/* Procura o cabecalho 55 AA */
	do {
		if (rx_byte(uart, &c, deadline)) {
			return -ETIMEDOUT;
		}
		while (c == 0x55) {
			if (rx_byte(uart, &c, deadline)) {
				return -ETIMEDOUT;
			}
			if (c == 0xAA) {
				goto header;
			}
		}
	} while (1);

header:
	sum = 0;
	for (int i = 0; i < 4; i++) {
		if (rx_byte(uart, &hdr[i], deadline)) {
			return -ETIMEDOUT;
		}
		sum += hdr[i];
	}
	resp->cmd = hdr[0];
	resp->status = hdr[1];
	resp->len = hdr[2] | (hdr[3] << 8);
	if (resp->len > MAX_DATA) {
		return -EMSGSIZE;
	}
	for (int i = 0; i < resp->len; i++) {
		if (rx_byte(uart, &resp->data[i], deadline)) {
			return -ETIMEDOUT;
		}
		sum += resp->data[i];
	}
	if (rx_byte(uart, &c, deadline)) {
		return -ETIMEDOUT;
	}
	if (c != sum) {
		return -EBADMSG;
	}
	if (resp->cmd != cmd) {
		return -EPROTO;
	}
	return 0;
}

static void hexdump(const char *label, const uint8_t *buf, size_t len)
{
	printk("%s:", label);
	for (size_t i = 0; i < len; i++) {
		printk(" %02X", buf[i]);
	}
	printk("\n");
}

/* Diagnostico: mostra o que chegou na uart1 desde o ultimo relatorio */
static void rx_report(const struct device *uart)
{
	uint32_t n = MIN(rx_count, sizeof(rx_last));

	printk("uart1: %u bytes recebidos, erro=0x%x, ultimos:", rx_count,
	       uart_err_check(uart));
	for (uint32_t i = 0; i < n; i++) {
		printk(" %02X", rx_last[(rx_count - n + i) % sizeof(rx_last)]);
	}
	printk("\n");
	rx_count = 0;
}

/*
 * IDENTIFY leva o texto "MCU ISP & WCH.CN". Se o CH592 esta rodando a ponte,
 * esse texto o faz reiniciar no bootloader (reset magico, peripheral.c), e o
 * IDENTIFY seguinte ja e respondido pelo bootloader.
 */
int ch592_isp_connect(const struct device *uart, uint32_t timeout_ms)
{
	static const char magic[] = "MCU ISP & WCH.CN";
	uint8_t req[2 + sizeof(magic) - 1] = { CH592_CHIP_ID, CH59X_DEVICE_TYPE };
	struct isp_resp resp;
	int64_t deadline = k_uptime_get() + timeout_ms;

	memcpy(&req[2], magic, sizeof(magic) - 1);

	/* A janela do download sem botao e curta: insiste a cada ~20 ms */
	while (k_uptime_get() < deadline) {
		if (isp_xfer(uart, CMD_IDENTIFY, req, sizeof(req), &resp, 20) == 0 &&
		    resp.len >= 2) {
			printk("Bootloader encontrado: chip 0x%02X, tipo 0x%02X\n",
			       resp.data[0], resp.data[1]);
			if (resp.data[0] != CH592_CHIP_ID ||
			    resp.data[1] != CH59X_DEVICE_TYPE) {
				printk("Aviso: esperado chip 0x92 / tipo 0x22\n");
			}
			return 0;
		}
	}

	rx_report(uart);
	return -ETIMEDOUT;
}

/*
 * Prepara a sessao depois do IDENTIFY: le a config e o UID e envia a semente
 * da chave XOR. Usada no inicio e para ressincronizar depois de um erro.
 */
static int isp_session(const struct device *uart, uint8_t key[8], bool verbose)
{
	struct isp_resp resp;
	uint8_t req[30];
	uint8_t sum = 0;
	int ret;

	/* Config + versao do bootloader + UID */
	req[0] = CFG_MASK_ALL;
	req[1] = 0;
	ret = isp_xfer(uart, CMD_READ_CONFIG, req, 2, &resp, 500);
	if (ret || resp.len < 26) {
		printk("READ_CONFIG falhou (%d)\n", ret);
		return -EIO;
	}
	if (verbose) {
		hexdump("READ_CONFIG", resp.data, resp.len);
		printk("Bootloader V%x%x.%x%x, UID", resp.data[14], resp.data[15],
		       resp.data[16], resp.data[17]);
		for (int i = 18; i < 26; i++) {
			printk(" %02X", resp.data[i]);
		}
		printk("\n");
	}
	for (int i = 18; i < 26; i++) {
		sum += resp.data[i];
	}

	/*
	 * Chave XOR: o bootloader escolhe 7 bytes da semente e faz XOR com a soma
	 * do UID; o ultimo byte e o primeiro somado ao chip id. Com a semente
	 * uniforme, a escolha dos bytes nao importa. A semente e 0xFF e nao 0x00
	 * (wchisp): com 30 bytes 0x00 o bootloader nao respondia.
	 */
	memset(key, sum ^ ISP_SEED, 8);
	key[7] = key[0] + CH592_CHIP_ID;
	sum = 0;
	for (int i = 0; i < 8; i++) {
		sum += key[i];
	}

	memset(req, ISP_SEED, sizeof(req));
	for (int i = 0;; i++) {
		rx_count = 0;
		ret = isp_xfer(uart, CMD_ISP_KEY, req, 30, &resp, 1000);
		if (!ret && resp.len >= 1 && resp.data[0] == sum) {
			return 0;
		}
		printk("ISP_KEY falhou (%d, esperado 0x%02X)\n", ret, sum);
		if (!ret) {
			hexdump("resposta", resp.data, resp.len);
		}
		rx_report(uart);
		if (i == 2) {
			return -EIO;
		}
		k_msleep(100);
	}
}

/*
 * Depois de um frame perdido o bootloader fica dessincronizado e recusa os
 * blocos seguintes: fica em silencio para ele descartar o frame incompleto e
 * refaz IDENTIFY + sessao, sem apagar nada.
 */
static int isp_resync(const struct device *uart, uint8_t key[8])
{
	k_msleep(300);
	if (ch592_isp_connect(uart, 3000) != 0) {
		return -EIO;
	}
	return isp_session(uart, key, false);
}

/* Grava (PROGRAM) ou confere (VERIFY) o firmware em blocos de CHUNK bytes */
static int write_chunks(const struct device *uart, uint8_t cmd, const uint8_t *fw,
			size_t fw_len, uint8_t key[8])
{
	const char *name = cmd == CMD_PROGRAM ? "PROGRAM" : "VERIFY";
	/* O bootloader grava em palavras: o tamanho tem que ser multiplo de 8 */
	size_t len = ROUND_UP(fw_len, 8);
	uint8_t req[5 + CHUNK];
	struct isp_resp resp;
	size_t addr = 0;
	int mismatches = 0;

	while (addr < len) {
		size_t n = MIN(CHUNK, len - addr);

		/*
		 * Repete so este bloco. Regravar os mesmos dados e inofensivo (a
		 * flash so leva bits de 1 para 0) e o VERIFY confere tudo no final.
		 */
		for (int tries = 1, wrong = 0;; tries++) {
			int64_t t0, t;
			int ret;

			sys_put_le32(addr, req);
			req[4] = (uint8_t)k_cycle_get_32(); /* padding, qualquer valor */
			for (size_t i = 0; i < n; i++) {
				/* O fim do firmware e completado com 0xFF (flash apagada) */
				uint8_t b = addr + i < fw_len ? fw[addr + i] : 0xFF;

				/* Cada byte vai cifrado com a chave; o bootloader desfaz */
				req[5 + i] = b ^ key[i % 8];
			}

			t0 = k_uptime_get();
			ret = isp_xfer(uart, cmd, req, 5 + n, &resp, CHUNK_TIMEOUT_MS);
			t = k_uptime_get() - t0;
			if (t > 100) {
				printk("  %s em 0x%05zx levou %lld ms\n", name, addr, t);
			}
			if (!ret && (cmd == CMD_PROGRAM || (resp.len >= 1 && resp.data[0] == 0))) {
				break;
			}
			if (!ret) {
				/*
				 * Resposta valida dizendo que os dados nao conferem. Repete
				 * para separar erro na transmissao do VERIFY de dado gravado
				 * errado, e segue para contar quantos blocos estao errados.
				 */
				if (++wrong < 3) {
					continue;
				}
				printk("%s em 0x%05zx: dados diferentes (status 0x%02x)\n", name,
				       addr, resp.len ? resp.data[0] : 0xff);
				mismatches++;
				break;
			}
			printk("%s em 0x%05zx sem resposta (%d), tentativa %d\n", name, addr,
			       ret, tries);
			if (tries == CHUNK_TRIES) {
				return -EIO;
			}
			if (isp_resync(uart, key) != 0) {
				printk("Ressincronizacao falhou\n");
				return -EIO;
			}
		}
		addr += n;
		if (addr % (16 * SECTOR_SIZE) < CHUNK || addr == len) {
			printk("  %s %zu/%zu bytes\n",
			       cmd == CMD_PROGRAM ? "gravado" : "verificado", addr, len);
		}
	}

	if (mismatches) {
		printk("%s: %d de %zu blocos diferentes\n", name, mismatches,
		       DIV_ROUND_UP(len, CHUNK));
		return -EIO;
	}

	if (cmd == CMD_PROGRAM) {
		/* O bootloader exige um PROGRAM vazio no final */
		sys_put_le32(addr, req);
		req[4] = 0;
		if (isp_xfer(uart, CMD_PROGRAM, req, 5, &resp, 300)) {
			printk("PROGRAM final falhou\n");
			return -EIO;
		}
	}
	return 0;
}

/* A gravacao inteira; chamar depois de ch592_isp_connect() */
int ch592_isp_flash(const struct device *uart, const uint8_t *fw, size_t len)
{
	struct isp_resp resp;
	uint8_t req[4];
	uint8_t key[8];
	uint32_t sectors;
	int ret;

	ret = isp_session(uart, key, true);
	if (ret) {
		return ret;
	}

	sectors = MAX(DIV_ROUND_UP(len, SECTOR_SIZE), MIN_ERASE_SECTOR);
	printk("Apagando %u setores de 1 KB...\n", sectors);
	sys_put_le32(sectors, req);
	ret = isp_xfer(uart, CMD_ERASE, req, 4, &resp, 15000);
	if (ret) {
		printk("ERASE falhou (%d)\n", ret);
		return -EIO;
	}
	/* Margem para o bootloader terminar de apagar antes do primeiro bloco */
	k_msleep(200);

	printk("Gravando %zu bytes...\n", len);
	ret = write_chunks(uart, CMD_PROGRAM, fw, len, key);
	if (ret) {
		return ret;
	}

	printk("Verificando...\n");
	ret = write_chunks(uart, CMD_VERIFY, fw, len, key);
	if (ret) {
		return ret;
	}

	ch592_isp_end(uart);
	printk("Gravacao concluida, CH592 reiniciado\n");
	return 0;
}

void ch592_isp_end(const struct device *uart)
{
	uint8_t reason = 1;
	struct isp_resp resp;

	/* Sai do bootloader e roda o firmware gravado (pode nao haver resposta) */
	isp_xfer(uart, CMD_ISP_END, &reason, 1, &resp, 200);
}
```

## src/ch592_isp.h
```c
#ifndef CH592_ISP_H_
#define CH592_ISP_H_

#include <stddef.h>
#include <stdint.h>
#include <zephyr/device.h>

/*
 * Gravador do CH592 pelo bootloader ISP serial da WCH (UART1 do CH592:
 * PA8 = RX, PA9 = TX, 115200 8N1). Protocolo baseado no wchisp
 * (github.com/ch32-rs/wchisp).
 */

/* Envia IDENTIFY repetidamente ate o bootloader responder ou estourar timeout_ms */
int ch592_isp_connect(const struct device *uart, uint32_t timeout_ms);

/* Le config/UID, apaga, grava, verifica e reinicia o CH592 no firmware novo */
int ch592_isp_flash(const struct device *uart, const uint8_t *fw, size_t len);

/* Sai do bootloader e roda o firmware que esta na flash do CH592 */
void ch592_isp_end(const struct device *uart);

#endif /* CH592_ISP_H_ */
```
